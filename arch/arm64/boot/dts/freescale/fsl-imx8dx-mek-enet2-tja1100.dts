/*
 * Copyright 2020 NXP
 *
 * This program is free software; you can redistribute it and/or
 * modify it under the terms of the GNU General Public License
 * as published by the Free Software Foundation; either version 2
 * of the License, or (at your option) any later version.
 *
 * This program is distributed in the hope that it will be useful,
 * but WITHOUT ANY WARRANTY; without even the implied warranty of
 * MERCHANTABILITY or FITNESS FOR A PARTICULAR PURPOSE.  See the
 * GNU General Public License for more details.
 */

#include "fsl-imx8dx-mek.dts"
#include "fsl-imx8qxp-enet2-tja1100.dtsi"

&esai0 {
	status = "disabled";
};

&ethphy1 {
	status = "okay";
};

&fec2 {
	status = "okay";
};
