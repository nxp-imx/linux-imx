// SPDX-License-Identifier: (GPL-2.0+ OR MIT)
/*
 * Copyright 2024 NXP
 */

/dts-v1/;
/plugin/;

#include <dt-bindings/clock/nxp,imx95-clock.h>
#include <dt-bindings/gpio/gpio.h>
#include "imx95-pinfunc.h"

&vehicle_core {
	status = "okay";
};
