// SPDX-License-Identifier: (GPL-2.0+ OR MIT)
/*
 * Copyright 2023,2026 NXP
 */

/dts-v1/;
/plugin/;

#include "imx95-clock.h"
#include "imx95-evk-dsi-serdes-common.dtsi"

&dpu {
	assigned-clocks = <&scmi_clk IMX95_CLK_DISP1PIX>,
			  <&scmi_clk IMX95_CLK_VIDEOPLL1_VCO>,
			  <&scmi_clk IMX95_CLK_VIDEOPLL1>;
	assigned-clock-parents = <&scmi_clk IMX95_CLK_VIDEOPLL1>;
	assigned-clock-rates = <0>, <4008000000>, <445333334>;
};
