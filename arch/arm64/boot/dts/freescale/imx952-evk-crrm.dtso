// SPDX-License-Identifier: (GPL-2.0+ OR MIT)
/*
 * Copyright 2026 NXP
 */

/dts-v1/;
/plugin/;

&{/} {
	reset_ctrl {
		compatible = "nxp,imx95-resetctrl";
		status = "okay";
        };
};

&xspi1 {
	status = "disabled";
};
