// SPDX-License-Identifier: (GPL-2.0+ OR MIT)
/*
 * Copyright 2025 NXP
 */

#include "imx91-11x11-frdm-imx91s.dts"

&flexspi1 {
	assigned-clocks = <&clk IMX91_CLK_FLEXSPI1>;
	assigned-clock-parents = <&clk IMX91_CLK_SYS_PLL_PFD1>;
	assigned-clock-rates = <266000000>;
};

&lpm {
	no-od-mode;
	ld-mode-enabled;
	soc-supply = <&buck2>;
	status = "okay";
};

&usdhc1 {
	assigned-clocks = <&clk IMX91_CLK_USDHC1>;
	assigned-clock-parents = <&clk IMX91_CLK_SYS_PLL_PFD1>;
	assigned-clock-rates = <266000000>;
};

&usdhc2 {
	assigned-clocks = <&clk IMX91_CLK_USDHC2>;
	assigned-clock-parents = <&clk IMX91_CLK_SYS_PLL_PFD1>;
	assigned-clock-rates = <266000000>;
};
