// SPDX-License-Identifier: (GPL-2.0+ OR MIT)
/*
 * Copyright 2026 NXP
 */

/*
 * This overlay cannot be used out-of-the-box since FRDM-IMX952
 * defaults to a 2x2 lane CSI configuration. The following hardware
 * rework is required to switch to 1x4 lane mode:

 *  - DNP: R394, R395, R399, R400
 *  - Populate: R386, R387, R390, R391
 */

/dts-v1/;
/plugin/;

#define DATA_LANES <1 2 3 4>
#include "imx952-frdm-os08a20-csi0-common.dtsi"

&camera_phy_csr {
	#address-cells = <1>;
	#size-cells = <1>;

	dphy_rx_0: dphy-rx@0 {
		reg = <0x0 0x10>, <0x100 0x10>;
		clocks = <&scmi_clk IMX952_CLK_CAMPHYCFG>,
			 <&scmi_clk IMX952_CLK_CGC_CAMCSI0>,
			 <&scmi_clk IMX952_CLK_CGC_CAMCSI1>;
		clock-names = "phy_cfg", "csi0", "csi1";
		assigned-clocks = <&scmi_clk IMX952_CLK_CAMPHYCFG>;
		assigned-clock-parents = <&scmi_clk IMX952_CLK_OSC24M>;
		assigned-clock-rates = <24000000>;
		fsl,csis = <&mipi_csi_0>, <&mipi_csi_1>;
		status = "okay";
	};
};
