// SPDX-License-Identifier: (GPL-2.0+ OR MIT)
/*
 * Copyright 2026 NXP
 */

#include "imx952-clock.h"
#include "imx95-frdm-waveshare-7inch-c-panel-common.dtsi"

&dpu {
	assigned-clocks = <&scmi_clk IMX952_CLK_DISP1PIX>,
			  <&scmi_clk IMX952_CLK_VIDEOPLL1_VCO>,
			  <&scmi_clk IMX952_CLK_VIDEOPLL1>;
	assigned-clock-parents = <&scmi_clk IMX952_CLK_VIDEOPLL1>;
	assigned-clock-rates = <0>, <3000000000>, <500000000>;
};

&pixel_interleaver {
	#address-cells = <1>;
	#size-cells = <0>;
	status = "okay";

	channel@0 {
		reg = <0>;
		status = "okay";
	};
};

&mipi_dphy {
	status = "okay";
};
