/*
 * Copyright 2020 NXP
 *
 * This program is free software; you can redistribute it and/or
 * modify it under the terms of the GNU General Public License
 * as published by the Free Software Foundation; either version 2
 * of the License, or (at your option) any later version.
 *
 * This program is distributed in the hope that it will be useful,
 * but WITHOUT ANY WARRANTY; without even the implied warranty of
 * MERCHANTABILITY or FITNESS FOR A PARTICULAR PURPOSE.  See the
 * GNU General Public License for more details.
 */

#include "imx8qm-mek-car2-a72.dts"

/ {
	esai_client0: esai_client@0 {
		compatible = "fsl,esai-client";
		fsl,client-id = <0>;
	};

	esai_client1: esai_client@1 {
		compatible = "fsl,esai-client";
		fsl,client-id = <1>;
	};
};

&esai0 {
	client-dais = <&esai_client0>, <&esai_client1>;
};
