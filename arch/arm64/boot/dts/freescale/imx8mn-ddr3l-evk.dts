// SPDX-License-Identifier: (GPL-2.0+ OR MIT)
 /*
  * Copyright 2020 NXP
  */

#include "imx8mn-evk.dts"

/ {
	model = "NXP i.MX8MNano DDR3L EVK board";
};

&aips4 {
	/delete-node/ display-subsystem;
};

/delete-node/ &adv_bridge;
/delete-node/ &gpu;
/delete-node/ &lcdif;
/delete-node/ &mipi_dsi;
