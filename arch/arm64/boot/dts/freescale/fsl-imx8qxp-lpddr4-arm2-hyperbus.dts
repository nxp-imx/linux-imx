// SPDX-License-Identifier: GPL-2.0+
/*
 * Copyright 2017~2018 NXP
 *
 * This program is free software; you can redistribute it and/or
 * modify it under the terms of the GNU General Public License
 * as published by the Free Software Foundation; either version 2
 * of the License, or (at your option) any later version.
 *
 * This program is distributed in the hope that it will be useful,
 * but WITHOUT ANY WARRANTY; without even the implied warranty of
 * MERCHANTABILITY or FITNESS FOR A PARTICULAR PURPOSE.  See the
 * GNU General Public License for more details.
 */

/dts-v1/;

#include "fsl-imx8qxp.dtsi"
#include "fsl-imx8x-arm2.dtsi"

/ {
	model = "Freescale i.MX8QXP LPDDR4 ARM2";
	compatible = "fsl,imx8qxp-lpddr4-arm2", "fsl,imx8qxp";
};

&hyperbus{
	pinctrl-names = "default";
	pinctrl-0 = <&pinctrl_flexspi0>;
	status = "okay";

	flash@0 {
		compatible = "cypress,hyperflash", "cfi-flash";
		reg = <0x0 0x4000000>;
	};
};

&flexspi0{
	status = "disabled";
};

