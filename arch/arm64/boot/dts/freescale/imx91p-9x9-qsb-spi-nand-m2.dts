// SPDX-License-Identifier: (GPL-2.0+ OR MIT)
/*
 * Copyright 2023 NXP
 */

#include "imx91p-9x9-qsb-flexspi-m2.dts"

&flexspi1 {
	/delete-node/ mt25qu512abb8e12;

	mt29f4g01abbfd: flash@0 {
		reg = <0>;
		#address-cells = <1>;
		#size-cells = <1>;
		compatible = "spi-nand";
		spi-max-frequency = <83000000>;
		spi-tx-bus-width = <4>;
		spi-rx-bus-width = <4>;
	};
};
