// SPDX-License-Identifier: (GPL-2.0+ OR MIT)
/*
 * Copyright 2023,2026 NXP
 */

#include "imx95-clock.h"
#include "imx95-evk-it6263-lvds1-common.dtsi"

&ldb {
	assigned-clocks = <&scmi_clk IMX95_CLK_LDBPLL_VCO>,
			  <&scmi_clk IMX95_CLK_LDBPLL>;
	assigned-clock-rates = <4158000000>, <1039500000>;
};
