// SPDX-License-Identifier: (GPL-2.0-only OR MIT)
/*
 * Copyright 2026 NXP
 */

#include "imx952.dtsi"

&dpu {
	compatible = "nxp,imx937-dpu";
	interrupts = <448>, <449>, <450>,  <64>,
		      <65>,  <66>,  <67>,  <68>,
		      <69>, <192>, <193>, <194>,
		     <195>, <196>, <197>,  <70>,
		      <71>,  <72>,  <73>,  <74>,
		      <75>,  <76>,  <77>,  <78>,
		      <79>,  <80>,  <81>,  <82>,
		      <83>,  <84>,  <85>,  <86>,
		     <198>, <199>, <200>, <201>,
		     <202>, <203>, <204>, <205>,
		     <206>, <207>, <208>, <209>,
		     <210>, <211>, <212>, <213>,
		     <214>, <451>,   <1>,   <2>,
		       <3>,   <4>,  <90>,  <91>,
		      <92>,  <93>,  <94>,  <95>,
		      <96>,  <97>,  <98>,  <99>,
		     <100>, <101>, <102>, <103>,
		     <215>, <216>, <217>, <218>,
		     <219>, <220>, <221>, <222>,
		     <223>, <224>, <225>, <226>,
		     <227>, <228>;
	interrupt-names = "store9_shdload",
			  "store9_framecomplete",
			  "store9_seqcomplete",
			  "extdst0_shdload",
			  "extdst0_framecomplete",
			  "extdst0_seqcomplete",
			  "extdst4_shdload",
			  "extdst4_framecomplete",
			  "extdst4_seqcomplete",
			  "extdst1_shdload",
			  "extdst1_framecomplete",
			  "extdst1_seqcomplete",
			  "extdst5_shdload",
			  "extdst5_framecomplete",
			  "extdst5_seqcomplete",
			  "domainblend0_shdload",
			  "domainblend0_framecomplete",
			  "disengcfg_shdload0",
			  "disengcfg_framecomplete0",
			  "disengcfg_seqcomplete0",
			  "framegen0_int0",
			  "framegen0_int1",
			  "framegen0_int2",
			  "framegen0_int3",
			  "sig0_shdload",
			  "sig0_valid",
			  "sig0_error",
			  "sig0_cluster_error",
			  "sig0_cluster_match",
			  "idhash0_shdload",
			  "idhash0_valid",
			  "idhash0_window_error",
			  "domainblend1_shdload",
			  "domainblend1_framecomplete",
			  "disengcfg_shdload1",
			  "disengcfg_framecomplete1",
			  "disengcfg_seqcomplete1",
			  "framegen1_int0",
			  "framegen1_int1",
			  "framegen1_int2",
			  "framegen1_int3",
			  "sig1_shdload",
			  "sig1_valid",
			  "sig1_error",
			  "sig1_cluster_error",
			  "sig1_cluster_match",
			  "idhash1_shdload",
			  "idhash1_valid",
			  "idhash1_window_error",
			  "cmdseq_error",
			  "comctrl_sw0",
			  "comctrl_sw1",
			  "comctrl_sw2",
			  "comctrl_sw3",
			  "framegen0_primsync_on",
			  "framegen0_primsync_off",
			  "framegen0_overflow0_on",
			  "framegen0_overflow0_off",
			  "framegen0_underrun0_on",
			  "framegen0_underrun0_off",
			  "framegen0_threshold0_rise",
			  "framegen0_threshold0_fail",
			  "framegen0_overflow1_on",
			  "framegen0_overflow1_off",
			  "framegen0_underrun1_on",
			  "framegen0_underrun1_off",
			  "framegen0_threshold1_rise",
			  "framegen0_threshold1_fail",
			  "framegen1_primsync_on",
			  "framegen1_primsync_off",
			  "framegen1_overflow0_on",
			  "framegen1_overflow0_off",
			  "framegen1_underrun0_on",
			  "framegen1_underrun0_off",
			  "framegen1_threshold0_rise",
			  "framegen1_threshold0_fail",
			  "framegen1_overflow1_on",
			  "framegen1_overflow1_off",
			  "framegen1_underrun1_on",
			  "framegen1_underrun1_off",
			  "framegen1_threshold1_rise",
			  "framegen1_threshold1_fail";
};

&gpu_opp_table {
	/delete-node/ opp-1000000000;
};
