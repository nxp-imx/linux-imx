// SPDX-License-Identifier: (GPL-2.0+ OR MIT)
/*
 * Copyright 2026 NXP
 */

/dts-v1/;
/plugin/;

#include <dt-bindings/clock/nxp,imx952-clock.h>
#include <dt-bindings/gpio/gpio.h>
#include "imx952-pinfunc.h"

&vehicle_core {
	status = "okay";
};
