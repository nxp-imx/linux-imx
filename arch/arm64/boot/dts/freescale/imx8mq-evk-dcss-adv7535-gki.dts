#include "imx8mq-evk-dcss-adv7535.dts"

/ {
  interrupt-parent = <&gic>;
};

&gpc {
   /delete-property/ interrupts;
   /delete-property/ interrupt-parent;
   /delete-property/ interrupt-controller;
   /delete-property/ broken-wake-request-signals;
   /delete-property/ #interrupt-cells;
};
