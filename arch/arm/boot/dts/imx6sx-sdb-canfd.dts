/*
 * Copyright (C) 2014 Freescale Semiconductor, Inc.
 *
 * This program is free software; you can redistribute it and/or modify
 * it under the terms of the GNU General Public License version 2 as
 * published by the Free Software Foundation.
 */

#include "imx6sx-sdb.dts"

/*
 * flexcan and canfd are sharing the same pads, so disable flexcan to
 * enable canfd.
 * There's a trick here that the tranceiver configuration gpios are still
 * got from the flexcan node since they're using the same tranceiver.
 */
&flexcan1 {
	status = "disabled";
};

&flexcan2 {
	status = "disabled";
};

&canfd1 {
	pinctrl-names = "default";
	pinctrl-0 = <&pinctrl_canfd1_1>;
	status = "okay";
};

&canfd2 {
	pinctrl-names = "default";
	pinctrl-0 = <&pinctrl_canfd2_1>;
	status = "okay";
};
