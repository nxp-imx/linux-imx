/*
 * Copyright (C) 2014 Freescale Semiconductor, Inc.
 *
 * This program is free software; you can redistribute it and/or modify
 * it under the terms of the GNU General Public License version 2 as
 * published by the Free Software Foundation.
 */

#include "imx6sx-17x17-arm2.dts"

&mlb {
	status = "okay";
};

&usdhc2 {
	/* pin conflict with mlb */
	status = "disabled";
};
