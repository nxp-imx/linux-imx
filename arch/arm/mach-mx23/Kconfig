## arch/arm/mach-mx23/Kconfig
```kconfig
choice
	prompt "Select i.MXS board type"

config MACH_MX23EVK
	bool "Freescale MX23 EVK board"
	depends on ARCH_MX23
	select USB_ARCH_HAS_EHCI

endchoice


config MXS_UNIQUE_ID
	bool "Support for UniqueID on boot media"
	default y

config MXS_UNIQUE_ID_OTP
	bool "UniqueID on OTP"
	depends on MXS_UNIQUE_ID
	default y

config VECTORS_PHY_ADDR
	int "vectors address"
	default 0
	help
	  This config set vectors table is located which physical address
```

## arch/arm/mach-mx25/Kconfig
```kconfig
if ARCH_MX25

comment "MX25 platforms:"

config MACH_MX25_3DS
	bool "Support MX25PDK (3DS) Platform"

menu "MX25 Options"

config MX25_OPTIONS
	bool
	default y
	select CPU_ARM926T
	select USB_ARCH_HAS_EHCI

config MX25_DOZE_DURING_IDLE
	bool "Enter Doze mode during idle"
	help
	  Turning on this option will put the CPU into Doze mode during idle.
	  The default is to enter Wait mode during idle. Doze mode during
	  idle will save additional power over Wait mode.

config MXC_SDMA_API
        bool "Use SDMA API"
        default y
        help
           This selects the Freescale MXC SDMA API.
           If unsure, say N.

config SDMA_IRAM
	bool "Use Internal RAM for SDMA transfer"
	depends on MXC_SDMA_API
	help
	  Support Internal RAM as SDMA buffer or control structures

config ARCH_MXC_HAS_NFC_V2
        bool "MXC NFC Hardware Version 2"
        depends on ARCH_MX25
        default y
        help
           This selects the Freescale MXC Nand Flash Controller Hardware Version 2
           If unsure, say N.

config ARCH_MXC_HAS_NFC_V2_1
        bool "MXC NFC Hardware Version 2.1"
        depends on ARCH_MXC_HAS_NFC_V2
        default y
        help
           This selects the Freescale MXC Nand Flash Controller Hardware Version 2.1
           If unsure, say N.

menu "Device options"

config I2C_MXC_SELECT1
	bool "Enable I2C1 module"
	default y
	depends on I2C_MXC
	help
	  Enable MX25 I2C1 module.

config I2C_MXC_SELECT2
	bool "Enable I2C2 module"
	default n
	depends on I2C_MXC
	help
	  Enable MX25 I2C2 module.

config I2C_MXC_SELECT3
	bool "Enable I2C3 module"
	default n
	depends on I2C_MXC
	help
	  Enable MX25 I2C3 module.

config FLEXCAN_MXC_SELECT1
	bool "Enable FlexCAN1 module"
	depends on CAN_FLEXCAN
	help
	  Enable MX25 FlexCAN1 module.

endmenu
endmenu
endif
```

## arch/arm/mach-mx27/Kconfig
```kconfig
menu "MX27 Options"
	depends on ARCH_MX27

config MX27_OPTIONS
	bool
	default y
	select CPU_ARM926T
	select MXC_EMMA
	select USB_ARCH_HAS_EHCI

config MACH_MX27ADS
	bool "Support MX27ADS platforms"
	default y
	help
	  Include support for MX27ADS platform. This includes specific
	  configurations for the board and its peripherals.

config ARCH_MXC_HAS_NFC_V1
        bool "MXC NFC Hardware Version 1"
        default y
        help
           This selects the Freescale MXC Nand Flash Controller Hardware Version 1
           If unsure, say N.

menu "Device options"

config I2C_MXC_SELECT1
	bool "Enable I2C1 module"
	default y
	depends on I2C_MXC
	help
	  Enable MX31 I2C1 module.

config I2C_MXC_SELECT2
	bool "Enable I2C2 module"
	default n
	depends on I2C_MXC
	help
	  Enable MX31 I2C2 module.

endmenu

endmenu
```

## arch/arm/mach-mx28/Kconfig
```kconfig
choice
	prompt "Select i.MXS board type"

config MACH_MX28EVK
	bool "Freescale MX28 EVK board"
	depends on ARCH_MX28
	select USB_ARCH_HAS_EHCI

endchoice

config VECTORS_PHY_ADDR
	int "vectors address"
	default 0
	help
	  This config set vectors table is located which physical address

config MXS_TIMER_WITH_MACH
	bool "System Timer support Compare Match interrupt"
	default y

config MEM_mDDR
	bool "Memory type is mDDR"
	depends on ARCH_MX28
	help
	  Say Y to select mDDR memory

config MX28_SUSPEND_TO_RAM
	bool "support MX28 suspend-to RAM feature"
  default n
	depends on ARCH_MX28
	help
	  Say Y to enable suspend-to-RAM

config WORKAROUND_ARCUSB_REG_RW
        bool "work around mx28 arch register write for USB"
        help
           MX28 require read ARC register before write. Use SWP intructure to
           implement this requirement.
```

## arch/arm/mach-mx3/Kconfig
```kconfig
if ARCH_MX3

config ARCH_MX31
	select ARCH_HAS_RNGA
	bool

config MX3_OPTIONS
	bool
	default y
	select CPU_V6
	select ARM_ERRATA_364296
	select ARM_ERRATA_411920
	select CACHE_L2X0
	select OUTER_CACHE
	select USB_ARCH_HAS_EHCI
	select ARCH_HAS_EVTMON
	select ARCH_HAS_RNGA

comment "MX3 platforms:"

config MACH_MX31ADS
	bool "Support MX31ADS platforms"
	select ARCH_MX31
	default y
	help
	  Include support for MX31ADS platform. This includes specific
	  configurations for the board and its peripherals.

config MACH_MX31ADS_WM1133_EV1
	bool "Support Wolfson Microelectronics 1133-EV1 module"
	depends on MACH_MX31ADS
	depends on MFD_WM8350_I2C
	depends on REGULATOR_WM8350
	select MFD_WM8350_CONFIG_MODE_0
	select MFD_WM8352_CONFIG_MODE_0
	help
	  Include support for the Wolfson Microelectronics 1133-EV1 PMU
	  and audio module for the MX31ADS platform.

config MACH_PCM037
	bool "Support Phytec pcm037 (i.MX31) platforms"
	select ARCH_MX31
	help
	  Include support for Phytec pcm037 platform. This includes
	  specific configurations for the board and its peripherals.

config MACH_PCM037_EET
	bool "Support pcm037 EET board extensions"
	depends on MACH_PCM037
	help
	  Add support for PCM037 EET baseboard extensions. If you are using the
	  OLED display with EET, use "video=mx3fb:CMEL-OLED" kernel
	  command-line parameter.

config MACH_MX31LITE
	bool "Support MX31 LITEKIT (LogicPD)"
	select ARCH_MX31
	help
	  Include support for MX31 LITEKIT platform. This includes specific
	  configurations for the board and its peripherals.

config MACH_MX31_3DS
	bool "Support MX31PDK (3DS)"
	select ARCH_MX31
	help
	  Include support for MX31PDK (3DS) platform. This includes specific
	  configurations for the board and its peripherals.

config MACH_MX31MOBOARD
	bool "Support mx31moboard platforms (EPFL Mobots group)"
	select ARCH_MX31
	help
	  Include support for mx31moboard platform. This includes specific
	  configurations for the board and its peripherals.

config MACH_MX31LILLY
	bool "Support MX31 LILLY-1131 platforms (INCO startec)"
	select ARCH_MX31
	help
	  Include support for mx31 based LILLY1131 modules. This includes
	  specific configurations for the board and its peripherals.

config MACH_QONG
	bool "Support Dave/DENX QongEVB-LITE platform"
	select ARCH_MX31
	help
	  Include support for Dave/DENX QongEVB-LITE platform. This includes
	  specific configurations for the board and its peripherals.

config MACH_PCM043
	bool "Support Phytec pcm043 (i.MX35) platforms"
#	select ARCH_MX35
	help
	  Include support for Phytec pcm043 platform. This includes
	  specific configurations for the board and its peripherals.

config MACH_ARMADILLO5X0
	bool "Support Atmark Armadillo-500 Development Base Board"
	select ARCH_MX31
	help
	  Include support for Atmark Armadillo-500 platform. This includes
	  specific configurations for the board and its peripherals.
	  Include support for Phytec pcm043 platform. This includes
	  specific configurations for the board and its peripherals.

config MXC_SDMA_API
        bool "Use SDMA API"
        default y
        help
           This selects the Freescale MXC SDMA API.
           If unsure, say N.

menu "SDMA options"
        depends on MXC_SDMA_API

config SDMA_IRAM
        bool "Use Internal RAM for SDMA transfer"
        default n
	help
           Support Internal RAM as SDMA buffer or control structures

config SDMA_IRAM_SIZE
        hex "Reserved bytes of IRAM for SDMA (0x800-0x2000)"
        range 0x800 0x2000
        depends on SDMA_IRAM
        default "0x1000"
        help
           Set the size of IRAM for SDMA. It must be multiple of 512bytes.
endmenu

config ARCH_MXC_HAS_NFC_V1
        bool "MXC NFC Hardware Version 1"
	depends on !(MACH_MX31ADS && XIP_KERNEL)
        default y
        help
           This selects the Freescale MXC Nand Flash Controller Hardware Version 1
           If unsure, say N.

config ARCH_MXC_HAS_NFC_V2
        bool "MXC NFC Hardware Version 2"
	depends on !(MACH_MX31ADS && XIP_KERNEL)
        default y
        help
           This selects the Freescale MXC Nand Flash Controller Hardware Version 2
           If unsure, say N.

menu "Device options"

config I2C_MXC_SELECT1
	bool "Enable I2C1 module"
	default y
	depends on I2C_MXC
	help
	  Enable MX31 I2C1 module.

config I2C_MXC_SELECT2
	bool "Enable I2C2 module"
	default n
	depends on I2C_MXC
	help
	  Enable MX31 I2C2 module.

config I2C_MXC_SELECT3
	bool "Enable I2C3 module"
	default n
	depends on I2C_MXC
	help
	  Enable MX31 I2C3 module.

endmenu
endif
```

## arch/arm/mach-mx35/Kconfig
```kconfig
menu "MX35 Options"
	depends on ARCH_MX35

config FORCE_MAX_ZONEORDER
    int "MAX_ORDER"
    default "13"

config MX35_OPTIONS
	bool
	default y
	select CPU_V6
	select ARM_ERRATA_364296
	select ARM_ERRATA_411920
	select CACHE_L2X0
	select OUTER_CACHE
	select USB_ARCH_HAS_EHCI
	select ARCH_HAS_EVTMON
	select ARCH_HAS_RNGC

config MACH_MX35_3DS
	bool "Support MX35 3STACK platforms"
	default y
	select MXC_PSEUDO_IRQS if MXC_PMIC_MC9SDZ60
	help
	  Include support for MX35 3STACK platform. This includes specific
	  configurations for the board and its peripherals.

config MACH_MX35EVB
	bool "Support MX35EVB platforms"
	default n
	help
	  Include support for MX35EVB platform. This includes specific
	  configurations for the board and its peripherals.

config MX35_DOZE_DURING_IDLE
	bool "Enter Doze mode during idle"
	help
	  Turning on this option will put the CPU into Doze mode during idle.
	  The default is to enter Wait mode during idle. Doze mode during
	  idle will save additional power over Wait mode.

config MXC_SDMA_API
        bool "Use SDMA API"
        default y
        help
           This selects the Freescale MXC SDMA API.
           If unsure, say N.

menu "SDMA options"
        depends on MXC_SDMA_API

config SDMA_IRAM
        bool "Use Internal RAM for SDMA transfer"
        default n
       help
           Support Internal RAM as SDMA buffer or control structures

config SDMA_IRAM_SIZE
        hex "Reserved bytes of IRAM for SDMA (0x800-0x1000)"
        range 0x800 0x1000
        depends on SDMA_IRAM
        default "0x1000"
        help
           Set the size of IRAM for SDMA. It must be a multiple of 512bytes.
endmenu

config ARCH_MXC_HAS_NFC_V2
        bool "MXC NFC Hardware Version 2"
        depends on ARCH_MX35
        default y
        help
           This selects the Freescale MXC Nand Flash Controller Hardware Version 3
           If unsure, say N.

config ARCH_MXC_HAS_NFC_V2_1
        bool "MXC NFC Hardware Version 2.1"
        depends on ARCH_MXC_HAS_NFC_V2
        default y
        help
           This selects the Freescale MXC Nand Flash Controller Hardware Version 2.1
           If unsure, say N.

menu "Device options"

config I2C_MXC_SELECT1
	bool "Enable I2C1 module"
	default y
	depends on I2C_MXC
	help
	  Enable MX35 I2C1 module.

config I2C_MXC_SELECT2
	bool "Enable I2C2 module"
	default n
	depends on I2C_MXC
	help
	  Enable MX35 I2C2 module.

config I2C_MXC_SELECT3
	bool "Enable I2C3 module"
	default n
	depends on I2C_MXC
	help
	  Enable MX35 I2C3 module.

endmenu

config MXC_PSEUDO_IRQS
	bool

endmenu
```

## arch/arm/mach-mx5/Kconfig
```kconfig
if ARCH_MX5

config ARCH_MX51
	bool
	select USB_ARCH_HAS_EHCI
	select MXC_TZIC
	select ARCH_MXC_IOMUX_V3

config ARCH_MX53
	bool
	select USB_ARCH_HAS_EHCI
	select MXC_TZIC
	select ARCH_MXC_IOMUX_V3

config ARCH_MX50
	bool
	select ARCH_HAS_RNGC

config FORCE_MAX_ZONEORDER
    int "MAX_ORDER"
    default "13"

config MX5_MULTI_ARCH
	bool
	default y
	select RUNTIME_PHYS_OFFSET
	depends on ARCH_MX51
	depends on ARCH_MX50 || ARCH_MX53

config MACH_MX51_3DS
	bool "Support MX51 3-Stack platform"
	select ARCH_MX51
	help
	  Include support for MX51 3-Stack platform. This includes specific
	  configurations for the board and its peripherals.

config MACH_MX51_BABBAGE
	bool "Support MX51 BABBAGE platforms"
	select ARCH_MX51
	help
	  Include support for MX51 Babbage platform, also known as MX51EVK in
	  u-boot. This includes specific configurations for the board and its
	  peripherals.

config MACH_MX53_EVK
	bool "Support MX53 EVK platform"
	select ARCH_MX53
	help
	  Include support for MX53 EVK platform. This includes specific
	  configurations for the board and its peripherals.

config MACH_MX53_ARD
	bool "Support MX53 ARD platform"
	select ARCH_MX53
	help
	  Include support for MX53 ARD platform. This includes specific
	  configurations for the board and its peripherals.

config MACH_MX50_ARM2
	bool "Support MX50 Armadillo2 platform"
	select ARCH_MX50
	help
	  Include support for MX50 EVK platform. This includes specific
	  configurations for the board and its peripherals.

config MACH_MX50_RDP
	bool "Support MX50 Reference Design Platform"
	select ARCH_MX50
	help
	  Include support for MX50 RDP platform. This includes specific
	  configurations for the board and its peripherals.

comment "MX5x Options:"

config MXC_SDMA_API
        bool "Use SDMA API"
        default y
        help
           This selects the Freescale MXC SDMA API.
           If unsure, say N.

config ARCH_MXC_HAS_NFC_V3
        bool "MXC NFC Hardware Version 3"
        depends on ARCH_MX5
        default y
        help
           This selects the Freescale MXC Nand Flash Controller Hardware Version 3
           If unsure, say N.

config ARCH_MXC_HAS_NFC_V3_2
        bool "MXC NFC Hardware Version 3.2"
        depends on ARCH_MXC_HAS_NFC_V3
        default y
        help
           This selects the Freescale MXC Nand Flash Controller Hardware Version 3.1
           If unsure, say N.

config SDMA_IRAM
	bool "Use Internal RAM for SDMA transfer"
	depends on MXC_SDMA_API
	help
	  Support Internal RAM as SDMA buffer or control structures

endif
```

## arch/arm/mach-mx51/Kconfig
```kconfig
menu "MX51 Options"
	depends on ARCH_MX51

config FORCE_MAX_ZONEORDER
    int "MAX_ORDER"
    default "13"

config MX51_OPTIONS
	bool
	default y
	select CPU_V7
	select USB_ARCH_HAS_EHCI
	select MXC_TZIC

config MACH_MX51_3DS
	bool "Support MX51 3-Stack platforms"
	default y
	help
	  Include support for MX51 3-Stack platform. This includes specific
	  configurations for the board and its peripherals.

config MACH_MX51_BABBAGE
	bool "Support MX51 BABBAGE platforms"
	help
	  Include support for MX51 Babbage platform. This includes specific
	  configurations for the board and its peripherals.

config MXC_SDMA_API
        bool "Use SDMA API"
        default y
        help
           This selects the Freescale MXC SDMA API.
           If unsure, say N.

config ARCH_MXC_HAS_NFC_V3
        bool "MXC NFC Hardware Version 3"
        depends on ARCH_MX51
        default y
        help
           This selects the Freescale MXC Nand Flash Controller Hardware Version 3
           If unsure, say N.

config ARCH_MXC_HAS_NFC_V3_2
        bool "MXC NFC Hardware Version 3.2"
        depends on ARCH_MXC_HAS_NFC_V3
        default y
        help
           This selects the Freescale MXC Nand Flash Controller Hardware Version 3.1
           If unsure, say N.

config SDMA_IRAM
	bool "Use Internal RAM for SDMA transfer"
	depends on MXC_SDMA_API
	help
	  Support Internal RAM as SDMA buffer or control structures

endmenu
```
