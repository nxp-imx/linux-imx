## arch/arm/mach-mx6/Kconfig
```kconfig
if ARCH_MX6

config ARCH_MX6Q
	bool
	select USB_ARCH_HAS_EHCI
	select ARCH_MXC_IOMUX_V3
	select ARM_GIC
	select IMX_HAVE_PLATFORM_IMX_UART
	select IMX_HAVE_PLATFORM_FEC
	select IMX_HAVE_PLATFORM_IMX_ANATOP_THERMAL
	select IMX_HAVE_PLATFORM_IMX_IPUV3
	select IMX_HAVE_PLATFORM_MXC_PWM
	select IMX_HAVE_PLATFORM_LDB

config FORCE_MAX_ZONEORDER
    int "MAX_ORDER"
    default "13"

config	SOC_IMX6Q
	bool

config MACH_MX6Q_SABREAUTO
	bool "Support i.MX 6Quad SABRE Automotive Infotainment platform"
	select ARCH_MX6Q
	select SOC_IMX6Q
	select IMX_HAVE_PLATFORM_IMX_UART
	select IMX_HAVE_PLATFORM_DMA
	select IMX_HAVE_PLATFORM_FEC
	select IMX_HAVE_PLATFORM_GPMI_NFC
	select IMX_HAVE_PLATFORM_SDHCI_ESDHC_IMX
	select IMX_HAVE_PLATFORM_SPI_IMX
	select IMX_HAVE_PLATFORM_IMX_I2C
	select IMX_HAVE_PLATFORM_VIV_GPU
	select IMX_HAVE_PLATFORM_IMX_VPU
	select IMX_HAVE_PLATFORM_IMX_ESAI
	select IMX_HAVE_PLATFORM_IMX_ANATOP_THERMAL
	select IMX_HAVE_PLATFORM_FSL_USB2_UDC
	select IMX_HAVE_PLATFORM_MXC_EHCI
	select IMX_HAVE_PLATFORM_FSL_OTG
	select IMX_HAVE_PLATFORM_FSL_USB_WAKEUP
	select IMX_HAVE_PLATFORM_AHCI
	select IMX_HAVE_PLATFORM_IMX_OCOTP
	select IMX_HAVE_PLATFORM_IMX2_WDT
	select IMX_HAVE_PLATFORM_IMX_SNVS_RTC
	select IMX_HAVE_PLATFORM_IMX_PM
	select IMX_HAVE_PLATFORM_MXC_HDMI
	select IMX_HAVE_PLATFORM_IMX_ASRC
	help
	  Include support for i.MX 6Quad SABRE Automotive Infotainment platform. This includes specific
	  configurations for the board and its peripherals.

comment "MX6 Options:"

config DMA_ZONE_SIZE
        int "DMA memory zone size"
        range 0 184
        default 24
        help
          This is the size in MB for the DMA zone. The DMA zone is used for
          dedicated memory for large contiguous video buffers
endif
```

## arch/arm/mach-stmp378x/Kconfig
```kconfig
if ARCH_STMP378X

config FB_STMP37XX_HX8238A
	depends on ARCH_STMP37XX
	bool "HX8238A"
	---help---
	  Use HX8238A dotclock LCD panel for STMP37XX

config FB_STMP37XX_LMS350
	depends on ARCH_STMP378X
	bool "LMS350"
	---help---
	  Use LMS350 dotclock LCD panel for STMP378X

config FB_STMP37XX_LMS430
	depends on ARCH_STMP378X
	bool "LMS430"
	---help---
	  Use LMS430 dotclock LCD panel for STMP378X

config FB_STMP378X_TVENC
	depends on ARCH_STMP378X
	bool "TVENC"
	---help---
	  Use TVOUT encoder for STMP378X

config STMP3XXX_UNIQUE_ID
	bool "Support for UniqueID on boot media"
	default y

config STMP3XXX_UNIQUE_ID_OTP
	bool "UniqueID on OTP"
	depends on STMP3XXX_UNIQUE_ID
	default y

config STMP378X_RAM_FREQ_SCALING
	bool "RAM frequency scaling support"
	depends on ARCH_STMP378X
	default y

choice
	prompt "Select STMP378x RAM chip"
	depends on STMP378X_RAM_FREQ_SCALING

config STMP378X_RAM_MDDR
	bool "mDDR SDRAM"
config STMP378X_RAM_DDR
	bool "DDR SDRAM"

endchoice

config DMA_ZONE_SIZE
	int "DMA memory zone size"
	range 0 32
	default 12
	help
	  This is the size in MB for the DMA zone. The DMA zone is used for
	  dedicated memory for large contiguous video buffers

config VECTORS_PHY_ADDR
	int "vectors address"
	default 0
	help
	  This config set vectors table is located which physical address

# set if we need the UTMI transceiver code
config UTMI_MXC
	bool
	select UTMI_MXC_OTG if USB_GADGET && USB_EHCI_HCD && USB_OTG
	default y if USB_EHCI_FSL_UTMI || USB_GADGET_FSL_UTMI

config UTMI_MXC_OTG
	tristate
	help
	  Support for USB OTG pin detect using the UTMI transceiver on STMP378xxx platforms.

endif
```

## arch/arm/mach-stmp3xxx/Kconfig
```kconfig
if ARCH_STMP3XXX

menu "SigmaTel STMP3xxx implementations"

choice
	prompt "Select STMP3xxx chip family"

config ARCH_STMP37XX
	bool "SigmaTel SMTP37xx"
	---help---
	 STMP37xx refers to 3700 through 3769 chips

config ARCH_STMP378X
	bool "SigmaTel STMP378x"
	---help---
	 STMP378x refers to 3780 through 3789 chips

endchoice

choice
	prompt "Select STMP3xxx board type"

config MACH_STMP37XX
	depends on ARCH_STMP37XX
	bool "SigmaTel STMP37xx development board"

config MACH_STMP378X
	depends on ARCH_STMP378X
	bool "SigmaTel STMP378x development board"

endchoice

endmenu

config FB_STMP37XX_HX8238A
	depends on ARCH_STMP37XX
	bool "HX8238A"
	---help---
	  Use HX8238A dotclock LCD panel for STMP37XX

config FB_STMP37XX_LMS350
	depends on ARCH_STMP378X
	bool "LMS350"
	---help---
	  Use LMS350 dotclock LCD panel for STMP378X

config FB_STMP37XX_LMS430
	depends on ARCH_STMP378X
	bool "LMS430"
	---help---
	  Use LMS430 dotclock LCD panel for STMP378X

config FB_STMP378X_TVENC
	depends on ARCH_STMP378X
	bool "TVENC"
	---help---
	  Use TVOUT encoder for STMP378X

config STMP3XXX_UNIQUE_ID
	bool "Support for UniqueID on boot media"
	default y

config STMP3XXX_UNIQUE_ID_OTP
	bool "UniqueID on OTP"
	depends on STMP3XXX_UNIQUE_ID
	default y

config STMP378X_RAM_FREQ_SCALING
	bool "RAM frequency scaling support"
	depends on ARCH_STMP378X
	default y

choice
	prompt "Select STMP378x RAM chip"
	depends on STMP378X_RAM_FREQ_SCALING

config STMP378X_RAM_MDDR
	bool "mDDR SDRAM"
config STMP378X_RAM_DDR
	bool "DDR SDRAM"

endchoice

endif
```

## arch/arm/plat-mxc/Kconfig
```kconfig
if ARCH_MXC

source "arch/arm/plat-mxc/devices/Kconfig"

menu "Freescale MXC Implementations"

config ARCH_MX50_SUPPORTED
	bool

config ARCH_MX53_SUPPORTED
	bool

choice
	prompt "Freescale CPU family:"
	default ARCH_MX3

config ARCH_MX1
	bool "MX1-based"
	help
	  This enables support for systems based on the Freescale i.MX1 family

config ARCH_MX2
	bool "MX2-based"
	help
	  This enables support for systems based on the Freescale i.MX2 family

config ARCH_MX25
	bool "MX25-based"
	help
	  This enables support for systems based on the Freescale i.MX25 family

config ARCH_MX3
	bool "MX3-based"
	help
	  This enables support for systems based on the Freescale i.MX3 family

config ARCH_MX503
	bool "i.MX50 + i.MX53"
	select ARCH_MX50_SUPPORTED
	select ARCH_MX53_SUPPORTED
	help
	  This enables support for machines using Freescale's i.MX50 and i.MX51
	  processors.

config ARCH_MX51
	bool "i.MX51"
	select ARCH_MX51_SUPPORTED
	help
	  This enables support for systems based on the Freescale i.MX51 family

config ARCH_MX6
	bool "MX6-based"
	select CPU_V7
	help
	  This enable support for systems based on the Freescale i.MX 6 Series family

endchoice

source "arch/arm/mach-imx/Kconfig"
source "arch/arm/mach-mx5/Kconfig"
source "arch/arm/mach-mx6/Kconfig"

endmenu
## Freescale private USB driver support
# set if we need the 1504 transceiver
config ISP1504_MXC
	bool
	default y

# set if we need the UTMI transceiver
config UTMI_MXC
	bool
	default y
	depends on ARCH_MX25 || ARCH_MX35 || ARCH_MX37 || ARCH_MX5

config MXC_IRQ_PRIOR
	bool "Use IRQ priority"
	help
	  Select this if you want to use prioritized IRQ handling.
	  This feature prevents higher priority ISR to be interrupted
	  by lower priority IRQ even IRQF_DISABLED flag is not set.
	  This may be useful in embedded applications, where are strong
	  requirements for timing.
	  Say N here, unless you have a specialized requirement.

config MXC_TZIC
	bool

config MXC_AVIC
	bool

config MXC_PWM
	tristate "Enable PWM driver"
	select HAVE_PWM
	help
	  Enable support for the i.MX PWM controller(s).

config MXC_EPIT
	tristate "Enable EPIT driver"
	select HAVE_EPIT
	help
	  Enable support for the i.MX EPIT controller(s).

config MXC_DEBUG_BOARD
	bool "Enable MXC debug board(for 3-stack)"
	help
	  The debug board is an integral part of the MXC 3-stack(PDK)
	  platforms, it can be attached or removed from the peripheral
	  board. On debug board, several debug devices(ethernet, UART,
	  buttons, LEDs and JTAG) are implemented. Between the MCU and
	  these devices, a CPLD is added as a bridge which performs
	  data/address de-multiplexing and decode, signal level shift,
	  interrupt control and various board functions.

config HAVE_EPIT
	bool

config MXC_REBOOT_MFGMODE
       bool "Enable reboot to MFG mode function"
       help
          Enable this config to perform "reboot download" to enter download mode.

config MXC_REBOOT_ANDROID_CMD
       bool "Enable reboot to android recovery and android fastboot"
       help
           Enable this config to use "reboot fastboot", "reboot recovery" to
	   enter fastboot and recovery mode.

config MXC_USE_EPIT
	bool "Use EPIT instead of GPT"
	depends on HAVE_EPIT
	help
	  Use EPIT as the system timer on systems that have it. Normally you
	  don't have a reason to do so as the EPIT has the same features and
	  uses the same clocks as the GPT. Anyway, on some systems the GPT
	  may be in use for other purposes.

config MXC_ULPI
	bool

config ARCH_HAS_RNGA
	bool

config ARCH_HAS_RNGC
	bool

config IMX_HAVE_IOMUX_V1
	bool

config ARCH_MXC_IOMUX_V3
	bool

config ARCH_MXC_AUDMUX_V1
	bool

config ARCH_MXC_AUDMUX_V2
	bool

config IRAM_ALLOC
	bool
        default y
	select GENERIC_ALLOCATOR

config CLK_DEBUG
	bool "clock debug information export to user space"
	depends on PM_DEBUG && DEBUG_FS
	default n
	help
	  export clk debug information to user space

config DMA_ZONE_SIZE
        int "DMA memory zone size"
        range 0 184
        default 24
        help
          This is the size in MB for the DMA zone. The DMA zone is used for
          dedicated memory for large contiguous video buffers

endif
```

## arch/arm/plat-mxc/devices/Kconfig
```kconfig
config IMX_HAVE_PLATFORM_DMA
	bool

config IMX_HAVE_PLATFORM_MXC_MLB
	bool

config IMX_HAVE_PLATFORM_FEC
	bool
	default y if ARCH_MX25 || SOC_IMX27 || SOC_IMX35 || SOC_IMX51 || SOC_IMX53

config IMX_HAVE_PLATFORM_FLEXCAN
	select HAVE_CAN_FLEXCAN if CAN
	bool

config IMX_HAVE_PLATFORM_FSL_USB2_UDC
	bool

config IMX_HAVE_PLATFORM_GPIO_KEYS
	bool
	default y if SOC_IMX51

config IMX_HAVE_PLATFORM_GPMI_NFC
	bool

config IMX_HAVE_PLATFORM_IMX21_HCD
	bool

config IMX_HAVE_PLATFORM_IMX2_WDT
	bool

config IMX_HAVE_PLATFORM_IMXDI_RTC
	bool

config IMX_HAVE_PLATFORM_IMX_SRTC
	bool

config IMX_HAVE_PLATFORM_IMX_SNVS_RTC
	bool

config IMX_HAVE_PLATFORM_IMX_CAAM
	bool
	default y if SOC_IMX6Q

config IMX_HAVE_PLATFORM_IMX_FB
	bool
	select HAVE_FB_IMX

config IMX_HAVE_PLATFORM_IMX_I2C
	bool

config IMX_HAVE_PLATFORM_IMX_KEYPAD
	bool

config IMX_HAVE_PLATFORM_IMX_SSI
	bool

config IMX_HAVE_PLATFORM_IMX_ESAI
	bool

config IMX_HAVE_PLATFORM_IMX_UART
	bool

config IMX_HAVE_PLATFORM_IMX_UDC
	bool

config IMX_HAVE_PLATFORM_IPU_CORE
	bool

config IMX_HAVE_PLATFORM_MX1_CAMERA
	bool

config IMX_HAVE_PLATFORM_MX2_CAMERA
	bool

config IMX_HAVE_PLATFORM_MXC_EHCI
	bool

config IMX_HAVE_PLATFORM_MXC_MMC
	bool

config IMX_HAVE_PLATFORM_MXC_NAND
	bool

config IMX_HAVE_PLATFORM_MXC_PWM
	bool

config IMX_HAVE_PLATFORM_MXC_EPIT
	bool

config IMX_HAVE_PLATFORM_MXC_RNGA
	bool
	select ARCH_HAS_RNGA

config IMX_HAVE_PLATFORM_MXC_RTC
	bool

config IMX_HAVE_PLATFORM_MXC_W1
	bool

config IMX_HAVE_PLATFORM_SDHCI_ESDHC_IMX
	bool

config IMX_HAVE_PLATFORM_SPI_IMX
	bool

config IMX_HAVE_PLATFORM_IMX_IPUV3
	bool

config IMX_HAVE_PLATFORM_IMX_TVE
	bool

config IMX_HAVE_PLATFORM_IMX_VPU
	bool

config IMX_HAVE_PLATFORM_IMX_DVFS
	bool

config IMX_HAVE_PLATFORM_AHCI
	bool

config IMX_HAVE_PLATFORM_IMX_IIM
	bool

config IMX_HAVE_PLATFORM_MXC_GPU
	bool
config IMX_HAVE_PLATFORM_IMX_OCOTP
	bool

config IMX_HAVE_PLATFORM_IMX_VIIM
	bool

config IMX_HAVE_PLATFORM_IMX_DCP
	bool

config IMX_HAVE_PLATFORM_RANDOM_RNGC
	bool

config IMX_HAVE_PLATFORM_PERFMON
	bool

config IMX_HAVE_PLATFORM_LDB
	bool

config IMX_HAVE_PLATFORM_IMX_PXP
	bool

config IMX_HAVE_PLATFORM_IMX_ELCDIF
	bool

config IMX_HAVE_PLATFORM_IMX_EPDC
	bool

config IMX_HAVE_PLATFORM_IMX_SPDC
	bool

config IMX_HAVE_PLATFORM_IMX_SPDIF
	bool

config IMX_HAVE_PLATFORM_VIV_GPU
    bool

config IMX_HAVE_PLATFORM_MXC_HDMI
	bool

config IMX_HAVE_PLATFORM_IMX_ANATOP_THERMAL
	bool

config IMX_HAVE_PLATFORM_FSL_OTG
	bool

config IMX_HAVE_PLATFORM_FSL_USB_WAKEUP
	bool

config IMX_HAVE_PLATFORM_IMX_PM
	bool

config IMX_HAVE_PLATFORM_IMX_ASRC
	bool

config IMX_HAVE_PLATFORM_IMX_MIPI_DSI
	bool

config IMX_HAVE_PLATFORM_IMX_MIPI_CSI2
	bool

config IMX_HAVE_PLATFORM_IMX_VDOA
	bool

config IMX_HAVE_PLATFORM_IMX_PCIE
	bool

config IMX_HAVE_PLATFORM_IMX_FSL_CSI
	bool
```

## arch/arm/plat-mxs/Kconfig
```kconfig
if ARCH_MXS

menu "Freescale i.MXS implementations"

choice
	prompt "Select i.MXS chip family"

config ARCH_MX28
	bool "Freescale MX28"
	select CPU_ARM926T
	select FIQ
	select ZONE_DMA
	select MXS_ICOLL
	select MXS_DMA_ENGINE
	select MXS_AUART_DMA_SUPPORT
	select ARCH_HAS_CPUFREQ
	---help---
	 Support Freescale MX28 chips

config ARCH_MX23
	bool "Freescale MX23"
	select CPU_ARM926T
	select FIQ
	select ZONE_DMA
	select MXS_ICOLL
	select MXS_DMA_ENGINE
	select MXS_AUART_DMA_SUPPORT
	select ARCH_HAS_CPUFREQ
	---help---
	Support Freescale MX23 chips

endchoice

if ARCH_MX28
source arch/arm/mach-mx28/Kconfig
endif

if ARCH_MX23
source arch/arm/mach-mx23/Kconfig
endif

config DMA_ZONE_SIZE
	int "DMA memory zone size"
	range 0 32
	default 16
	help
	    This is the size in MB for the DMA zone. The DMA zone is used for
	    dedicated memory for large contiguous video buffers
endmenu

config MXS_ICOLL
	bool

config MXS_EARLY_CONSOLE
	bool "Enable console early"
	default y
	help
	  Enable console early for kernel debug.

config MXS_DMA_ENGINE
	bool "Enable DMA ENGINE support"
	default y
	help
	  Support DMA controller on AHB-APBH and AHB-APBX Bridge

config MXS_LRADC
	bool "Low Resolution ADC support"
	default y
	depends on ARCH_MXS
	help
	  Enable LRADC support

config MXS_PWM_CHANNELS
	int
	default 8
	help
	  The number of pwm channel on Freescale MXS platform.

menu "Freescale Application UART:"

config MXS_AUART_DMA_SUPPORT
	bool
	depends on MXS_DMA_ENGINE
	default y

config MXS_AUART_PORTS
	int
	default 5

config MXS_AUART0_DEVICE_ENABLE
	bool "Application uart 0 enabled"
	default y
	help
	  Enable applicatoin uart 0

config MXS_AUART0_DMA_ENABLE
	bool "Set application uart 0 to dma mode"
	default n
	depends on MXS_AUART_DMA_SUPPORT
	help
	  Set application uart 0 to dma mode

config MXS_AUART1_DEVICE_ENABLE
	bool "Application uart 1 enabled"
	default y
	help
	  Enable applicatoin uart 1

config MXS_AUART1_DMA_ENABLE
	bool "Set application uart 1 to dma mode"
	default n
	depends on MXS_AUART_DMA_SUPPORT
	help
	  Set application uart 1 to dma mode

config MXS_AUART2_DEVICE_ENABLE
	bool "Application uart 2 enabled"
	default y
	help
	  Enable applicatoin uart 2

config MXS_AUART2_DMA_ENABLE
	bool "Set application uart 2 to dma mode"
	default n
	depends on MXS_AUART_DMA_SUPPORT
	help
	  Set application uart 2 to dma mode

config MXS_AUART3_DEVICE_ENABLE
	bool "Application uart 3 enabled"
	default y
	help
	  Enable applicatoin uart 3

config MXS_AUART3_DMA_ENABLE
	bool "Set application uart 3 to dma mode"
	default n
	depends on MXS_AUART_DMA_SUPPORT
	help
	  Set application uart 3 to dma mode

config MXS_AUART4_DEVICE_ENABLE
	bool "Application uart 4 enabled"
	default y
	help
	  Enable applicatoin uart 4

config MXS_AUART4_DMA_ENABLE
	bool "Set application uart 4 to dma mode"
	default n
	depends on MXS_AUART_DMA_SUPPORT
	help
	  Set application uart 4 to dma mode

config MXS_RAM_FREQ_SCALING
        bool "RAM frequency scaling support"
        depends on ARCH_MXS
        default y

choice
	prompt "Select MXS RAM chip"
	depends on MXS_RAM_FREQ_SCALING

config MXS_RAM_MDDR
	bool "mDDR SDRAM"
	depends on ARCH_MX23
config MXS_RAM_DDR
	bool "DDR SDRAM"
	depends on ARCH_MX23

endchoice

config IRAM_ALLOC
        bool
        default y
        select GENERIC_ALLOCATOR
endmenu

endif
```
