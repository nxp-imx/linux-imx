## drivers/char/imx_mcc/Kconfig
```kconfig
#
# imx mcc
#

config IMX_SEMA4
	bool "IMX SEMA4 driver"
	depends on SOC_IMX6SX
	help
	  Support for IMX SEMA4 driver, most people should say N here.

config IMX_MCC_TEST
	bool "IMX MCC test driver"
	depends on SOC_IMX6SX && IMX_SEMA4
	default y
	help
	  If you say Y here, you will get support for IMX MCC ping pong
	  test and CAN test. Say N here, if the IMX_MCC_TTY interface is
	  mandatory required.

	  If unsure, it is safe to say Y.

config IMX_MCC_TTY
	bool "IMX PTY for MCC interface"
	depends on SOC_IMX6SX && IMX_SEMA4 && !IMX_MCC_TEST
	help
	  This enables a PTY node for IMX6SX MCC, used as interface
	  between kernel space and user space. Say N here, if the
	  interface is not required.

#end imx mcc
```

## drivers/clk/imx/Kconfig
```kconfig
# SPDX-License-Identifier: GPL-2.0
# common clock support for NXP i.MX SoC family.
config MXC_CLK
	tristate "IMX clock"
	depends on ARCH_MXC

config MXC_CLK_SCU
	bool
	depends on IMX_SCU

config CLK_IMX8MM
	tristate "IMX8MM CCM Clock Driver"
	depends on ARCH_MXC && ARM64
	select MXC_CLK
	help
	    Build the driver for i.MX8MM CCM Clock Driver

config CLK_IMX8MN
	tristate "IMX8MN CCM Clock Driver"
	depends on ARCH_MXC && ARM64
	select MXC_CLK
	help
	    Build the driver for i.MX8MN CCM Clock Driver

config CLK_IMX8MP
	tristate "IMX8MP CCM Clock Driver"
	depends on ARCH_MXC && ARM64
	select MXC_CLK
	help
	    Build the driver for i.MX8MP CCM Clock Driver

config CLK_IMX8MQ
	tristate "IMX8MQ CCM Clock Driver"
	depends on ARCH_MXC && ARM64
	select MXC_CLK
	help
	    Build the driver for i.MX8MQ CCM Clock Driver

config CLK_IMX8QXP
	tristate "IMX8QXP SCU Clock"
	depends on ARCH_MXC && IMX_SCU && ARM64
	select MXC_CLK_SCU
	select MXC_CLK
	help
	  Build the driver for IMX8QXP SCU based clocks.
```

## drivers/gpu/drm/Kconfig
```kconfig
#
# Drm device configuration
#
# This driver provides support for the
# Direct Rendering Infrastructure (DRI) in XFree86 4.1.0 and higher.
#
menuconfig DRM
	tristate "Direct Rendering Manager (XFree86 4.1.0 and higher DRI support)"
	select I2C
	select I2C_ALGOBIT
	select SLOW_WORK
	help
	  Kernel-level support for the Direct Rendering Infrastructure (DRI)
	  introduced in XFree86 4.0. If you say Y here, you need to select
	  the module that's right for your graphics card from the list below.
	  These modules provide support for synchronization, security, and
	  DMA transfers. Please see <http://dri.sourceforge.net/> for more
	  details.  You should also select and configure AGP
	  (/dev/agpgart) support if it is available for your platform.

config DRM_KMS_HELPER
	tristate
	depends on DRM
	select FB
	select FRAMEBUFFER_CONSOLE if !EXPERT
	help
	  FB and CRTC helpers for KMS drivers.

config DRM_TTM
	tristate
	depends on DRM
	help
	  GPU memory management subsystem for devices with multiple
	  GPU memory types. Will be enabled automatically if a device driver
	  uses it.

config DRM_VIVANTE
	tristate "Vivante GCCore"
	depends on DRM
	help
	  Choose this option if you have a Vivante graphics card.
          If M is selected, the module will be called vivante.
```

## drivers/gpu/drm/imx/Kconfig
```kconfig
# SPDX-License-Identifier: GPL-2.0-only
config DRM_IMX
	tristate "DRM Support for Freescale i.MX"
	select DRM_KMS_HELPER
	select VIDEOMODE_HELPERS
	select DRM_GEM_CMA_HELPER
	select DRM_KMS_CMA_HELPER
	depends on DRM && (ARCH_MXC || ARCH_MULTIPLATFORM || COMPILE_TEST)
	depends on IMX_IPUV3_CORE || IMX_DPU_CORE || IMX_LCDIF_CORE
	help
	  enable i.MX graphics support

config DRM_IMX_LCDIF_MUX_DISPLAY
	tristate "Support for LCDIF mux displays"
	select DRM_PANEL_BRIDGE
	depends on DRM_IMX && OF && MFD_SYSCON

config DRM_IMX_PARALLEL_DISPLAY
	tristate "Support for parallel displays"
	select DRM_PANEL
	depends on DRM_IMX
	select VIDEOMODE_HELPERS

config DRM_IMX_TVE
	tristate "Support for TV and VGA displays"
	depends on DRM_IMX
	depends on COMMON_CLK
	select REGMAP_MMIO
	help
	  Choose this to enable the internal Television Encoder (TVe)
	  found on i.MX53 processors.

config DRM_IMX_LDB
	tristate "Support for i.MX6 LVDS displays"
	depends on DRM_IMX && DRM_FSL_IMX_LVDS_BRIDGE
	help
	  Choose this to enable the internal LVDS Display Bridge (LDB)
	  found on i.MX53 and i.MX6 processors.

config DRM_IMX8QM_LDB
	tristate "Support for i.MX8qm LVDS displays"
	depends on DRM_IMX && DRM_FSL_IMX_LVDS_BRIDGE
	depends on PHY_MIXEL_LVDS
	help
	  Choose this to enable the internal LVDS Display Bridge (LDB)
	  found on i.MX8qm processors.

config DRM_IMX8QXP_LDB
	tristate "Support for i.MX8qxp LVDS displays"
	depends on DRM_IMX && DRM_FSL_IMX_LVDS_BRIDGE
	depends on PHY_MIXEL_LVDS_COMBO
	help
	  Choose this to enable the internal LVDS Display Bridge (LDB)
	  found on i.MX8qxp processors.

config DRM_IMX8MP_LDB
	tristate "Support for i.MX8mp LVDS displays"
	depends on DRM_IMX && DRM_FSL_IMX_LVDS_BRIDGE
	depends on PHY_FSL_IMX8MP_LVDS
	help
	  Choose this to enable the internal LVDS Display Bridge (LDB)
	  found on i.MX8mp processors.

config DRM_IMX_IPUV3
	tristate
	depends on DRM_IMX
	depends on IMX_IPUV3_CORE
	default y if DRM_IMX=y
	default m if DRM_IMX=m

config IMX8MP_HDMI_PAVI
	tristate "NXP i.MX8MP HDMI Audio Video (PVI/PAI)"
	help
	  Choose this if you want to use HDMI PAI/PVI on i.MX8MP.

config DRM_IMX_HDMI
	tristate "Freescale i.MX DRM HDMI"
	select DRM_DW_HDMI
	select IMX8MP_HDMI_PAVI
	depends on DRM_IMX
	help
	  Choose this if you want to use HDMI on i.MX6/i.MX8.

config DRM_IMX_SEC_DSIM
	tristate "Support for Samsung MIPI DSIM displays"
	depends on DRM_IMX
	select MFD_SYSCON
	select DRM_SEC_MIPI_DSIM
	help
	  Choose this to enable the internal SEC MIPI DSIM controller
	  found on i.MX platform.

source "drivers/gpu/drm/imx/dcnano/Kconfig"
source "drivers/gpu/drm/imx/dpu/Kconfig"
source "drivers/gpu/drm/imx/dcss/Kconfig"
source "drivers/gpu/drm/imx/mhdp/Kconfig"
source "drivers/gpu/drm/imx/ipuv3/Kconfig"
source "drivers/gpu/drm/imx/lcdif/Kconfig"
source "drivers/gpu/drm/imx/lcdifv3/Kconfig"
```

## drivers/gpu/drm/imx/dcif/Kconfig
```kconfig
config DRM_IMX_DCIF
	tristate "DRM support for NXP i.MX943 DCIF"
	select DRM_KMS_HELPER
	select VIDEOMODE_HELPERS
	select DRM_GEM_DMA_HELPER
	select DRM_DISPLAY_HELPER
	select DRM_BRIDGE_CONNECTOR
	depends on DRM && OF && ARCH_MXC
	depends on COMMON_CLK
	help
	  enable NXP i.MX943 Display Control Interface(DCIF) support
```
