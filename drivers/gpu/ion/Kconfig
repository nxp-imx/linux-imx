## drivers/gpu/ion/Kconfig
```kconfig
menuconfig ION
	tristate "Ion Memory Manager"
	select GENERIC_ALLOCATOR
	help
	  Chose this option to enable the ION Memory Manager.

config ION_MXC
	tristate "Ion for MXC"
	depends on ARCH_MXC && ION
	help
	  Choose this option if you wish to use ion on an Freescale MXC.

config ION_TEGRA
	tristate "Ion for Tegra"
	depends on ARCH_TEGRA && ION
	help
	  Choose this option if you wish to use ion on an nVidia Tegra.
```

## drivers/i2c-slave/Kconfig
```kconfig
#
# I2C slave subsystem configuration
#

menuconfig I2C_SLAVE
	bool "I2C Slave support"
	depends on HAS_IOMEM
	---help---
	  I2C (pronounce: I-square-C) is a slow serial bus protocol used in
	  many micro controller applications and developed by Philips.

	  If you want I2C Slave support, you should say Y here.

	  This I2C Slave support can also be built as a module.  If so, the module
	  will be called i2c-slave.

if I2C_SLAVE

config I2C_SLAVE_CORE
	tristate "I2C SLAVE CORE"
	default y
	---help---
		i2c slave core.

config MXC_I2C_SLAVE
	tristate "MXC I2C SLAVE"
	depends on I2C_SLAVE_CORE
	default y
	---help---
		mxc i2c slave support.

config I2C_SLAVE_CLIENT
	tristate "I2C SLAVE CLIENT"
	default y
	---help---
		i2c slave client that used when the master is on the same board.
		this is for i2c master which is on the same board with the slave.

endif # I2C_SLAVE
```

## drivers/media/platform/mxc/capture/Kconfig
```kconfig
config VIDEO_MXC_CSI_CAMERA
	tristate "CSI camera support"
	depends on VIDEO_MXC_CAPTURE && VIDEO_V4L2
	---help---
	  This is the video4linux2 capture driver based on CSI module.

config MXC_CAMERA_OV5640
        tristate "OmniVision ov5640 camera support"
        depends on !VIDEO_MXC_EMMA_CAMERA && I2C
        ---help---
          If you plan to use the ov5640 Camera with your MXC system, say Y here.
```

## drivers/media/platform/mxc/subdev/Kconfig
```kconfig
if VIDEO_MXC_CAPTURE

config VIDEO_MXC_CSI_CAMERA
	tristate "CSI camera support"
	depends on VIDEO_MXC_CAPTURE && VIDEO_V4L2
	---help---
	  This is the video4linux2 capture driver based on CSI module.

config MXC_CAMERA_OV5640
        tristate "OmniVision ov5640 camera support"
        depends on VIDEO_MXC_CAPTURE && I2C
        ---help---
          If you plan to use the ov5640 Camera with your MXC system, say Y here.

config MXC_VADC
	tristate "mxc VADC support"
	depends on VIDEO_MXC_CAPTURE && VIDEO_V4L2
	---help---
		If you plan to use the VADC with your MXC system, say Y here.

endif
```

## drivers/media/platform/nxp/Kconfig
```kconfig
# SPDX-License-Identifier: GPL-2.0-only

# V4L drivers

comment "NXP media platform drivers"

# mem2mem drivers

source "drivers/media/platform/nxp/imx-jpeg/Kconfig"
```

## drivers/media/platform/nxp/hdmirx/Kconfig
```kconfig
config VIDEO_MHDP_HDMIRX
	tristate "Cadence MHDP HDMIRX Controller"
	help
	  Driver for the Cadence HDMI receiver interface. This device
	  is found in the i.MX8QM SoCs. Select this config to enable
	  the HDMI RX capture driver.


config VIDEO_MHDP_HDMIRX_CEC
	tristate "Cadence MHDP HDMIRX CEC"
	select DRM_CDNS_HDMI_CEC
	help
	  Driver for the Cadence HDMI receiver CEC protocol. This device
	  is found in the i.MX8QM SoCs. Select this config to enable
	  the HDMI RX CEC driver.
```

## drivers/media/radio/stfm1000/Kconfig
```kconfig
config RADIO_STFM1000
	tristate "STFM1000 support"
	depends on I2C && VIDEO_V4L2 && ARCH_STMP3XXX
	select I2C_ALGOBIT
	---help---
	  Choose Y here if you have this FM radio card, and then fill in the
	  port address below.

	  In order to control your radio card, you will need to use programs
	  that are compatible with the Video For Linux API.  Information on
	  this API and pointers to "v4l" programs may be found at
	  <file:Documentation/video4linux/API.html>.

	  To compile this driver as a module, choose M here: the
	  module will be called stfm1000.

config RADIO_STFM1000_ALSA
	tristate "STFM1000 audio support"
	depends on RADIO_STFM1000 && SND
	select SND_PCM
	---help---
	  This is a video4linux driver for direct (DMA) audio in
	  STFM1000 using ALSA

	  To compile this driver as a module, choose M here: the
	  module will be called stfm1000-alsa.
```

## drivers/media/video/mxc/capture/Kconfig
```kconfig
if VIDEO_MXC_CAMERA

menu "MXC Camera/V4L2 PRP Features support"
config VIDEO_MXC_IPU_CAMERA
	bool
	depends on VIDEO_MXC_CAMERA && MXC_IPU
	default y

config VIDEO_MXC_EMMA_CAMERA
	tristate "MX27 eMMA support"
	depends on VIDEO_MXC_CAMERA && MXC_EMMA && FB_MXC_SYNC_PANEL
	select VIDEO_MXC_OPL
	default y

config VIDEO_MXC_CSI_CAMERA
	tristate "CSI camera support"
	depends on !VIDEO_MXC_EMMA_CAMERA

config VIDEO_MXC_CSI_DMA
	bool "CSI-DMA Still Image Capture support"
	depends on VIDEO_MXC_EMMA_CAMERA
	default n
	---help---
	  Use CSI-DMA method instead of CSI-PrP link to capture still image. This allows
	  to use less physical contiguous memory to capture big resolution still image. But
	  with this method the CSC (Color Space Conversion) and resize are not supported.
	  If unsure, say N.

config MXC_CAMERA_MC521DA
	tristate "Magnachip mc521da camera support"
	select I2C_MXC
	depends on VIDEO_MXC_EMMA_CAMERA
	select MXC_CAMERA_SENSOR_CLK
	---help---
	  If you plan to use the mc521da Camera with your MXC system, say Y here.

config MXC_EMMA_CAMERA_MICRON111
	tristate "Micron mt9v111 camera support with eMMA"
	select I2C_MXC
	depends on VIDEO_MXC_EMMA_CAMERA
	select MXC_CAMERA_SENSOR_CLK
	---help---
	  If you plan to use the mt9v111 Camera with your MXC system, say Y here.

config MXC_CAMERA_OV2640_EMMA
	tristate "OmniVision ov2640 camera support with eMMA"
	depends on VIDEO_MXC_EMMA_CAMERA
	select MXC_CAMERA_SENSOR_CLK
	---help---
	  If you plan to use the ov2640 Camera with your MXC system, say Y here.

config MXC_CAMERA_MICRON111
	tristate "Micron mt9v111 camera support"
	select I2C_MXC
	depends on ! VIDEO_MXC_EMMA_CAMERA
	select MXC_CAMERA_SENSOR_CLK
	---help---
	  If you plan to use the mt9v111 Camera with your MXC system, say Y here.

config MXC_CAMERA_OV2640
	tristate "OmniVision ov2640 camera support"
	depends on !VIDEO_MXC_EMMA_CAMERA
	select MXC_CAMERA_SENSOR_CLK
	---help---
	  If you plan to use the ov2640 Camera with your MXC system, say Y here.

config MXC_CAMERA_OV3640
	tristate "OmniVision ov3640 camera support"
	depends on !VIDEO_MXC_EMMA_CAMERA
	select MXC_CAMERA_SENSOR_CLK
	---help---
	  If you plan to use the ov3640 Camera with your MXC system, say Y here.

config MXC_CAMERA_OV5640
	tristate "OmniVision ov5640 camera support"
	depends on !VIDEO_MXC_EMMA_CAMERA
	select MXC_CAMERA_SENSOR_CLK
	---help---
	  If you plan to use the ov5640 Camera with your MXC system, say Y here.

config MXC_CAMERA_OV8820_MIPI
	tristate "OmniVision ov8820 camera support using mipi"
	depends on !VIDEO_MXC_EMMA_CAMERA
	depends on ARCH_MX6Q
	select MXC_MIPI_CSI2 if ARCH_MX6Q
	select MXC_CAMERA_SENSOR_CLK
	---help---
	  If you plan to use the ov8820 Camera with mipi interface in your MXC system, say Y here.

config MXC_CAMERA_OV5642
	tristate "OmniVision ov5642 camera support"
	depends on !VIDEO_MXC_EMMA_CAMERA
	select MXC_CAMERA_SENSOR_CLK
	---help---
	  If you plan to use the ov5642 Camera with your MXC system, say Y here.

config MXC_TVIN_ADV7180
	tristate "Analog Device adv7180 TV Decoder Input support"
	depends on (MACH_MX35_3DS || MACH_MX51_3DS || MACH_MX6Q_SABREAUTO || MACH_MX6Q_ARM2)
	---help---
	  If you plan to use the adv7180 video decoder with your MXC system, say Y here.


config MXC_CAMERA_OV5640_MIPI
	tristate "OmniVision ov5640 camera support using mipi"
	depends on !VIDEO_MXC_EMMA_CAMERA
	depends on ARCH_MX6Q
	select MXC_MIPI_CSI2 if ARCH_MX6Q
	select MXC_CAMERA_SENSOR_CLK
	---help---
	  If you plan to use the ov5640 Camera with mipi interface in your MXC system, say Y here.

config MXC_MIPI_CSI2_TVIN_ADV7280
	tristate "Analog Devices adv7280 TV Decoder Input support using mipi-csi2"
	depends on (!VIDEO_MXC_EMMA_CAMERA)
	depends on ARCH_MX6Q
	select MXC_MIPI_CSI2 if ARCH_MX6Q
	select MXC_CAMERA_SENSOR_CLK
	---help---
	  If you plan to use the adv7280 device with mipi-csi2 interface
	  in your iMX6 system, say Y here.

config MXC_CAMERA_SENSOR_CLK
	tristate "camera clock"
	depends on !VIDEO_MXC_EMMA_CAMERA
	---help---
	  If you plan to use the Camera with your MXC system, say Y here.

choice
	prompt "Select Overlay Rounting"
	default MXC_IPU_DEVICE_QUEUE_SDC
	depends on VIDEO_MXC_IPU_CAMERA && FB_MXC_SYNC_PANEL

config MXC_IPU_DEVICE_QUEUE_SDC
	tristate "Queue ipu device for overlay library"
	depends on VIDEO_MXC_IPU_CAMERA
	---help---
	  Use case CSI->MEM->IPU DEVICE->SDC:
		Images from sensor will be frist recieved in memory,then
		queue to ipu device for processing if needed, and displaying
		it on synchronous display with SDC use case.

config MXC_IPU_PRP_VF_SDC
	bool "Pre-Processor VF SDC library"
	depends on VIDEO_MXC_IPU_CAMERA
	---help---
	  Use case PRP_VF_SDC:
		Preprocessing image from smart sensor for viewfinder and
		displaying it on synchronous display with SDC use case.
		If SDC BG is selected, Rotation will not be supported.
		CSI -> IC (PRP VF) -> MEM
		MEM -> IC (ROT) -> MEM
		MEM -> SDC (FG/BG)

endchoice

config MXC_IPU_PRP_ENC
	tristate "Pre-processor Encoder library"
	depends on VIDEO_MXC_IPU_CAMERA
	default y
	---help---
	  Use case PRP_ENC:
		Preprocessing image from smart sensor for encoder.
		CSI -> IC (PRP ENC) -> MEM

config MXC_IPU_CSI_ENC
	tristate "IPU CSI Encoder library"
	depends on VIDEO_MXC_IPU_CAMERA
	default y
	---help---
	  Use case IPU_CSI_ENC:
		Get raw image with CSI from smart sensor for encoder.
		CSI -> MEM
endmenu

endif
```

## drivers/media/video/mxc/output/Kconfig
```kconfig
config VIDEO_MXC_IPU_OUTPUT
	bool "IPU v4l2 support"
	depends on VIDEO_MXC_OUTPUT && MXC_IPU
	default y
	---help---
	  This is the video4linux2 driver for IPU post processing video output.

config VIDEO_MXC_IPUV1_WVGA_OUTPUT
	bool "IPUv1 WVGA v4l2 display support"
	depends on VIDEO_MXC_OUTPUT && MXC_IPU
	default n
	---help---
	  This is the video4linux2 driver for IPUv1 WVGA post processing video output.

config VIDEO_MXC_EMMA_OUTPUT
	bool
	depends on VIDEO_MXC_OUTPUT && MXC_EMMA && FB_MXC_SYNC_PANEL
	default y
	---help---
	  This is the video4linux2 driver for EMMA post processing video output.

config VIDEO_MXC_OUTPUT_FBSYNC
	bool "Synchronize the output with LCDC refresh"
	depends on VIDEO_MXC_EMMA_OUTPUT
	default y
	---help---
	  Synchronize the post-processing with LCDC EOF (End of Frame) to
	  prevent tearing issue. If unsure, say Y.
```

## drivers/media/video/uvc/Kconfig
```kconfig
config USB_VIDEO_CLASS
	tristate "USB Video Class (UVC)"
	---help---
	  Support for the USB Video Class (UVC).  Currently only video
	  input devices, such as webcams, are supported.

	  For more information see: <http://linux-uvc.berlios.de/>

config USB_VIDEO_CLASS_INPUT_EVDEV
	bool "UVC input events device support"
	default y
	depends on USB_VIDEO_CLASS=INPUT || INPUT=y
	---help---
	  This option makes USB Video Class devices register an input device
	  to report button events.

	  If you are in doubt, say Y.

config USB_VIDEO_BUFFERS_DMA
       bool "UVC frame buffers allocated by DMA"
       default y
       depends on USB_VIDEO_CLASS
       ---help---
         This option makes frame buffers of USB Video Class devices are
	 allocated by DMA.
```

## drivers/mxc/Kconfig
```kconfig
# drivers/video/mxc/Kconfig

if ARCH_MXC

menu "MXC support drivers"

config MXC_IPU
	bool "Image Processing Unit Driver"
	depends on !ARCH_MX21
	depends on !ARCH_MX27
	depends on !ARCH_MX25
	select MXC_IPU_V1 if !ARCH_MX37 && !ARCH_MX5 && !ARCH_MX6Q
	select MXC_IPU_V3 if ARCH_MX37 || ARCH_MX5 || ARCH_MX6Q
	select MXC_IPU_V3D if ARCH_MX37
	select MXC_IPU_V3EX if ARCH_MX5
	select MXC_IPU_V3H if ARCH_MX6Q
	help
	  If you plan to use the Image Processing unit, say
	  Y here. IPU is needed by Framebuffer and V4L2 drivers.

source "drivers/mxc/ipu/Kconfig"
source "drivers/mxc/ipu3/Kconfig"

source "drivers/mxc/ssi/Kconfig"
source "drivers/mxc/dam/Kconfig"
source "drivers/mxc/pmic/Kconfig"
source "drivers/mxc/mcu_pmic/Kconfig"
source "drivers/mxc/security/Kconfig"
source "drivers/mxc/hmp4e/Kconfig"
source "drivers/mxc/hw_event/Kconfig"
source "drivers/mxc/vpu/Kconfig"
source "drivers/mxc/asrc/Kconfig"
source "drivers/mxc/bt/Kconfig"
source "drivers/mxc/gps_ioctrl/Kconfig"
source "drivers/mxc/mlb/Kconfig"
source "drivers/mxc/adc/Kconfig"
source "drivers/mxc/amd-gpu/Kconfig"
source "drivers/mxc/gpu-viv/Kconfig"
source "drivers/mxc/thermal/Kconfig"
source "drivers/mxc/mipi/Kconfig"
source "drivers/mxc/hdmi-cec/Kconfig"

endmenu

endif
```

## drivers/mxc/adc/Kconfig
```kconfig
#
# i.MX ADC devices
#

menu "i.MX ADC support"

config IMX_ADC
	tristate "i.MX ADC"
	depends on ARCH_MXC
	default n
	help
	   This selects the Freescale i.MX on-chip ADC driver.

endmenu
```

## drivers/mxc/amd-gpu/Kconfig
```kconfig
#
# Bluetooth configuration
#

menu "MXC AMD GPU support"
	depends on ARCH_MX35 || ARCH_MX51 || ARCH_MX53 || ARCH_MX50

config MXC_AMD_GPU
	tristate "MXC AMD GPU support"
	---help---
         Say Y to get the GPU driver support.

endmenu
```

## drivers/mxc/asrc/Kconfig
```kconfig
#
# ASRC configuration
#

menu "MXC Asynchronous Sample Rate Converter support"

config MXC_ASRC
	tristate "ASRC support"
	depends on ARCH_MX35 || ARCH_MX53 || ARCH_MX6
	---help---
         Say Y to get the ASRC service.

endmenu
```

## drivers/mxc/bt/Kconfig
```kconfig
#
# Bluetooth configuration
#

menu "MXC Bluetooth support"

config MXC_BLUETOOTH
	tristate "MXC Bluetooth support"
	depends on MACH_MX31_3DS || MACH_MX35_3DS || MACH_MX37_3DS || MACH_MX51_3DS
	---help---
         Say Y to get the third party Bluetooth service.

endmenu
```

## drivers/mxc/can_rpmsg/Kconfig
```kconfig
#
# can rpmsg configuration
#

menu "MXC can rpmsg setting"

config CAN_RPMSG
       tristate "NXP RPMSG CAN support"
       select EXTCON
       help
          If you say yes here you get support for the NXP RPMSG
          CAN module.

endmenu
```

## drivers/mxc/dam/Kconfig
```kconfig
#
# DAM API configuration
#

menu "MXC Digital Audio Multiplexer support"

config MXC_DAM
	tristate "DAM support"
	depends on ARCH_MXC
	---help---
	  Say Y to get the Digital Audio Multiplexer services API available on MXC platform.

endmenu
```

## drivers/mxc/gps_ioctrl/Kconfig
```kconfig
#
# BROADCOM GPS configuration
#

menu "Broadcom GPS ioctrl support"

config GPS_IOCTRL
	tristate "GPS ioctrl support"
	depends on MACH_MX31_3DS || MACH_MX35_3DS || MACH_MX37_3DS || MACH_MX51_3DS
	---help---
	  Say Y to enable Broadcom GPS ioctrl on MXC platform.

endmenu
```

## drivers/mxc/gpu-viv/Kconfig
```kconfig
menu "MXC Vivante GPU support"
	depends on ARCH_MX6

config MXC_GPU_VIV
	tristate "MXC Vivante GPU support"
	---help---
         Say Y to get the GPU driver support.

config GPU_LOW_MEMORY_KILLER
       tristate "Reserved memory account to Low memory Killer"
       depends on ANDROID
       default n
       ---help---
         Resigter reserved memory account to low memory killer, These
         reserved memory is mainly used by GPU driver, but it's not
         account by low memory killer, so even it takes much memory,
         it will not killed.  add this to fix this, it will kill the
         large memory app in background.

endmenu
```

## drivers/mxc/hdmi-cec/Kconfig
```kconfig
#
# Codec configuration
#

menu "MXC HDMI CEC (Consumer Electronics Control) support"

config MXC_HDMI_CEC
	  tristate "Support for MXC HDMI CEC (Consumer Electronics Control)"
	  depends on (ARCH_MX6)
	  select MFD_MXC_HDMI
	---help---
	  The HDMI CEC device implement low level protocol on i.MX6x platforms.

endmenu
```
