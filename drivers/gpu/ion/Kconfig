## drivers/mxc/hmp4e/Kconfig
```kconfig
#
# MPEG4 Encoder kernel module  configuration
#

menu "MXC MPEG4 Encoder Kernel module support"

config MXC_HMP4E
	tristate "MPEG4 Encoder support"
	depends on ARCH_MXC
	depends on !ARCH_MX27
	default y
	---help---
	  Say Y to get the MPEG4 Encoder kernel module available on
	  MXC platform.

config MXC_HMP4E_DEBUG
	bool "MXC MPEG4 Debug messages"
	depends on MXC_HMP4E != n
	default n
	---help---
	  Say Y here if you need the Encoder driver to print debug messages.
	  This is an option for developers, most people should say N here.

endmenu
```

## drivers/mxc/hw_event/Kconfig
```kconfig
menu "MXC HARDWARE EVENT"

config MXC_HWEVENT
	bool "MXC Hardware Event Handler"
	default y
	depends on ARCH_MXC
	help
	  If you plan to use the Hardware Event Handler in the MXC, say
	  Y here. If unsure, select Y.

endmenu
```

## drivers/mxc/ipu/pf/Kconfig
```kconfig
config MXC_IPU_PF
	tristate "MXC MPEG4/H.264 Post Filter Driver"
	depends on MXC_IPU_V1
    default y
	help
        Driver for MPEG4 dering and deblock and H.264 deblock
        using MXC IPU h/w
```

## drivers/mxc/ipu3/Kconfig
```kconfig
config MXC_IPU_V3
	bool

config MXC_IPU_V3D
	bool

config MXC_IPU_V3EX
	bool

config MXC_IPU_V3H
	bool
```
