## drivers/net/wireless/ath6kl/Kconfig
```kconfig
config ATH6K_LEGACY
	tristate "Atheros AR600x support (non mac80211)"
	depends on MMC
	depends on WLAN
	select WIRELESS_EXT
	select WEXT_SPY
	select WEXT_PRIV
	help
	This module adds support for wireless adapters based on Atheros AR600x chipset running over SDIO. If you choose to build it as a module, it will be called ath6kl.

choice
	prompt "AR600x Board Data Configuration"
	depends on ATH6K_LEGACY
	default AR600x_SD31_XXX
	help
	Select the appropriate board data template from the list below that matches your AR600x based reference design.

config AR600x_SD31_XXX
	bool "SD31-xxx"
	help
        Board Data file for a standard SD31 reference design (File: bdata.SD31.bin)

config AR600x_WB31_XXX
	bool "WB31-xxx"
	help
        Board Data file for a standard WB31 (BT/WiFi) reference design (File: bdata.WB31.bin)

config AR600x_SD32_XXX
	bool "SD32-xxx"
	help
        Board Data file for a standard SD32 (5GHz) reference design (File: bdata.SD32.bin)

config AR600x_CUSTOM_XXX
	bool "CUSTOM-xxx"
	help
        Board Data file for a custom reference design (File: should be named as bdata.CUSTOM.bin)
endchoice

config ATH6KL_ENABLE_COEXISTENCE
	bool "BT Coexistence support"
	depends on ATH6K_LEGACY
	help
	Enables WLAN/BT coexistence support. Select the apprpriate configuration from below.

choice
	prompt "Front-End Antenna Configuration"
	depends on ATH6KL_ENABLE_COEXISTENCE
	default AR600x_DUAL_ANTENNA
	help
	Select the appropriate configuration from the list below that matches your AR600x based reference design.

config AR600x_DUAL_ANTENNA
	bool "Dual Antenna"
	help
        Dual Antenna Design

config AR600x_SINGLE_ANTENNA
	bool "Single Antenna"
	help
        Single Antenna Design
endchoice

choice
	prompt "Collocated Bluetooth Type"
	depends on ATH6KL_ENABLE_COEXISTENCE
	default AR600x_BT_AR3001
	help
	Select the appropriate configuration from the list below that matches your AR600x based reference design.

config AR600x_BT_QCOM
	bool "Qualcomm BTS4020X"
	help
        Qualcomm BT (3 Wire PTA)

config AR600x_BT_CSR
	bool "CSR BC06"
	help
        CSR BT (3 Wire PTA)

config AR600x_BT_AR3001
	bool "Atheros AR3001"
	help
        Atheros BT (3 Wire PTA)
endchoice

config ATH6KL_HCI_BRIDGE
	bool "HCI over SDIO support"
	depends on ATH6K_LEGACY
	help
	Enables BT over SDIO. Applicable only for combo designs (eg: WB31)

config ATH6KL_CONFIG_GPIO_BT_RESET
	bool "Configure BT Reset GPIO"
	depends on ATH6KL_HCI_BRIDGE
	help
	Configure a WLAN GPIO for use with BT.

config AR600x_BT_RESET_PIN
	int "GPIO"
	depends on ATH6KL_CONFIG_GPIO_BT_RESET
	default 22
	help
	WLAN GPIO to be used for resetting BT

config ATH6KL_CFG80211
	bool "CFG80211 support"
	depends on ATH6K_LEGACY
	help
	Enables support for CFG80211 APIs

config ATH6KL_HTC_RAW_INTERFACE
	bool "RAW HTC support"
	depends on ATH6K_LEGACY
	help
	Enables raw HTC interface. Allows application to directly talk to the HTC interface via the ioctl interface

config ATH6KL_VIRTUAL_SCATTER_GATHER
	bool "Virtual Scatter-Gather support"
	depends on ATH6K_LEGACY
	help
	Enables virtual scatter gather support for the hardware that does not support it natively.

config ATH6KL_DEBUG
	bool "Debug support"
	depends on ATH6K_LEGACY
	help
	Enables debug support

config ATH6KL_ENABLE_HOST_DEBUG
	bool "Host Debug support"
	depends on ATH6KL_DEBUG
	help
	Enables debug support in the driver

config ATH6KL_ENABLE_TARGET_DEBUG_PRINTS
	bool "Target Debug support - Enable UART prints"
	depends on ATH6KL_DEBUG
	help
	Enables uart prints

config AR600x_DEBUG_UART_TX_PIN
	int "GPIO"
	depends on ATH6KL_ENABLE_TARGET_DEBUG_PRINTS
	default 8
	help
	WLAN GPIO to be used for Debug UART (Tx)

config ATH6KL_DISABLE_TARGET_DBGLOGS
	bool "Target Debug support - Disable Debug logs"
	depends on ATH6KL_DEBUG
	help
	Enables debug logs
```

## drivers/net/wireless/bcmdhd_1363/Kconfig
```kconfig
config BCMDHD_1363
	tristate "Broadcom FullMAC wireless cards support v1.363"
	depends on !BCMDHD
	---help---
	  This module adds support for wireless adapters based on
	  Broadcom FullMAC chipset.

	  If you choose to build a module, it'll be called dhd. Say M if
	  unsure.

config BCMDHD_PCIE
	bool "PCIe bus interface support"
	depends on BCMDHD_1363 && PCI && !BCMDHD_SDIO

config BCM4359
	bool "BCM4359 support"
	depends on BCMDHD_1363
	default y

config BCMDHD_FW_PATH
	depends on BCMDHD_1363
	string "Firmware path"
	default "/system/vendor/firmware/fw_bcmdhd.bin"
	---help---
	  Path to the firmware file.

config BCMDHD_NVRAM_PATH
	depends on BCMDHD_1363
	string "NVRAM path"
	default "/system/etc/wifi/bcmdhd.cal"
	---help---
	  Path to the calibration file.

config DHD_USE_STATIC_BUF
	bool "Enable memory preallocation"
	depends on BCMDHD_1363
	default n
	---help---
	  Use memory preallocated in platform

config DHD_USE_SCHED_SCAN
	bool "Use CFG80211 sched scan"
	depends on BCMDHD_1363 && CFG80211
	default n
	---help---
	  Use CFG80211 sched scan

config DHD_SET_RANDOM_MAC_VAL
hex "Vendor OUI"
depends on BCMDHD_1363
default 0x001A11
 ---help---
Set vendor OUI for SoftAP
```

## drivers/net/wireless/marvell/mrvl8997/Kconfig
```kconfig
config MRVL8997
	tristate "Marvell WiFi Driver for 8997"
	default m
	depends on CFG80211
	---help---
		This adds support for wireless adapters based on Marvell
		802.11n/ac chipsets. If you choose to build it as a module,
		it will be build 2 modules moal.ko and mlan.ko
```

## drivers/net/wireless/rtl8192ce/Kconfig
```kconfig
#config RTL8192CE
config RTL8192CE
	tristate "Realtek 8192C PCI WiFi"
	depends on PCI
	---help---
	  Help message of RTL8192CE
```

## drivers/pci/endpoint/functions/Kconfig
```kconfig
# SPDX-License-Identifier: GPL-2.0
#
# PCI Endpoint Functions
#

config PCI_EPF_TEST
	tristate "PCI Endpoint Test driver"
	depends on PCI_ENDPOINT
	select CRC32
	help
	   Enable this configuration option to enable the test driver
	   for PCI Endpoint.

	   If in doubt, say "N" to disable Endpoint test driver.

config IMX_MIC_EPF
	tristate "i.MX MIC Endpoint driver"
	depends on PCI_ENDPOINT && IMX_MIC_CARD
	help
	   Enable this configuration option to enable endpoint driver
	   for i.MX MIC.
```

## drivers/pci/host/Kconfig
```kconfig
menu "PCI host controller drivers"
	depends on PCI

config PCI_MVEBU
	bool "Marvell EBU PCIe controller"
	depends on ARCH_MVEBU || ARCH_KIRKWOOD

config PCIE_DW
	bool

config PCI_EXYNOS
	bool "Samsung Exynos PCIe controller"
	depends on SOC_EXYNOS5440
	select PCIEPORTBUS
	select PCIE_DW

config PCI_IMX6
	bool "Freescale i.MX6 PCIe controller"
	depends on SOC_IMX6Q
	select PCIEPORTBUS
	select PCIE_DW

config PCI_IMX6SX_EXTREMELY_PWR_SAVE
	bool "Freescale i.MX6SX PCIe controller extremely power save mode"
	depends on PCI_IMX6

config EP_MODE_IN_EP_RC_SYS
	bool "PCI Express EP mode in the IMX6 RC/EP interconnection system"
	depends on PCI_IMX6

config EP_SELF_IO_TEST
	bool "PCI Express EP_SELF_IO_TEST in EP mode"
	depends on EP_MODE_IN_EP_RC_SYS

config RC_MODE_IN_EP_RC_SYS
	bool "PCI Express RC mode in the IMX6 RC/EP interconnection system"
	depends on PCI_IMX6

config PCI_IMX_EP_DRV
	bool "i.MX6 PCI Express EP skeleton driver"
	depends on RC_MODE_IN_EP_RC_SYS
	default y

config PCI_TEGRA
	bool "NVIDIA Tegra PCIe controller"
	depends on ARCH_TEGRA

endmenu
```

## drivers/rpmsg/Kconfig
```kconfig
menu "Rpmsg drivers"

# RPMSG always gets selected by whoever wants it
config RPMSG
	tristate "RPMSG bus driver"
	select VIRTIO
	select VIRTUALIZATION

config IMX_RPMSG_PINGPONG
	tristate "IMX RPMSG pingpong driver"
	depends on RPMSG

config IMX_RPMSG_TTY
	tristate "IMX RPMSG tty driver"
	depends on RPMSG

endmenu
```
