## drivers/mxc/mcu_pmic/Kconfig
```kconfig
#
# PMIC Modules configuration
#

config MXC_PMIC_MC9SDZ60
	tristate "MC9sDZ60 PMIC"
	depends on ARCH_MXC && I2C
	  ---help---
	  This is the MXC MC9sDZ60(MCU) PMIC support.

config MXC_MC9SDZ60_RTC
	tristate "MC9SDZ60 Real Time Clock (RTC) support"
	depends on MXC_PMIC_MC9SDZ60
	---help---
	This is the MC9SDZ60 RTC module driver. This module provides kernel API
	for RTC part of MC9SDZ60.
	If you want MC9SDZ60 RTC support, you should say Y here
	
```

## drivers/mxc/mipi/Kconfig
```kconfig
#
# MIPI configuration
#

menu "MXC MIPI Support"

config MXC_MIPI_CSI2
	tristate "MIPI CSI2 support"
	depends on ARCH_MX6
	---help---
         Say Y to get the MIPI CSI2 support.

endmenu
```

## drivers/mxc/mlb/Kconfig
```kconfig
#
# MLB configuration
#

menu "MXC Media Local Bus Driver"

config MXC_MLB
	boolean

config MXC_MLB50
	tristate "MLB support"
	depends on ARCH_MX35 || ARCH_MX53
	select MXC_MLB
	---help---
         Say Y to get the MLB support.

config MXC_MLB150
	tristate "MLB150 support"
	depends on ARCH_MX6Q
	select MXC_MLB
	---help---
	Say Y to get the MLB150 support.

endmenu
```

## drivers/mxc/pmic/Kconfig
```kconfig
#
# PMIC device driver configuration
#

menu "MXC PMIC support"

config MXC_PMIC
	boolean

config MXC_PMIC_MC13783
	tristate "MC13783 PMIC"
	depends on ARCH_MXC && SPI
	select MXC_PMIC
	---help---
	  This is the MXC MC13783(PMIC) support. It include
	  ADC, Audio, Battery, Connectivity, Light, Power and RTC.

config MXC_PMIC_MC13892
	tristate "MC13892 PMIC"
	depends on ARCH_MXC && (I2C || SPI)
	select MXC_PMIC
	---help---
	  This is the MXC MC13892(PMIC) support. It include
	  ADC, Battery, Connectivity, Light, Power and RTC.

config MXC_PMIC_MC34708
	tristate "MC34708 PMIC"
	depends on ARCH_MXC && (I2C || SPI)
	select MXC_PMIC
	---help---
	  This is the MXC MC34708(PMIC) support. It include
	  ADC, Battery, Connectivity, Light, Power and RTC.

config MXC_PMIC_I2C
	bool "Support PMIC I2C Interface"
	depends on MXC_PMIC_MC13892 && I2C

config MXC_PMIC_SPI
	bool "Support PMIC SPI Interface"
	depends on (MXC_PMIC_MC13892 || MXC_PMIC_MC13783) && SPI

config MXC_PMIC_MC34704
	tristate "MC34704 PMIC"
	depends on ARCH_MXC && I2C
	select MXC_PMIC
	  ---help---
	  This is the MXC MC34704 PMIC support.

config MXC_PMIC_MC9SDZ60
	tristate "MC9sDZ60 PMIC"
	depends on ARCH_MXC && I2C
	select MXC_PMIC
	  ---help---
	  This is the MXC MC9sDZ60(MCU) PMIC support.

config MXC_PMIC_CHARDEV
	tristate "MXC PMIC device interface"
	depends on MXC_PMIC
	help
	  Say Y here to use "pmic" device files, found in the /dev directory
	  on the system.  They make it possible to have user-space programs
	  use or controll PMIC. Mainly its useful for notifying PMIC events
	  to user-space programs.

comment "MXC PMIC Client Drivers"
	depends on MXC_PMIC

source "drivers/mxc/pmic/mc13783/Kconfig"

source "drivers/mxc/pmic/mc13892/Kconfig"

source "drivers/mxc/pmic/mc34708/Kconfig"
endmenu
```

## drivers/mxc/pmic/mc13783/Kconfig
```kconfig
#
# PMIC Modules configuration
#

config MXC_MC13783_ADC
	tristate "MC13783 ADC support"
	depends on MXC_PMIC_MC13783
	---help---
	This is the MC13783 ADC module driver. This module provides kernel API
	for the ADC system of MC13783.
	It controls also the touch screen interface.
	If you want MC13783 ADC support, you should say Y here

config MXC_MC13783_AUDIO
	tristate "MC13783 Audio support"
	depends on MXC_PMIC_MC13783
	---help---
	This is the MC13783 audio module driver. This module provides kernel API
	for audio part of MC13783.
	If you want MC13783 audio support, you should say Y here
config MXC_MC13783_RTC
	tristate "MC13783 Real Time Clock (RTC) support"
	depends on MXC_PMIC_MC13783
	---help---
	This is the MC13783 RTC module driver. This module provides kernel API
	for RTC part of MC13783.
	If you want MC13783 RTC support, you should say Y here
config MXC_MC13783_LIGHT
	tristate "MC13783 Light and Backlight support"
	depends on MXC_PMIC_MC13783
	---help---
	This is the MC13783 Light module driver. This module provides kernel API
	for led and backlight control part of MC13783.
	If you want MC13783 Light support, you should say Y here
config MXC_MC13783_BATTERY
	tristate "MC13783 Battery API support"
	depends on MXC_PMIC_MC13783
	---help---
	This is the MC13783 battery module driver. This module provides kernel API
	for battery control part of MC13783.
	If you want MC13783 battery support, you should say Y here
config MXC_MC13783_CONNECTIVITY
	tristate "MC13783 Connectivity API support"
	depends on MXC_PMIC_MC13783
	---help---
	This is the MC13783 connectivity module driver. This module provides kernel API
	for USB/RS232 connectivity control part of MC13783.
	If you want MC13783 connectivity support, you should say Y here
config MXC_MC13783_POWER
	tristate "MC13783 Power API support"
	depends on MXC_PMIC_MC13783
	---help---
	This is the MC13783 power and supplies module driver. This module provides kernel API
	for power and regulator control part of MC13783.
	If you want MC13783 power support, you should say Y here
```

## drivers/mxc/pmic/mc13892/Kconfig
```kconfig
#
# PMIC Modules configuration
#

config MXC_MC13892_ADC
	tristate "MC13892 ADC support"
	depends on MXC_PMIC_MC13892
	---help---
	This is the MC13892 ADC module driver. This module provides kernel API
	for the ADC system of MC13892.
	It controls also the touch screen interface.
	If you want MC13892 ADC support, you should say Y here

config MXC_MC13892_RTC
	tristate "MC13892 Real Time Clock (RTC) support"
	depends on MXC_PMIC_MC13892
	---help---
	This is the MC13892 RTC module driver. This module provides kernel API
	for RTC part of MC13892.
	If you want MC13892 RTC support, you should say Y here
config MXC_MC13892_LIGHT
	tristate "MC13892 Light and Backlight support"
	depends on MXC_PMIC_MC13892
	---help---
	This is the MC13892 Light module driver. This module provides kernel API
	for led and backlight control part of MC13892.
	If you want MC13892 Light support, you should say Y here
config MXC_MC13892_BATTERY
	tristate "MC13892 Battery API support"
	depends on MXC_PMIC_MC13892
	---help---
	This is the MC13892 battery module driver. This module provides kernel API
	for battery control part of MC13892.
	If you want MC13892 battery support, you should say Y here
config MXC_MC13892_CONNECTIVITY
	tristate "MC13892 Connectivity API support"
	depends on MXC_PMIC_MC13892
	---help---
	This is the MC13892 connectivity module driver. This module provides kernel API
	for USB/RS232 connectivity control part of MC13892.
	If you want MC13892 connectivity support, you should say Y here
config MXC_MC13892_POWER
	tristate "MC13892 Power API support"
	depends on MXC_PMIC_MC13892
	---help---
	This is the MC13892 power and supplies module driver. This module provides kernel API
	for power and regulator control part of MC13892.
	If you want MC13892 power support, you should say Y here
```

## drivers/mxc/pmic/mc34708/Kconfig
```kconfig
#
# PMIC Modules configuration
#

config MXC_MC34708_ADC
	tristate "MC34708 ADC support"
	depends on MXC_PMIC_MC34708
	---help---
	This is the MC34708 ADC module driver. This module provides kernel API
	for the ADC system of MC34708.
	It controls also the touch screen interface.
	If you want MC34708 ADC support, you should say Y here

config MXC_MC34708_RTC
	tristate "MC34708 Real Time Clock (RTC) support"
	depends on MXC_PMIC_MC34708
	---help---
	This is the MC34708 RTC module driver. This module provides kernel API
	for RTC part of MC34708.
	If you want MC34708 RTC support, you should say Y here
config MXC_MC34708_BATTERY
	tristate "MC34708 Battery API support"
	depends on MXC_PMIC_MC34708
	---help---
	This is the MC34708 battery module driver. This module provides kernel API
	for battery control part of MC34708.
	If you want MC34708 battery support, you should say Y here
```

## drivers/mxc/security/Kconfig
```kconfig
menu "MXC Security Drivers"

config MXC_DRYICE
        tristate "MXC DryIce Driver"
        depends on ARCH_MX25
        default n
        ---help---
          This module contains the core API's for accessing the DryIce module.
          If you are unsure about this, say N here.

endmenu
```

## drivers/mxc/security/sahara2/Kconfig
```kconfig
menu "SAHARA2 Security Hardware Support"

config MXC_SAHARA
	tristate "Security Hardware Support (FSL SHW)"
	---help---
	  Provides driver and kernel mode API for using cryptographic
	  accelerators.

config MXC_SAHARA_USER_MODE
	tristate "User Mode API for FSL SHW"
	depends on MXC_SAHARA
	---help---
	  Provides kernel driver for User Mode API.

config MXC_SAHARA_POLL_MODE
	bool "Force driver to POLL for hardware completion."
	depends on MXC_SAHARA
	default n
	---help---
	  When this flag is yes, the driver will not use interrupts to
	  determine when the hardware has completed a task, but instead
	  will hold onto the CPU and continually poll the hardware until
	  it completes.

config MXC_SAHARA_POLL_MODE_TIMEOUT
    hex "Poll loop timeout"
    depends on MXC_SAHARA_POLL_MODE
    default "0xFFFFFFFF"
    help
        To avoid infinite polling, a timeout is provided. Should the
        timeout be reached, a fault is reported, indicating there must
        be something wrong with SAHARA, and SAHARA is reset. The loop
        will exit after the given number of iterations.

endmenu
```

## drivers/mxc/ssi/Kconfig
```kconfig
#
# SPI device configuration
#

menu "MXC SSI support"

config MXC_SSI
	tristate "SSI support"
	---help---
	  Say Y to get the SSI services API available on MXC platform.

endmenu
```

## drivers/mxc/thermal/Kconfig
```kconfig
#
# ANATOP Configuration
#

menu "ANATOP_THERMAL"

config ANATOP_THERMAL
	tristate "Thermal Zone"
	depends on ARCH_MX6
	select THERMAL
	default y
	help
	  This driver supports ANATOP thermal zones. It is HIGHLY
	  recommended that this option be enabled, as your processor(s)
	  may be damaged without it.

	  To compile this driver as a module, choose M here:
	  the module will be called thermal.

endmenu
```

## drivers/mxc/vehicle/Kconfig
```kconfig
#
# vehicle configuration
#

menu "MXC vehicle setting"

config VEHICLE_CORE
       tristate "NXP VEHICLE core support"
       help
          If you say yes here you get support for the NXP
          vehicle core module.

config VEHICLE_RPMSG_M4
       tristate "NXP RPMSG VEHICLE MCU support"
       select EXTCON
       help
          If you say yes here you get support for the NXP MCU
          module which communicate with AP.

config VEHICLE_DUMMY
       tristate "NXP VEHICLE DUMMY support"
       select EXTCON
       help
          If you say yes here you get support for the NXP dummy MCU
          which simulate the vehicle signal.

config VEHICLE_DRIVER_OREO
	tristate "NXP vehicle driver for android o"
	help
	   If you say yes here, you can get support for vehicle protocol
	   in android o, otherwise it support android p.

endmenu
```

## drivers/mxc/vpu/Kconfig
```kconfig
#
# Codec configuration
#

menu "MXC VPU(Video Processing Unit) support"

config MXC_VPU
	  tristate "Support for MXC VPU(Video Processing Unit)"
	  depends on (ARCH_MX3 || ARCH_MX27 || ARCH_MX37 || ARCH_MX5 || ARCH_MX6)
	  default y
	---help---
	  The VPU codec device provides codec function for H.264/MPEG4/H.263,
	  as well as MPEG2/VC-1/DivX on some platforms.

config MXC_VPU_DEBUG
	bool "MXC VPU debugging"
	depends on MXC_VPU != n
	help
	  This is an option for the developers; most people should
	  say N here.  This enables MXC VPU driver debugging.

config MX6_VPU_352M
	bool "MX6 VPU 352M"
	depends on MXC_VPU
	default n
	help
	 Increase VPU frequncy to 352M, the config will disable bus frequency
	 adjust dynamic, and CPU lowest setpoint will be 352Mhz.
	 This config is used for special VPU use case.

endmenu
```

## drivers/mxc/vpu/memory_usage/Kconfig
```kconfig
# SPDX-License-Identifier: GPL-2.0-only

comment "IMX VPU memory usage recorder driver"

config MXC_MUR
	tristate "IMX VPU memory usage recorder driver"
	depends on VIDEO_DEV
	help
	  IMX VPU memory usage recorder is to count
	  and show the detailed memory usage of VPU
	  device and instances.
	  To compile this driver as a module choose m here.
```

## drivers/mxc/vpu_legacy/Kconfig
```kconfig
#
# Codec configuration
#

menu "MXC VPU(Video Processing Unit) LEGACY DECODER support"

config MXC_VPU_LEGACY
	  tristate "Support for MXC VPU(Video Processing Unit) LEGACY A0 DECODER"
	  default n
	---help---
	  The VPU codec device provides codec function for H.265/H.264/MPEG4/H.263 etc.

config MXC_VPU_LEGACY_DEBUG
	bool "MXC VPU LEGACY debugging"
	depends on MXC_VPU_LEGACY != n
	help
	  This is an option for the developers; most people should
	  say N here.  This enables MXC VPU driver debugging.

endmenu
```

## drivers/mxc/vpu_malone/Kconfig
```kconfig
#
# Codec configuration
#

menu "MXC VPU(Video Processing Unit) MALONE DECODER support"

config MXC_VPU_MALONE
	  tristate "Support for MXC VPU(Video Processing Unit) MALONE B0 DECODER"
	  default y
	---help---
	  The VPU codec device provides codec function for H.265 H.264 MPEG2 MPEG4 etc.

config MXC_VPU_MALONE_DEBUG
	bool "MXC VPU MALONE debugging"
	depends on MXC_VPU_MALONE != n
	help
	  This is an option for the developers; most people should
	  say N here.  This enables MXC VPU driver debugging.

endmenu
```

## drivers/net/can/Kconfig
```kconfig
menu "CAN Device Drivers"
	depends on CAN

config CAN_VCAN
	tristate "Virtual Local CAN Interface (vcan)"
	depends on CAN
	default N
	---help---
	  Similar to the network loopback devices, vcan offers a
	  virtual local CAN interface.

	  This driver can also be built as a module.  If so, the module
	  will be called vcan.

config CAN_DEBUG_DEVICES
	bool "CAN devices debugging messages"
	depends on CAN
	default N
	---help---
	  Say Y here if you want the CAN device drivers to produce a bunch of
	  debug messages to the system log.  Select this if you are having
	  a problem with CAN support and want to see more of what is going
	  on.

config CAN_FLEXCAN
        tristate "Freescale FlexCAN"
        depends on CAN && ARCH_MX35
        default m
        ---help---
          This select the support of Freescale CAN(FlexCAN).
          This driver can also be built as a module.
          If unsure, say N.

endmenu
```

## drivers/net/dsa/netc/Kconfig
```kconfig
# SPDX-License-Identifier: GPL-2.0-only
config NET_DSA_NETC_SWITCH
	tristate "NXP NETC Ethernet switch support"
	depends on NET_DSA && PCI
	select NET_DSA_TAG_NETC
	select FSL_ENETC_MDIO
	select PCS_XPCS
	select NXP_NETC_LIB
	help
	  This driver supports the NXP NETC Ethernet switch, which is embedded
	  as a PCIe function of the NXP NETC IP. But note that this driver does
	  only support switch versions greater than or equal to NETC v4.3.

	  If compiled as module (M), the module name is nxp-netc-switch.
```
