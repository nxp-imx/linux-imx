## drivers/soc/imx/Kconfig
```kconfig
# SPDX-License-Identifier: GPL-2.0-only
menu "i.MX SoC drivers"

config IMX_GPCV2_PM_DOMAINS
	tristate "i.MX GPCv2 PM domains"
	default ARCH_MXC
	depends on ARCH_MXC || (COMPILE_TEST && OF)
	depends on PM
	select PM_GENERIC_DOMAINS
	select REGMAP_MMIO
	default y if SOC_IMX7D

config SOC_IMX8M
	tristate "i.MX8M SoC family support"
	depends on ARCH_MXC || COMPILE_TEST
	default ARCH_MXC && ARM64
	select SOC_BUS
	select ARM_GIC_V3 if ARCH_MXC && ARCH_MULTI_V7
	help
	  If you say yes here you get support for the NXP i.MX8M family
	  support, it will provide the SoC info like SoC family,
	  ID and revision etc.

config SOC_DEV_IMX9
	tristate "i.MX9 SoC device support"
	depends on ARCH_MXC || COMPILE_TEST
	depends on NVMEM_IMX_OCOTP_FSB_S400
	default ARCH_MXC && ARM64
	select SOC_BUS
	select ARM_GIC_V3 if ARCH_MXC && ARCH_MULTI_V7
	help
	  If you say yes here you get support for the NXP i.MX9 SoC device
	  support, it will provide the SoC info like SoC family,
	  ID and revision etc.

config IMX8M_BUSFREQ
	tristate "i.MX8M busfreq"
	depends on SOC_IMX8M
	default ARCH_MXC

config IMX8M_PM_DOMAINS
	tristate "i.MX8M PM domains"
	default ARCH_MXC
	depends on ARCH_MXC || (COMPILE_TEST && OF)
	depends on PM
	select PM_GENERIC_DOMAINS

config SOC_IMX9
	tristate "i.MX9 SoC family support"
	depends on ARCH_MXC || COMPILE_TEST
	default ARCH_MXC && ARM64
	select SOC_BUS
	help
	  If you say yes here, you get support for the NXP i.MX9 family

config SECVIO_SC
	tristate "NXP SC secvio support"
	depends on IMX_SCU
	default y
	help
	   If you say yes here you get support for the NXP SNVS security
	   violation module. It includes the possibility to read information
	   related to security violations and tampers. It also gives the
	   possibility to register user callbacks when a security violation
	   occurs.

config RPMSG_LIFE_CYCLE
	tristate "i.MX8ULP Rpmsg Life Cycle Support"
	depends on ARCH_MXC || COMPILE_TEST
	depends on RPMSG
	default ARCH_MXC && ARM64
	help
	  If you say yes here you get supoort for the rpmsg life cycle support on
	  i.MX8ULP for low power mode state coordination between A core & M core to
	  make sure A core can be put into Low power mode without risk by sending
	  notify to M core.

config IMX8ULP_LPM_CTRL
	tristate "i.MX8ULP DDR Low Power Control support"
	depends on ARCH_MXC || COMPILE_TEST
	default ARCH_MXC && ARM64
	help
	  If you say yes here you get supoort for DDR frequency scaling support on
	  i.MX8ULP for scaling the DDR frequency based on user case. The DDR frequency
	  need to be switched manually by user.

config IMX_GKI_FIX
	bool "IMX GKI fix issue"
	default n

config IMX_GKI_8Q_FIX
	bool "IMX GKI 8Q fix issue"
	default n

config IMX_LPA_CTRL
	tristate "i.MX8MP lpa power mode control support"
	depends on ARCH_MXC
	default n
endmenu
```

## drivers/soc/imx/mu/Kconfig
```kconfig
config SOC_IMX_MU
	tristate "i.MX SoC MU support"
	depends on ARCH_MXC
	default ARCH_MXC && ARM64
```

## drivers/staging/android/Kconfig
```kconfig
menu "Android"

config ANDROID
	bool "Android Drivers"
	default n
	---help---
	  Enable support for various drivers needed on the Android platform

if ANDROID

config ANDROID_BINDER_IPC
	bool "Android Binder IPC Driver"
	default y

config ANDROID_LOGGER
	tristate "Android log driver"
	default y

config ANDROID_LOW_MEMORY_KILLER
	bool "Android Low Memory Killer"
	default y
	---help---
	  Register processes to be killed when memory is low

endif # if ANDROID

endmenu
```

## drivers/staging/android/ion/Kconfig
```kconfig
# SPDX-License-Identifier: GPL-2.0
menuconfig ION
	bool "Ion Memory Manager"
	depends on HAS_DMA && MMU
	select GENERIC_ALLOCATOR
	select DMA_SHARED_BUFFER
	help
	  Choose this option to enable the ION Memory Manager,
	  used by Android to efficiently allocate buffers
	  from userspace that can be shared between drivers.
	  If you're not using Android its probably safe to
	  say N here.

config ION_IMX
	tristate "Ion for imx platform"
	depends on ARCH_MXC && ION
	help
		Choose this option if you wish to get phy address on imx platform

source "drivers/staging/android/ion/heaps/Kconfig"
```

## drivers/trusty/Kconfig
```kconfig
# SPDX-License-Identifier: GPL-2.0-only
#
# Trusty driver
#

menu "Trusty driver"

config TRUSTY
	tristate "Trusty core driver"
	depends on ARM || ARM64
	help
	  Trusty is a secure OS that provides a Trusted Execution Environment
	  (TEE) for Android.  Trusty runs on the same processor as Linux but is
	  isolated from the rest of the system by both hardware and software.

	  This option enables the core part of the Linux kernel driver for
	  Trusty.  This doesn't do much by itself; you'll need to enable some of
	  the sub-modules too.

	  If you build this as a module, it will be called trusty-core.

if TRUSTY

config TRUSTY_FFA_TRANSPORT
	tristate "Trusty transport based on FFA"
	depends on ARM_FFA_TRANSPORT
	default y
	help
	  Enable ARM FF-A based transport for Trusty.

	  If you want to use ARM FF-A based transport for sending Trusty messages
	  to secure world and/or performing memory sharing operations, answer Y.

	  This transport can also be used in tandem with TRUSTY_SMC_TRANSPORT
	  where the FF-A driver is used for the memory operations, while the
	  legacy SMC transport is used to call into Trusty.

config TRUSTY_SMC_TRANSPORT
	tristate
	prompt "Trusty transport based on SMC" if TRUSTY_FFA_TRANSPORT
	default y
	help
	  Enable SMC based transport for Trusty.

	  If TRUSTY_SMC_TRANSPORT_USE_FFA_TRANSPORT is also Y,
	  the SMC transport will use the firmware driver
	  and call into the memory operation implementation from
	  the FF-A transport enabled by TRUSTY_FFA_TRANSPORT.

	  If you want to use legacy SMC based transport for sending Trusty
	  messages to secure world, answer Y.

config TRUSTY_SMC_TRANSPORT_USE_FFA_TRANSPORT
	bool
	depends on TRUSTY_SMC_TRANSPORT && TRUSTY_FFA_TRANSPORT
	default y

config TRUSTY_IRQ
	bool "Trusty IRQ support"
	default y
	help
	  Enable forwarding of IRQs from Linux to Trusty.  This driver retrieves
	  from Trusty a list of IRQs that Trusty uses, and it registers handlers
	  for them which notify Trusty that the IRQ has been received.

	  If you build the trusty core driver as a module, this will be part of the
	  trusty-core module.

	  Usually this is needed for Trusty to work, so say 'y'.

config TRUSTY_LOG
	tristate "Trusty log support"
	default y
	help
	  Print log messages generated by the secure OS to the Linux kernel log.

	  While this module is loaded, messages are retrieved and printed after
	  each call into Trusty, and also during Linux kernel panics.

	  If you build this as a module, it will be called trusty-log.

config TRUSTY_TEST
	tristate "Trusty stdcall test"
	default y
	help
	  Allow running tests of the Trusty stdcall interface.  Running these
	  tests is initiated by userspace writing to a sysfs file.

	  This depends on having a test sevice running on the Trusty side.

	  If you build this as a module, it will be called trusty-test.

config TRUSTY_VIRTIO
	tristate "Trusty virtio support"
	select VIRTIO
	default y
	help
	  Enable the Trusty virtio driver, which is responsible for management
	  and interaction with virtio devices exposed by Trusty.  This driver
	  requests the virtio device descriptors from Trusty, then parses them
	  and adds the corresponding virtio devices.

	  If you build this as a module, it will be called trusty-virtio.

config TRUSTY_VIRTIO_IPC
	tristate "Trusty Virtio IPC driver"
	depends on TRUSTY_VIRTIO
	default y
	help
	  Enable support for communicating with Trusty services.

	  If you build this as a module, it will be called trusty-ipc.

config TRUSTY_VIRTIO_POLL_VQUEUES
	bool "Poll the virtio queues periodically"
	depends on TRUSTY_VIRTIO
	help
	  Add an optional timer that polls the virtio queues periodically.
	  When enabled, this will add a device attribute that configures
	  the timer period for the polling. The attribute can be set to 0
	  to disable the timer dynamically.

	  This is needed when there is no signaling mechanism between
	  Linux and Trusty for virtio, e.g., when using FF-A to talk
	  between guest VMs and TrustZone without notification support.

config TRUSTY_DMA_BUF_FFA_TAG
	bool "Availability of trusty_dma_buf_get_ffa_tag"
	default n
	help
	  Whether trusty_dma_buf_get_ffa_tag is provided on this platform.
	  Providing this function will allow the platform to select what tag
	  should be passed to the SPM when attempting to transfer the buffer
	  to secure world. The value passed here is implementation defined and
	  may depend on your SPM.

	  If set to N, a default implementation which returns 0 will be used.

config TRUSTY_DMA_BUF_SHARED_MEM_ID
	bool "Availability of trusty_dma_buf_get_shared_mem_id"
	default n
	help
	  Whether trusty_dma_buf_get_shared_mem_id is provided on this platform.
	  Providing this function allows the platform to manage memory
	  transaction life cycle of DMA bufs independently of Trusty IPC driver.
	  The latter can query trusty_shared_mem_id_t value allocated for a
	  given DMA buf using trusty_dma_buf_get_shared_mem_id interface.

	  If set to N, a default implementation which does not allocate any IDs
	  will be used.

config TRUSTY_CRASH_IS_PANIC
	bool "When trusty panics, then panic the kernel"
	help
	 This option will treat Trusty panics as fatal.  This is useful if
	 your system cannot recover from Trusty panic/halt and you require
	 the system to reboot to recover.

	 If N, it will contine to run the kernel, but trusty operations will
	 return errors.

config TRUSTY_POPULATE
	tristate "Build a module that populates the Trusty devices"
	default m
	help
	  Build a module that will register some platform devices for
	  some of the other Trusty modules that guests need to use.
	  This is useful when the device tree does or can not contain
	  the nodes we need. The devices are populated on module insertion
	  and persist until trusty-populate.ko is removed.

	  If N, the modules require device tree nodes for probing.

endif # TRUSTY

endmenu
```

## drivers/usb/otg/Kconfig
```kconfig
config TRANSCEIVER_MXC_OTG
	tristate "USB OTG pin detect support"
	depends on (MC13783_MXC || ISP1504_MXC) && USB_GADGET && USB_EHCI_HCD && USB_OTG
	help
	  Support for USB OTG PIN detect on MXC platforms.

config UTMI_MXC_OTG
	tristate "USB OTG pin detect support for UTMI PHY"
	depends on  USB_EHCI_FSL_UTMI && USB_GADGET && USB_EHCI_HCD && USB_OTG
	help
	  Support for USB OTG PIN detect for UTMI PHY on MXC platforms.
```

## drivers/video/fbdev/imx/Kconfig
```kconfig
config FB_LCDIF
	tristate "lcdif framebuffer support"
	depends on FB_IMX64 && ARCH_FSL_IMX8MQ && FB_IMX_DISPDRV_ENC
	default y
	help
	  Framebuffer support for lcdif controller.

config FB_IMX_DISPDRV_ENC
	tristate "IMX dispdrv framework for encoders"
	depends on FB_IMX64 && ARCH_FSL_IMX8MQ
	default y
	help
	  IMX encoders driver framework which wo-work with IMX
	  framebuffer drivers.
```

## drivers/video/mxc/Kconfig
```kconfig
config FB_MXC
	tristate "MXC Framebuffer support"
	depends on FB && (MXC_IPU || ARCH_MX21 || ARCH_MX27 || ARCH_MX25)
	select FB_CFB_FILLRECT
	select FB_CFB_COPYAREA
	select FB_CFB_IMAGEBLIT
	select FB_MODE_HELPERS
	default y
	help
	  This is a framebuffer device for the MXC LCD Controller.
	  See <http://www.linux-fbdev.org/> for information on framebuffer
	  devices.

	  If you plan to use the LCD display with your MXC system, say
	  Y here.

config FB_MXC_SYNC_PANEL
	depends on FB_MXC
	tristate "Synchronous Panel Framebuffer"
	default y

config FB_MXC_EPSON_VGA_SYNC_PANEL
	depends on FB_MXC_SYNC_PANEL
	tristate "Epson VGA Panel"
	default n

config FB_MXC_TVOUT_TVE
	tristate "MXC TVE TV Out Encoder"
	depends on FB_MXC_SYNC_PANEL
	depends on MXC_IPU_V3

config FB_MXC_LDB
	tristate "MXC LDB"
	depends on FB_MXC_SYNC_PANEL
	depends on MXC_IPU_V3

config FB_MXC_CLAA_WVGA_SYNC_PANEL
	depends on FB_MXC_SYNC_PANEL
	tristate "CLAA WVGA Panel"

config FB_MXC_SEIKO_WVGA_SYNC_PANEL
	depends on FB_MXC_SYNC_PANEL
	tristate "SEIKO WVGA Panel"

config FB_MXC_SII9022
	depends on FB_MXC_SYNC_PANEL
	tristate "Si Image SII9022 DVI/HDMI Interface Chip"

config FB_MXC_CH7026
	depends on FB_MXC_SYNC_PANEL
	tristate "Chrontel CH7026 VGA Interface Chip"

config FB_MXC_TVOUT_CH7024
	tristate "CH7024 TV Out Encoder"
	depends on FB_MXC_SYNC_PANEL

config FB_MXC_LOW_PWR_DISPLAY
	bool "Low Power Display Refresh Mode"
	depends on FB_MXC_SYNC_PANEL && MXC_FB_IRAM
	default y

config FB_MXC_INTERNAL_MEM
	bool "Framebuffer in Internal RAM"
	depends on FB_MXC_SYNC_PANEL && MXC_FB_IRAM
	default y

config FB_MXC_ASYNC_PANEL
	depends on FB_MXC
	bool "Asynchronous Panels"
	default n

menu "Asynchronous Panel Type"
	depends on FB_MXC_ASYNC_PANEL && FB_MXC

config FB_MXC_EPSON_PANEL
    depends on FB_MXC_ASYNC_PANEL
	default n
	bool "Epson 176x220 Panel"

endmenu

config FB_MXC_EINK_PANEL
	depends on FB_MXC
	depends on DMA_ENGINE
	select FB_DEFERRED_IO
	tristate "E-Ink Panel Framebuffer"

config FB_MXC_EINK_AUTO_UPDATE_MODE
    bool "E-Ink Auto-update Mode Support"
    default n
    depends on FB_MXC_EINK_PANEL

config FB_MXC_ELCDIF_FB
	depends on FB && ARCH_MXC
	tristate "Support MXC ELCDIF framebuffer"

choice
	prompt "Async Panel Interface Type"
	depends on FB_MXC_ASYNC_PANEL && FB_MXC
	default FB_MXC_ASYNC_PANEL_IFC_16_BIT

config FB_MXC_ASYNC_PANEL_IFC_8_BIT
	bool "8-bit Parallel Bus Interface"

config FB_MXC_ASYNC_PANEL_IFC_16_BIT
	bool "16-bit Parallel Bus Interface"

config FB_MXC_ASYNC_PANEL_IFC_SERIAL
	bool "Serial Bus Interface"

endchoice
```

## drivers/video/mxs/Kconfig
```kconfig
config FB_MXS
	tristate "MXS Framebuffer driver"
	depends on FB && ARCH_MXS
	select FB_CFB_FILLRECT
	select FB_CFB_COPYAREA
	select FB_CFB_IMAGEBLIT
	default y
	---help---
	  Say Y here to enable support for the framebuffer driver for the
	  Freescale MXS Board.

config FB_MXS_LCD_43WVF1G
	depends on FB_MXS
	tristate "SEIKO 4.3' LCD WVGA(800x480) PANEL"
	default y if ARCH_MX28

config FB_MXS_LCD_LMS430
	depends on FB_MXS
	bool "LMS430"
	default y if ARCH_MX23
	---help---
	  Use LMS430 dotclock LCD panel for MXS

config FB_MXS_TVENC
	depends on ARCH_MXS
	bool "TVENC"
	---help---
	  Use TVOUT encoder for MXS
```

## drivers/virt/halla/Kconfig
```kconfig
# SPDX-License-Identifier: GPL-2.0-only
#
# Exynos HVM solutions
#

config EXYNOS_HVM
	tristate "Exynos Halla VM Management driver"
	depends on ARM64 && EVENTFD
	help
	  Exynos Halla VM Management(HVM) module.

	  This module supports the Guest VM to operate on the Halla hypervisor.
	  In addition, it interacts with the crosvm to manage and operate the
	  Guest VM.

	  Select M if you want it be built as a module (exynos-hvm.ko).

	  If unsure, say N.
```
