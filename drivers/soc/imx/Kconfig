## sound/arm/Kconfig
```kconfig
# ALSA ARM drivers

menuconfig SND_ARM
	bool "ARM sound devices"
	depends on ARM
	default y
	help
	  Support for sound devices specific to ARM architectures.
	  Drivers that are implemented on ASoC can be found in
	  "ALSA for SoC audio support" section.

if SND_ARM

config SND_ARMAACI
	tristate "ARM PrimeCell PL041 AC Link support"
	depends on ARM_AMBA
	select SND_PCM
	select SND_AC97_CODEC

config SND_PXA2XX_PCM
	tristate
	select SND_PCM

config SND_PXA2XX_LIB
	tristate
	select SND_AC97_CODEC if SND_PXA2XX_LIB_AC97

config SND_PXA2XX_LIB_AC97
	bool

config SND_PXA2XX_AC97
	tristate "AC97 driver for the Intel PXA2xx chip"
	depends on ARCH_PXA
	select SND_PXA2XX_PCM
	select SND_AC97_CODEC
	select SND_PXA2XX_LIB
	select SND_PXA2XX_LIB_AC97
	help
	  Say Y or M if you want to support any AC97 codec attached to
	  the PXA2xx AC97 interface.

config SND_MXC_SPDIF
        tristate "MXC SPDIF sound card spport"
        select SND_PCM
        help
          Say Y here to enable SPDIF sound card

config SND_MXC_PMIC
	tristate "MXC PMIC sound system"
	depends on ARCH_MXC && MXC_DAM && MXC_SSI && \
		(MXC_MC13783_AUDIO || MXC_PMIC_SC55112_AUDIO)
	default y
	select SND_PCM
	help
	  Say Y here to include support for soundcards based on the
	  MC13783 chip.

	  To compile this driver as a module, choose M here: the module
	  will be called snd-mc13783.

config  SND_MXC_PLAYBACK_MIXING
        bool "Playback Stream Mixing"
        depends on (!ARCH_MX27) && (!ARCH_MXC91131) && ARCH_MXC && MXC_DAM && MXC_SSI && \
                (MXC_MC13783_AUDIO)
        default n
        select SND_PCM
        help
          Say Y here to include support mixing for soundcards based on the
          MC13783 chip. This supports audio stream mixing on VCODEC for mc13783 based platforms.
	  Analog mixng as well as Digital mixing can be tested on these platforms.
	  As of now , mixing of mono files only are supported in Digital Mixing since it is done on VCODEC.
	  SSI 2 channel mode is used to mix 2 streams on a single SSI.  This is supported on all platforms except imx27ads(imx27ads - Analog mixing only).

config HEADSET_DETECT_ENABLE
        bool "Headset Detect Enable"
        depends on (!ARCH_MXC91131) && ARCH_MXC && MXC_DAM && MXC_SSI && \
                (MXC_MC13783_AUDIO)
        default n
        select SND_PCM
        help
        Say Y here to enable Headset Detect Feature.

config SND_MXC_PMIC_IRAM
        bool "MXC PMIC sound system supports IRAM"
        depends on SND_MXC_PMIC && SDMA_IRAM
        default n
        select SND_PCM
        help
          It will use IRAM as the DMA buffer of ALSA playback.

endif	# SND_ARM
```

## sound/soc/google/Kconfig
```kconfig
menu "SoC Audio for Google boards"

config SND_GOOGLE_EDGETPU_CARD
	tristate "Google Edge TPU sound card"
	depends on SND_SOC_RT5645
	help
	  Say Y if you want to add support for Google Edge TPU audio

endmenu
```

## sound/soc/imx/Kconfig
```kconfig
menuconfig SND_IMX_SOC
	tristate "SoC Audio for Freescale i.MX CPUs"
	depends on ARCH_MXC
	select SND_PCM
	select FIQ
	select SND_SOC_AC97_BUS
	help
	  Say Y or M if you want to add support for codecs attached to
	  the i.MX SSI interface.


if SND_IMX_SOC

config SND_MXC_SOC_ESAI
	tristate

config SND_MXC_SOC_FIQ
	tristate

config SND_MXC_SOC_MX2
	tristate

config SND_MXC_SOC_SPDIF_DAI
	tristate

config SND_MXC_SOC_WM1133_EV1
	tristate "Audio on the the i.MX31ADS with WM1133-EV1 fitted"
	depends on MACH_MX31ADS_WM1133_EV1 && EXPERIMENTAL
	select SND_SOC_WM8350
	select SND_MXC_SOC_FIQ
	help
	  Enable support for audio on the i.MX31ADS with the WM1133-EV1
	  PMIC board with WM8835x fitted.

config SND_SOC_MX27VIS_AIC32X4
	tristate "SoC audio support for Visstrim M10 boards"
	depends on MACH_IMX27_VISSTRIM_M10
	select SND_SOC_TVL320AIC32X4
	select SND_MXC_SOC_MX2
	help
	  Say Y if you want to add support for SoC audio on Visstrim SM10
	  board with TLV320AIC32X4 codec.

config SND_SOC_PHYCORE_AC97
	tristate "SoC Audio support for Phytec phyCORE (and phyCARD) boards"
	depends on MACH_PCM043 || MACH_PCA100
	select SND_SOC_WM9712
	select SND_MXC_SOC_FIQ
	help
	  Say Y if you want to add support for SoC audio on Phytec phyCORE
	  and phyCARD boards in AC97 mode

config SND_SOC_IMX_SGTL5000
	tristate "SoC Audio support for i.MX boards with sgtl5000"
	depends on I2C && (MACH_MX35_3DS || MACH_MX51_BABBAGE \
			|| MACH_MX6Q_SABRELITE || MACH_MX6Q_ARM2)
	select SND_SOC_SGTL5000
	select SND_MXC_SOC_MX2
	help
	  Say Y if you want to add support for SoC audio on an i.MX board with
	  a sgtl5000 codec.

config SND_SOC_IMX_WM8958
	tristate "SoC Audio support for IMX boards with WM8958"
	depends on MFD_WM8994
	select SND_MXC_SOC_MX2
	select SND_SOC_WM8994
	help
	  Say Y if you want to add support for SoC audio on an i.MX board with
	  a WM8958 codec.

config SND_SOC_IMX_CS42888
	tristate "SoC Audio support for i.MX boards with cs42888"
	depends on I2C && (MACH_MX6Q_ARM2 || MACH_MX6Q_SABREAUTO || MACH_MX53_ARD)
	select SND_SOC_CS42888
	select SND_MXC_SOC_MX2
	help
	  Say Y if you want to add support for SoC audio on an i.MX board with
	  a cs42888 codec

config SND_SOC_EUKREA_TLV320
	tristate "Eukrea TLV320"
	depends on MACH_EUKREA_MBIMX27_BASEBOARD \
		|| MACH_EUKREA_MBIMXSD25_BASEBOARD \
		|| MACH_EUKREA_MBIMXSD35_BASEBOARD \
		|| MACH_EUKREA_MBIMXSD51_BASEBOARD
	select SND_SOC_TLV320AIC23
	select SND_MXC_SOC_FIQ
	help
	  Enable I2S based access to the TLV320AIC23B codec attached
	  to the SSI interface

config SND_SOC_IMX_SPDIF
	tristate "SoC Audio support for IMX - S/PDIF"
	default n
	select SND_MXC_SOC_SPDIF_DAI
	select SND_SOC_MXC_SPDIF
	select SND_MXC_SOC_MX2
	help
	  Say Y if you want to add support for SoC audio on a IMX development
	  board with S/PDIF.

config SND_SOC_IMX_HDMI
	tristate "SoC Audio support for IMX - HDMI"
	default n
	select SND_SOC_MXC_HDMI
	select MFD_MXC_HDMI
	help
	  Say Y if you want to add support for SoC audio through IMX HDMI.

endif	# SND_IMX_SOC
```

## sound/soc/mxs/Kconfig
```kconfig
config SND_MXS_SOC
	tristate "SoC Audio for the MXS chips"
	depends on ARCH_MXS && SND_SOC
	select SND_PCM
	help
	  Say Y or M if you want to add support for codecs attached to
	  the MXS I2S or SSP interface.


config SND_MXS_SOC_SPDIF_DAI
	tristate

config SND_MXS_SOC_EVK_DEVB
	tristate "SoC Audio support for MXS-EVK SGTL5000"
	depends on SND_MXS_SOC && ARCH_MX28
	select SND_SOC_SGTL5000
	help
	  Say Y if you want to add support for SoC audio on MXS EVK development
	  board with the sgtl5000 codec.

config SND_MXS_SOC_EVK_ADC
	tristate "SoC Audio support for MXS-EVK ADC/DAC"
	depends on SND_MXS_SOC && ARCH_MX23
	select SND_SOC_MXS_ADC_CODEC
	help
	  Say Y if you want to add support for SoC audio on MXS EVK development
	  board with ADC/DAC audio interface.

config SND_MXS_SOC_DAI
	tristate "MXS Digital Audio Interface SAIF"
	default y
	depends on SND_MXS_SOC_EVK_DEVB
	help
	   Enable MXS Digital Audio Interface SAIF

config SND_MXS_SOC_ADC
	tristate "MXS ADC/DAC Audio Interface"
	default y
	depends on SND_MXS_SOC_EVK_ADC
	help
	  Enable MXS ADC/DAC Audio Interface

config SND_MXS_SOC_EVK_DEVB_SPDIF
	tristate "SoC SPDIF support for MXS EVK Development Board"
	default n
	depends on SND_MXS_SOC && ARCH_MXS
	select SND_MXS_SOC_SPDIF_DAI
	select SND_SOC_MXS_SPDIF
	help
	  Say Y if you want to add support for SoC audio on MXS EVK development
	  board with the SPDIF transmitter.
```

## sound/soc/stmp3xxx/Kconfig
```kconfig
config SND_STMP3XXX_SOC
	tristate "SoC Audio for the SigmaTel STMP3XXX chips"
	depends on ARCH_STMP3XXX && SND_SOC
	select SND_PCM
	help
	  Say Y or M if you want to add support for codecs embedded into
	  the STMP3XXX chips.

config SND_STMP3XXX_SOC_DAI
	tristate

config SND_STMP3XXX_SOC_SPDIF_DAI
	tristate

config SND_STMP3XXX_SOC_STMP3780_DEVB
	tristate "SoC Audio support for STMP3780 Development Board"
	depends on SND_STMP3XXX_SOC && ARCH_STMP378X
	select SND_STMP3XXX_SOC_DAI
	select SND_SOC_STMP378X_CODEC
	help
	  Say Y if you want to add support for SoC audio on stmp3780 development
	  board with the stmp378x codec.

config SND_STMP3XXX_SOC_STMP3780_DEVB_SPDIF
	tristate "SoC SPDIF support for STMP3780 Development Board"
	depends on SND_STMP3XXX_SOC && ARCH_STMP378X
	select SND_STMP3XXX_SOC_SPDIF_DAI
	select SND_SOC_STMP3XXX_SPDIF
	help
	  Say Y if you want to add support for SoC audio on stmp3780 development
	  board with the SPDIF transmitter.
```
