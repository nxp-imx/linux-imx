## Documentation/devicetree/bindings/arm/freescale/fsl,seco_mu.yaml
```yaml
# SPDX-License-Identifier: (GPL-2.0 OR BSD-2-Clause)
%YAML 1.2
---
$id: http://devicetree.org/schemas/arm/freescale/fsl,seco_mu.yaml#
$schema: http://devicetree.org/meta-schemas/core.yaml#

title: NXP i.MX8 SECO MU driver

maintainers:
  - Aisheng Dong <aisheng.dong@nxp.com>

description: |
  Create char devices in /dev as channels of the form /dev/seco_muXchY with X
  the id of the driver and Y for each users. It allows to send and receive
  messages to the SECO.

properties:
  compatible:
    enum:
      - fsl,imx-seco-mu

  mboxes:
    description:
      List of <&phandle type channel> - 4 channels for TX, 4 channels for RX,
      1 channel for TXDB (see mailbox/fsl,mu.txt)
    maxItems: 9

  mbox-names:
    items:
      - const: txdb
      - const: rxdb

  fsl,seco_mu_id:
    description:
      Identify the driver instance, used to create the channels, default to 1
    allOf:
      - $ref: /schemas/types.yaml#/definitions/uint32
      - enum: [0,1,2,3]

  fsl,seco_max_users:
    description:
      Number of channels to create, default to 4
    allOf:
      - $ref: /schemas/types.yaml#/definitions/uint32
      - enum: [0,1,2,3,4,5,6,7,8,9]

required:
  - compatible
  - mboxes
  - mbox-names

examples:
  - |
    seco_mu: seco_mu {
      compatible = "fsl,imx-seco-mu";
      mbox-names = "txdb", "rxdb";
      mboxes = <&mu 2 0
          &mu 3 0>;

      fsl,seco_mu_id = <1>;
      fsl,seco_max_users = <4>;
    };
```

## Documentation/devicetree/bindings/arm/imx/gpc.txt
```
Freescale imx GPC bindings

Optional properties:
- fsl,cpu_pupscr_sw2iso: for powering up CPU, number of 32K clock cycle PGC will wait before negating isolation signal.
- fsl,cpu_pupscr_sw: for powering up CPU, number of 32K clock cycle PGC will wait before asserting isolation signal.
- fsl,cpu_pdnscr_iso2sw: for powering down CPU, number of ipg clock cycle PGC will wait before negating isolation signal.
- fsl,cpu_pdnscr_iso: for powering down CPU, number of ipg clock cycle PGC will wait before asserting isolation signal.

These properties are for adjusting the GPC PGC CPU power up/down setting, if there is no such property in dts, then default
value in GPC PGC registers will be used.

- fsl,mf-mix-wakeup-irq: for recording those wakeup sources' irq number in fast/mega mix domain, same as GPC_IMRx register layout.
If the bitmap in this properties is 1, then fast/mega mix's power can NOT be gated if it is set as wakeup source in kernel.

Example:

	gpc: gpc@020dc000 {
		fsl,mf-mix-wakeup-irq = <0x4000000 0x3d00 0x0 0x0>;
	};

	&gpc {
		fsl,cpu_pupscr_sw2iso = <0xf>;
		fsl,cpu_pupscr_sw = <0xf>;
		fsl,cpu_pdnscr_iso2sw = <0x1>;
		fsl,cpu_pdnscr_iso = <0x1>;
	};
```

## Documentation/devicetree/bindings/clock/imx6sx-clock.txt
```
* Clock bindings for Freescale i.MX6 SoloX

Required properties:
- compatible: Should be "fsl,imx6sx-ccm"
- reg: Address and length of the register set
- #clock-cells: Should be <1>

The clock consumer should specify the desired clock by having the clock
ID in its "clocks" phandle cell.  See include/dt-bindings/clock/imx6sx-clock.h
for the full list of i.MX6 SoloX clock IDs.
```

## Documentation/devicetree/bindings/display/bridge/nwl-dsi.yaml
```yaml
# SPDX-License-Identifier: GPL-2.0
%YAML 1.2
---
$id: http://devicetree.org/schemas/display/bridge/nwl-dsi.yaml#
$schema: http://devicetree.org/meta-schemas/core.yaml#

title: Northwest Logic MIPI-DSI controller on i.MX SoCs

maintainers:
  - Guido Gúnther <agx@sigxcpu.org>
  - Robert Chiras <robert.chiras@nxp.com>

description: |
  NWL MIPI-DSI host controller found on i.MX8 platforms. This is a dsi bridge for
  the SOCs NWL MIPI-DSI host controller.

properties:
  compatible:
    const: fsl,imx8mq-nwl-dsi

  reg:
    maxItems: 1

  interrupts:
    maxItems: 1

  clocks:
    items:
      - description: DSI core clock
      - description: RX_ESC clock (used in escape mode)
      - description: TX_ESC clock (used in escape mode)
      - description: PHY_REF clock
      - description: VIDEO_PLL clock
      - description: PHY_PARENT clock (optional)

  clock-names:
    items:
      - const: core
      - const: rx_esc
      - const: tx_esc
      - const: phy_ref
      - const: video_pll
      - const: phy_parent

  mux-controls:
    description:
      mux controller node to use for operating the input mux

  phys:
    maxItems: 1
    description:
      A phandle to the phy module representing the DPHY

  phy-names:
    items:
      - const: dphy

  power-domains:
    maxItems: 1
    description:
      A phandle to the power domain

  resets:
    description:
      phandles to the reset controller
    items:
      - description: dsi byte reset line
      - description: dsi dpi reset line
      - description: dsi esc reset line
      - description: dsi pclk reset line

  reset-names:
    items:
      - const: byte
      - const: dpi
      - const: esc
      - const: pclk

  ports:
    type: object
    description:
      A node containing DSI input & output port nodes with endpoint
      definitions as documented in
      Documentation/devicetree/bindings/graph.txt.

  port@0:
    type: object
    description:
      Input port node to receive pixel data from the
      display controller

  port@1:
    type: object
    description:
      DSI output port node to the panel or the next bridge
      in the chain

  fsl,clock-drop-level:
    description:
      Specifies the level at wich the crtc_clock should be dropped

patternProperties:
  "^panel@[0-9]+$": true

required:
  - clock-names
  - clocks
  - compatible
  - interrupts
  - mux-controls
  - phy-names
  - phys
  - ports
  - reg
  - reset-names
  - resets

examples:
 - |

   mipi_dsi: mipi_dsi@30a00000 {
              #address-cells = <1>;
              #size-cells = <0>;
              compatible = "fsl,imx8mq-nwl-dsi";
              reg = <0x30A00000 0x300>;
              clocks = <&clk 163>, <&clk 244>, <&clk 245>, <&clk 164>;
              clock-names = "core", "rx_esc", "tx_esc", "phy_ref";
              interrupts = <0 34 4>;
              mux-controls = <&mux 0>;
              power-domains = <&pgc_mipi>;
              resets = <&src 0>, <&src 1>, <&src 2>, <&src 3>;
              reset-names = "byte", "dpi", "esc", "pclk";
              phys = <&dphy>;
              phy-names = "dphy";

              panel@0 {
                      compatible = "rocktech,jh057n00900";
                      reg = <0>;
                      port@0 {
                           panel_in: endpoint {
                                     remote-endpoint = <&mipi_dsi_out>;
                           };
                      };
              };

              ports {
                    #address-cells = <1>;
                    #size-cells = <0>;

                    port@0 {
                           reg = <0>;
                           mipi_dsi_in: endpoint {
                                        remote-endpoint = <&lcdif_mipi_dsi>;
                           };
                    };
                    port@1 {
                           reg = <1>;
                           mipi_dsi_out: endpoint {
                                         remote-endpoint = <&panel_in>;
                           };
                    };
              };
      };
```

## Documentation/devicetree/bindings/display/imx/fsl-imx-drm.txt
```
Freescale i.MX DRM master device
================================

The freescale i.MX DRM master device is a virtual device needed to list all
IPU or other display interface nodes that comprise the graphics subsystem.

Required properties:
- compatible: Should be "fsl,imx-display-subsystem"
- ports: Should contain a list of phandles pointing to display interface ports
  of IPU devices

example:

display-subsystem {
	compatible = "fsl,display-subsystem";
	ports = <&ipu_di0>;
};


Freescale i.MX IPUv3
====================

Required properties:
- compatible: Should be "fsl,<chip>-ipu"
- reg: should be register base and length as documented in the
  datasheet
- interrupts: Should contain sync interrupt and error interrupt,
  in this order.
- resets: phandle pointing to the system reset controller and
          reset line index, see reset/fsl,imx-src.txt for details
Optional properties:
- port@[0-3]: Port nodes with endpoint definitions as defined in
  Documentation/devicetree/bindings/media/video-interfaces.txt.
  Ports 0 and 1 should correspond to CSI0 and CSI1,
  ports 2 and 3 should correspond to DI0 and DI1, respectively.

example:

ipu: ipu@18000000 {
	#address-cells = <1>;
	#size-cells = <0>;
	compatible = "fsl,imx53-ipu";
	reg = <0x18000000 0x080000000>;
	interrupts = <11 10>;
	resets = <&src 2>;

	ipu_di0: port@2 {
		reg = <2>;

		ipu_di0_disp0: endpoint {
			remote-endpoint = <&display_in>;
		};
	};
};

Freescale i.MX DPU
====================

Required properties:
- compatible: Should be "fsl,<chip>-dpu"
- reg: should be register base and length as documented in the
  datasheet
- intsteer: phandle pointing to interrupt steer.
- interrupts, interrupt-names: Should contain interrupts and names as
  documented in the datasheet.
- clocks, clock-names: phandles to the DPU clocks described in
  Documentation/devicetree/bindings/clock/clock-bindings.txt
  The following clocks are expected on i.MX8qm and i.MX8qxp:
           "pll0" - PLL clock for display interface 0
           "pll1" - PLL clock for display interface 1
           "disp0" - pixel clock for display interface 0
           "disp1" - pixel clock for display interface 1
  The needed clock numbers for each are documented in
  Documentation/devicetree/bindings/clock/imx8qm-clock.txt, and in
  Documentation/devicetree/bindings/clock/imx8qxp-clock.txt.
- power-domains: phandle pointing to power domain.
Optional properties:
- port@[0-1]: Port nodes with endpoint definitions as defined in
  Documentation/devicetree/bindings/media/video-interfaces.txt.
  ports 0 and 1 should correspond to display interface 0 and
  display interface 1, respectively.

example:

dpu: dpu@56180000 {
	#address-cells = <1>;
	#size-cells = <0>;
	compatible = "fsl,imx8qm-dpu";
	reg = <0x0 0x56180000 0x0 0x40000>;
	intsteer = <&dpu1_intsteer>;
	interrupts = <GIC_SPI 40 IRQ_TYPE_LEVEL_HIGH>,
		     <GIC_SPI 41 IRQ_TYPE_LEVEL_HIGH>,
		     <GIC_SPI 42 IRQ_TYPE_LEVEL_HIGH>,
		     <GIC_SPI 43 IRQ_TYPE_LEVEL_HIGH>,
		     <GIC_SPI 44 IRQ_TYPE_LEVEL_HIGH>,
		     <GIC_SPI 45 IRQ_TYPE_LEVEL_HIGH>,
		     <GIC_SPI 46 IRQ_TYPE_LEVEL_HIGH>,
		     <GIC_SPI 47 IRQ_TYPE_LEVEL_HIGH>;
	interrupt-names = "irq_common",
			  "irq_stream0a",
			  "irq_stream0b",
			  "irq_stream1a",
			  "irq_stream1b",
			  "irq_reserved0",
			  "irq_reserved1",
			  "irq_blit";
	clocks = <&clk IMX8QM_DC0_PLL0_CLK>,
		 <&clk IMX8QM_DC0_PLL1_CLK>,
		 <&clk IMX8QM_DC0_DISP0_CLK>,
		 <&clk IMX8QM_DC0_DISP1_CLK>;
	clock-names = "pll0", "pll1", "disp0", "disp1";
	power-domains = <&pd_dc0>;

	dpu1_disp1: port@1 {
		reg = <1>;

		dpu1_disp1_lvds0: lvds0-endpoint {
			remote-endpoint = <&ldb1_lvds0>;
		};

		dpu1_disp1_lvds1: lvds1-endpoint {
			remote-endpoint = <&ldb1_lvds1>;
		};
	};
};

Parallel display support
========================

Required properties:
- compatible: Should be "fsl,imx-parallel-display"
Optional properties:
- interface_pix_fmt: How this display is connected to the
  display interface. Currently supported types: "rgb24", "rgb565", "bgr666"
  and "lvds666".
- edid: verbatim EDID data block describing attached display.
- ddc: phandle describing the i2c bus handling the display data
  channel
- port@[0-1]: Port nodes with endpoint definitions as defined in
  Documentation/devicetree/bindings/media/video-interfaces.txt.
  Port 0 is the input port connected to the IPU display interface,
  port 1 is the output port connected to a panel.

example:

display@di0 {
	compatible = "fsl,imx-parallel-display";
	edid = [edid-data];
	interface-pix-fmt = "rgb24";

	port@0 {
		reg = <0>;

		display_in: endpoint {
			remote-endpoint = <&ipu_di0_disp0>;
		};
	};

	port@1 {
		reg = <1>;

		display_out: endpoint {
			remote-endpoint = <&panel_in>;
		};
	};
};

panel {
	...

	port {
		panel_in: endpoint {
			remote-endpoint = <&display_out>;
		};
	};
};
```

## Documentation/devicetree/bindings/display/imx/nxp,imx94-dcif.yaml
```yaml
# SPDX-License-Identifier: (GPL-2.0 OR BSD-2-Clause)
# Copyright 2025 NXP
%YAML 1.2
---
$id: http://devicetree.org/schemas/display/imx/nxp,imx94-dcif.yaml#
$schema: http://devicetree.org/meta-schemas/core.yaml#

title: i.MX94 Display Control Interface (DCIF)

maintainers:
  - Laurentiu Palcu <laurentiu.palcu@oss.nxp.com>

description:
  The Display Control Interface(DCIF) is a system master that fetches graphics
  stored in memory and displays them on a TFT LCD panel or connects to a
  display interface depending on the chip configuration.

properties:
  compatible:
    const: nxp,imx94-dcif

  reg:
    maxItems: 1

  interrupts:
    items:
      - description:
          Interrupt output for CPU domain 0 (controlled by common registers group).
      - description:
          Interrupt output for CPU domain 1 (controlled by background layer registers group).
      - description:
          Interrupt output for CPU domain 2 (controlled by foreground layer registers group).

  interrupt-names:
    items:
      - const: common
      - const: bg_layer
      - const: fg_layer

  clocks:
    items:
      - description: APB bus clock
      - description: AXI bus clock
      - description: Pixel clock

  clock-names:
    items:
      - const: apb
      - const: axi
      - const: pix

  assigned-clocks:
    description: Reference to DISPLAYMIX CSR clock mux.
    maxItems: 1

  assigned-clock-parents:
    description: Parent of the clock mux.
    maxItems: 1

  power-domains:
    maxItems: 1

  nxp,blk-ctrl:
    $ref: /schemas/types.yaml#/definitions/phandle
    description: A phandle which points to NXP displaymix blk-ctrl.

  port:
    $ref: /schemas/graph.yaml#/properties/port
    description: Display Pixel Interface(DPI) output port

additionalProperties: false

examples:
  - |
    #include <dt-bindings/interrupt-controller/arm-gic.h>

    soc {
        #address-cells = <2>;
        #size-cells = <2>;

        display-controller@4b120000 {
            compatible = "nxp,imx94-dcif";
            reg = <0x0 0x4b120000 0x0 0x300000>;
            interrupts = <GIC_SPI 377 IRQ_TYPE_LEVEL_HIGH>,
                         <GIC_SPI 378 IRQ_TYPE_LEVEL_HIGH>,
                         <GIC_SPI 379 IRQ_TYPE_LEVEL_HIGH>;
            interrupt-names = "common", "bg_layer", "fg_layer";
            clocks = <&scmi_clk 69>, <&scmi_clk 70>, <&dispmix_csr 0>;
            clock-names = "apb", "axi", "pix";
            assigned-clocks = <&dispmix_csr 0>;
            assigned-clock-parents = <&ldb_pll_pixel>;
            power-domains = <&scmi_devpd 11>;
            nxp,blk-ctrl = <&dispmix_csr>;

            port {
                dcif_out: endpoint {
                    remote-endpoint = <&ldb_in>;
                };
            };
        };
    };
```
