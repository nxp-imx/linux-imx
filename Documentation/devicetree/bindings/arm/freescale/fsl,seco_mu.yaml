## Documentation/devicetree/bindings/display/mxsfb.txt
```
* Freescale MXS LCD Interface (LCDIF)

Required properties:
- compatible: Should be "fsl,<chip>-lcdif".  Supported chips include
  imx23 and imx28.
- reg: Address and length of the register set for lcdif
- interrupts: Should contain lcdif interrupts
- display : phandle to display node (see below for details)

Optional properties:
- disp-dev: Display device driver name
- disp-videomode: Display device video mode name; this is used if the panel
  supports multiple video modes, in order to chose the right one (see below for
  examples)

* display node

Required properties:
- bits-per-pixel : <16> for RGB565, <32> for RGB888/666.
- bus-width : number of data lines.  Could be <8>, <16>, <18> or <24>.

Required sub-node:
- display-timings : Refer to binding doc display-timing.txt for details.

Examples:

lcdif@80030000 {
	compatible = "fsl,imx28-lcdif";
	reg = <0x80030000 2000>;
	interrupts = <38 86>;

	display: display {
		bits-per-pixel = <32>;
		bus-width = <24>;

		display-timings {
			native-mode = <&timing0>;
			timing0: timing0 {
				clock-frequency = <33500000>;
				hactive = <800>;
				vactive = <480>;
				hfront-porch = <164>;
				hback-porch = <89>;
				hsync-len = <10>;
				vback-porch = <23>;
				vfront-porch = <10>;
				vsync-len = <10>;
				hsync-active = <0>;
				vsync-active = <0>;
				de-active = <1>;
				pixelclk-active = <0>;
			};
		};
	};
};

Examples - optional properties:

Snippet from imx7d-sdb-mipi-dsi.dts:

&lcdif {
	disp-dev = "mipi_dsi_samsung";
	disp-videomode = "TRUULY-WVGA-SYNC-LOW";
};

&mipi_dsi {
	pinctrl-names = "default";
	pinctrl-0 = <&pinctrl_mipi_dsi_reset>;
	lcd_panel = "TRULY-WVGA-TFT3P5581E";
	resets = <&mipi_dsi_reset>;
	status = "okay";
};

In the above example, the panel supports 2 video modes (snippet from
drivers/video/fbdev/mxc/mxcfb_hx8363_wvga.c):

#define ACTIVE_HIGH_NAME	"TRUULY-WVGA-SYNC-HIGH"
#define ACTIVE_LOW_NAME		"TRUULY-WVGA-SYNC-LOW"

static struct fb_videomode truly_lcd_modedb[] = {
	{
		ACTIVE_HIGH_NAME, 50, 480, 854, 41042,
		40, 60,
		3, 3,
		8, 4,
		0x0,
		FB_VMODE_NONINTERLACED,
		0,
	}, {
		ACTIVE_LOW_NAME, 50, 480, 854, 41042,
		40, 60,
		3, 3,
		8, 4,
		FB_SYNC_OE_LOW_ACT,
		FB_VMODE_NONINTERLACED,
		0,
	},
};
```

## Documentation/devicetree/bindings/display/panel/ontat,kd50g21-40nt-a1.yaml
```yaml
# SPDX-License-Identifier: GPL-2.0
%YAML 1.2
---
$id: http://devicetree.org/schemas/display/panel/ontat,kd50g21-40nt-a1.yaml#
$schema: http://devicetree.org/meta-schemas/core.yaml#

title: On Tat Industrial Company 5" WVGA DPI TFT LCD panel

maintainers:
  - Liu Ying <victor.liu@nxp.com>

allOf:
  - $ref: panel-common.yaml#

properties:
  compatible:
    const: ontat,kd50g21-40nt-a1

  enable-gpios: true
  power-supply: true
  backlight: true
  port: true

required:
  - compatible
  - power-supply

additionalProperties: false

examples:
  - |
    #include <dt-bindings/gpio/gpio.h>
    panel {
      compatible = "ontat,kd50g21-40nt-a1";
      enable-gpios = <&pcal6524 22 GPIO_ACTIVE_HIGH>;
      power-supply = <&vdd_lcd_reg>;

      port {
        panel_in: endpoint {
          remote-endpoint = <&display_out>;
        };
      };
    };

...
```

## Documentation/devicetree/bindings/dma/fsl,imx-pxp-dma.yaml
```yaml
# SPDX-License-Identifier: (GPL-2.0-only OR BSD-2-Clause)
%YAML 1.2
---
$id: http://devicetree.org/schemas/dma/fsl,imx-pxp-dma.yaml#
$schema: http://devicetree.org/meta-schemas/core.yaml#

title: Freescale Pixel Processing Pipeline

maintainers:
  - Guoniu Zhou <guoniu.zhou@nxp.com>
  - Robby Cai <robby.cai@nxp.com>

description:
  Pixel Processing Pipeline (PXP) used to process graphics buffers or
  composite video and graphics data with DMA engines. Then the data
  can be send to an LCD display or TV encoder. It support two paths
  to process image data. One is primary path and the other is second
  path, both of them support CSC, Rotation, Composite, Alpha blending/
  Color key. Only primary path support Scaling. Except that, the second
  path can't support rotate image after composite or alpha blending.

properties:
  compatible:
    enum:
      - fsl,imx6ull-pxp-dma
      - fsl,imx7d-pxp-dma
      - fsl,imx8ulp-pxp-dma
      - fsl,imx93-pxp-dma
      - fsl,imx94-pxp-dma

  reg:
    maxItems: 1

  interrupts:
    minItems: 1
    maxItems: 2

  clocks:
    items:
      - description: The AXI clock
      - description: The IPG clock

  clock-names:
    items:
      - const: pxp_axi
      - const: pxp_ipg

  power-domains:
    maxItems: 1

required:
  - compatible
  - reg
  - interrupts
  - clocks
  - clock-names

additionalProperties: false

examples:
  - |
    #include <dt-bindings/clock/imx93-clock.h>
    #include <dt-bindings/interrupt-controller/arm-gic.h>
    #include <dt-bindings/power/fsl,imx93-power.h>

    epxp: epxp@4ae20000 {
        compatible = "fsl,imx93-pxp-dma";
        reg = <0x4ae20000 0x10000>;
        interrupts = <GIC_SPI 173 IRQ_TYPE_LEVEL_HIGH>,
                     <GIC_SPI 174 IRQ_TYPE_LEVEL_HIGH>;
        clocks = <&clk IMX93_CLK_MEDIA_AXI>,
                 <&clk IMX93_CLK_MEDIA_APB>;
        clock-names = "pxp_axi", "pxp_ipg";
        power-domains = <&media_blk_ctrl IMX93_MEDIABLK_PD_PXP>;
    };
```

## Documentation/devicetree/bindings/dma/fsl-edma-v3.txt
```
* Freescale enhanced Direct Memory Access(eDMA-v3) Controller

  The eDMA-v3 controller is inherited from FSL eDMA, and firstly is intergrated
  on Freescale i.MX8QM SOC chip. The eDMA channels have multiplex capability by
  programmble memory-mapped registers. Specific DMA request source has fixed channel.

* eDMA Controller
Required properties:
- compatible :
	- "fsl,imx8qm-edma" for eDMA used similar to that on i.MX8QM SoC
	- "fsl,imx8qm-adma" for audio eDMA used on i.MX8QM
	- "fsl,imx8ulp-edma" for eDMA used on i.MX8ULP
- reg : Specifies base physical address(s) and size of the eDMA channel registers.
	Each eDMA channel has separated register's address and size. The first one
	is Manage Page address space.
- interrupts : A list of interrupt-specifiers, each channel has one interrupt.
- interrupt-names : Should contain below template:
	"edmaX-chanX-Xx"
	     |     | |---> receive/transmit, r or t
	     |     |---> channel id, the max number is 32
	     |---> edma controller instance, 0, 1, 2,..etc

- #dma-cells : Must be <3>.
	The 1st cell specifies the channel ID, but source/event id on i.mx8ulp
	The 2nd cell specifies the channel priority.
	The 3rd cell specifies the channel attributes which include below:
	BIT(0): transmit or receive:
		0: transmit, 1: receive.
	BIT(1): local or remote access:
		0: local, 1: remote.
	BIT(2): dualfifo case or not(only in Audio cyclic now):
		0: not dual fifo case, 1: dualfifo case.
	See the SoC's reference manual for all the supported request sources.
- dma-channels : Number of channels supported by the controller

Optional properties :
- power-domains: Power domains for edma channel used.
- power-domain-names: Power domains name for edma channel used.
- clocks : A list of phandle and clock-specifier pairs, one for each entry in
	clock-names. The first one is for Manage Page
- clock-names : A list of channel clock names.

Examples:
edma0: dma-controller@40018000 {
	compatible = "fsl,imx8qm-edma";
	reg = <0x0 0x5a2c0000 0x0 0x10000>, /* channel12 UART0 rx */
	      <0x0 0x5a2d0000 0x0 0x10000>, /* channel13 UART0 tx */
	      <0x0 0x5a2e0000 0x0 0x10000>, /* channel14 UART1 rx */
	      <0x0 0x5a2f0000 0x0 0x10000>; /* channel15 UART1 tx */
	#dma-cells = <3>;
	dma-channels = <4>;
	interrupts = <GIC_SPI 434 IRQ_TYPE_LEVEL_HIGH>,
		     <GIC_SPI 435 IRQ_TYPE_LEVEL_HIGH>,
		     <GIC_SPI 436 IRQ_TYPE_LEVEL_HIGH>,
		     <GIC_SPI 437 IRQ_TYPE_LEVEL_HIGH>;
	interrupt-names = "edma0-chan12-rx", "edma0-chan13-tx",
			  "edma0-chan14-rx", "edma0-chan15-tx";
	power-domains = <&pd IMX_SC_R_DMA_0_CH12>,
			<&pd IMX_SC_R_DMA_0_CH13>,
			<&pd IMX_SC_R_DMA_0_CH14>,
			<&pd IMX_SC_R_DMA_0_CH15>;
	power-domain-names = "edma0-chan12", "edma0-chan13",
			     "edma0-chan14", "edma0-chan15";
	status = "okay";
};

or i.mx8ulp:
	edma1: dma-controller@29010000 {
		compatible = "fsl,imx8ulp-edma";
		reg = <0x29010000 0x10000>,
		      <0x29020000 0x10000>,
		      <0x29030000 0x10000>;
		#dma-cells = <3>;
		dma-channels = <2>;
		interrupts = <GIC_SPI 0 IRQ_TYPE_LEVEL_HIGH>,
			     <GIC_SPI 1 IRQ_TYPE_LEVEL_HIGH>;
		interrupt-names = "edma1-chan0-tx",
				  "edma1-chan1-tx";
		clocks = <&pcc3 IMX8ULP_CLK_DMA1_MP>,
			 <&pcc3 IMX8ULP_CLK_DMA1_CH0>,
			 <&pcc3 IMX8ULP_CLK_DMA1_CH1>;
		clock-names = "edma-mp-clk",
			      "edma1-chan0-clk",
			      "edma1-chan1-clk";
		status = "okay";
	};

* DMA clients
DMA client drivers that uses the DMA function must use the format described
in the dma.txt file, using a three-cell specifier for each channel: the 1st
specifies the channel number, the 2nd specifies the priority, and the 3rd
specifies the channel type is for transmit or receive: 0: transmit, 1: receive.

Examples:
lpuart1: serial@5a070000 {
	compatible = "fsl,imx8qm-lpuart";
	reg = <0x0 0x5a070000 0x0 0x1000>;
	interrupts = <GIC_SPI 226 IRQ_TYPE_LEVEL_HIGH>;
	interrupt-parent = <&gic>;
	clocks = <&clk IMX8QM_UART1_CLK>;
	clock-names = "ipg";
	assigned-clock-names = <&clk IMX8QM_UART1_CLK>;
	assigned-clock-rates = <80000000>;
	power-domains = <&pd IMX_SC_R_UART_1>,
	power-domain-names = "uart";
	dma-names = "tx","rx";
	dmas = <&edma0 15 0 0>,
		<&edma0 14 0 1>;
	status = "disabled";
};

or i.mx8ulp:
lpuart5: serial@293a0000 {
	compatible = "fsl,imx8ulp-lpuart", "fsl,imx7ulp-lpuart";
	reg = <0x293a0000 0x1000>;
	interrupts = <GIC_SPI 100 IRQ_TYPE_LEVEL_HIGH>;
	clocks = <&pcc3 IMX8ULP_CLK_LPUART5>;
	clock-names = "ipg";
	assigned-clocks = <&pcc3 IMX8ULP_CLK_LPUART5>;
	assigned-clock-parents = <&cgc1 IMX8ULP_CLK_LPOSC>;
	assigned-clock-rates = <24000000>;
	dmas = <&edma1 58 0 0>, <&edma1 57 0 1>;
	dma-names = "tx","rx";

	status = "okay";
};
```

## Documentation/devicetree/bindings/fb/mxsfb.txt
```
* Freescale MXS LCD Interface (LCDIF)

Required properties:
- compatible: Should be "fsl,<chip>-lcdif".  Supported chips include
  imx23 and imx28.
- reg: Address and length of the register set for lcdif
- interrupts: Should contain lcdif interrupts
- display : phandle to display node (see below for details)

Optional sub-node:
These properties are required only when driving LCD panels directly:
- pinctrl-names: Should be "default"
- pinctrl-0: pinctrl setting for lcd
- lcd-supply: lcd power supply, usually via GPIO

This property is required only when driving LDB:
- disp-dev: Should be "ldb".

* display node

Required properties:
- bits-per-pixel : <16> for RGB565, <32> for RGB888/666.
- bus-width : number of data lines.  Could be <8>, <16>, <18> or <24>.

Optional sub-node:
- display-timings : Refer to binding doc display-timing.txt for details.
  This property is required only when driving LCD panels directly.

Examples:

lcdif@80030000 {
	compatible = "fsl,imx28-lcdif";
	reg = <0x80030000 2000>;
	interrupts = <38 86>;
	pinctrl-names = "default";
	pinctrl-0 = <&lcdif_24bit_pins_a
		     &lcdif_pins_evk>;
	lcd-supply = <&reg_lcd_3v3>;

	display: display {
		bits-per-pixel = <32>;
		bus-width = <24>;

		display-timings {
			native-mode = <&timing0>;
			timing0: timing0 {
				clock-frequency = <33500000>;
				hactive = <800>;
				vactive = <480>;
				hfront-porch = <164>;
				hback-porch = <89>;
				hsync-len = <10>;
				vback-porch = <23>;
				vfront-porch = <10>;
				vsync-len = <10>;
				hsync-active = <0>;
				vsync-active = <0>;
				de-active = <1>;
				pixelclk-active = <0>;
			};
		};
	};
};
```

## Documentation/devicetree/bindings/input/snvs-pwrkey.txt
```
* Freescale i.MX SNVS powerkey device tree bindings

The snvs-pwrkey is designed to enable POWER key function which controlled
by SNVS ONOFF, the driver can report the status of POWER key and wakeup
system if pressed after system suspend.

Required SoC Specific Properties:
- compatible: Should be "fsl,imx6sx-snvs-pwrkey".

- reg: Physical base address of the SNVS and length of memory mapped
  region.

- interrupts: The SNVS interrupt number to the CPU(s).

- fsl,keycode: Keycode to emit, KEY_POWER by default.

- fsl,wakeup: Button can wake-up the system

Example:
snvs-pwrkey@0x020cc000 {
	compatible = "fsl,imx6sx-snvs-pwrkey";
	reg = <0x020cc000 0x4000>;
	interrupts = <0 4 0x4>;
	fsl,keycode = <116>; /* KEY_POWER */
	fsl,wakeup;
};
```

## Documentation/devicetree/bindings/input/touchscreen/elan-ts.txt
```
* ELAN Resistive Touch Controller

Required properties:
- compatible: must be "elan,elan-touch"
- reg: i2c slave address
- interrupt-parent: the phandle for the interrupt controller
- interrupts: touch controller interrupt
- gpio_elan_cs: the gpio pin for chip select
- gpio_elan_rst: the gpio pin for chip reset
- gpio_intr: the gpio pin to be used for interrupt pin

Example:

	elan@10 {
		compatible = "elan,elan-touch";
		reg = <0x10>;
		interrupt-parent = <&gpio3>;
		interrupts = <28 3>;
		gpio_elan_cs = <&gpio2 18 0>;
		gpio_elan_rst = <&gpio3 8 0>;
		gpio_intr = <&gpio3 28 0>;
		status = "okay";
	};
```

## Documentation/devicetree/bindings/leds/leds-pca995x.txt
```
* NXP - pca995x LED driver

The PCA995x family of chips are  I2C-bus controlled 16-channel
constant current LED driver optimized for dimming and blinking
57 mA Red/Green/Blue/Amber (RGBA) LEDs.
Note that the top side markings of the pca995x chips are PCA9952
and PCA9955.

Required properties:
- compatible : should be one of :
	"nxp,pca9955btw"
	"nxp,pca995xtw"
- #address-cells: must be 1
- #size-cells: must be 0
- reg: I2C slave address. depends on the model and HW connections.

Optional properties:
- reset-gpios: use a GPIO to control the reset line of the chip.

LED sub-node properties:
- reg : number of LED line.
		from 0 to 15 for the both pca9955btw & pca995xtw
- label : (optional)
	see Documentation/devicetree/bindings/leds/common.txt
- linux,default-trigger : (optional)
	see Documentation/devicetree/bindings/leds/common.txt

Examples:

/* TechNexion's voice HAT board */
pca995tw: pca995xtw@60 {
	#address-cells = <1>;
	#size-cells = <0>;
	compatible = "nxp,pca995xtw";
	reset-gpios = <&gpio5 7 GPIO_ACTIVE_HIGH>;
	reg = <0x60>;

	led0 {
		label = "blue0";
		linux,default-trigger = "none";
		reg = <0>;
	};

	led1 {
		label = "green0";
		linux,default-trigger = "none";
		reg = <1>;
	};

	led2 {
		label = "red0";
		linux,default-trigger = "none";
		reg = <2>;
	};
};

/* NXP's 8MIC board */
pca995btw: pca995btw@7 {
	#address-cells = <1>;
	#size-cells = <0>;
	compatible = "nxp,pca995btw";
	reg = <0x07>;

	led0 {
		label = "green0";
		linux,default-trigger = "none";
		reg = <0>;
	};

	led1 {
		label = "blue0";
		linux,default-trigger = "none";
		reg = <1>;
	};

	led2 {
		label = "red0";
		linux,default-trigger = "none";
		reg = <2>;
	};

	led3 {
		label = "green1";
		linux,default-trigger = "none";
		reg = <3>;
	};
};

For more information please check the information bellow:
https://www.nxp.com/docs/en/data-sheet/PCA9952_PCA9955.pdf
https://www.nxp.com/docs/en/data-sheet/PCA9955B.pdf
```
