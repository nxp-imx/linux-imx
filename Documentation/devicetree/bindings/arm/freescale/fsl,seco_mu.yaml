## Documentation/devicetree/bindings/net/fsl,backplane-anlt.yaml
```yaml
# SPDX-License-Identifier: GPL-2.0+
%YAML 1.2
---
$id: http://devicetree.org/schemas/net/fsl,backplane-anlt.yaml#
$schema: http://devicetree.org/meta-schemas/core.yaml#

title: Freescale Backplane Ethernet PHY

maintainers:
  - Vladimir Oltean <vladimir.oltean@nxp.com>

description: |
  Some QorIQ and Layerscape SoCs have an additional block on each SerDes
  networking lane, based on an IP core from MoreThanIP, which performs IEEE
  802.3 clause 73 base page exchanges (for auto-negotiation) and clause 72
  training frame exchanges (for link training).

  By default, this AN/LT block comes up with auto-negotiation disabled, and
  in that case it allows itself to be quickly bypassed from the data path and
  for the PCS link to come up without its involvement.

  Software can optionally make use of it, to turn the PCS, AN/LT block and lane
  (PMA/PMD) into a full copper backplane internal PHY.

  As a warning, this binding has not been peer reviewed, and may (and likely
  will be) subject to future incompatible changes. Also, the binding for the
  multi-lane link modes (40GBase-KR4) is not currently backed up by a driver
  implementation.

allOf:
  - if:
      properties:
        compatible:
          - items:
              - const: fsl,lx2160a-backplane-anlt
              - const: ethernet-phy-ieee802.3-c45
    then:
      $ref: ethernet-phy.yaml#

properties:
  compatible:
    oneOf:
      - items:
          - const: fsl,lx2160a-backplane-anlt
          - const: ethernet-phy-ieee802.3-c45
      - const: fsl,lx2160a-secondary-anlt

  reg:
    minimum: 0
    maximum: 31
    description: |
      The address of the AN/LT block within the internal MDIO bus of the MAC it
      is attached to.

      In the 1000Base-KX and 10GBase-KR link modes, the AN/LT block responds at
      the same MDIO address as the PCS (determined by the SGMIInCR1[MDEV_PORT]
      or SXGMIInCR1[MDEV_PORT] registers of the SerDes block, by default 0).
      The PCS and AN/LT block respond to different MMDs, though.

      In the 25GBase-KR and higher link modes, the AN/LT block responds at a
      different MDIO address than the PCS, determined by the
      ANLTnCR1[MDEV_PORT] register of the SerDes block. By default this is 4
      for lanes A and E, 5 for lanes B and F, 6 for lanes C and G, 7 for lanes
      D and H.

      The PCS responds in all cases at the address determined by the MDEV_PORT
      field of the SGMIInCR1, SXGMIIaCR1, E25GaCR1, E40GaCR1, E50GaCR1 or
      E100GaCR1 registers of the SerDes block.

  phys:
    maxItems: 1
    description:
      phandle for the generic PHY (SerDes lane) that acts as PMA/PMD layer

  pcs-handle:
    maxItems: 1
    description:
      phandle for the technology-dependent PCS block corresponding to the
      initial (RCW-based) configuration of the port. Must be omitted for the
      link modes where the PCS and AN/LT block respond at the same MDIO
      address. Must be specified otherwise.

  secondary-anlt-handle:
    maxItems: 1
    description:
      In case this is the primary (first) lane of a multi-lane link mode, this
      property holds an array of phandles for the other AN/LT blocks, that are
      involved in link training but not in auto-negotiation. These have the
      "fsl,lx2160a-secondary-anlt" compatible string.

required:
  - compatible
  - reg
  - phys

unevaluatedProperties: false

examples:

  # LX2160A lanes A, B, C, D with SerDes 1 protocol 19: dpmac2 uses 40GBase-KR4
  - |
    dpmac2 {
        phy-handle = <&mac2_backplane_anlt>;
        phy-connection-type = "internal";
    };

    pcs_mdio2 {
        #address-cells = <1>;
        #size-cells = <0>;
        status = "okay";

        pcs2: ethernet-phy@0 {
            reg = <0>;
        };

        mac2_backplane_anlt: ethernet-phy@7 {
            compatible = "fsl,lx2160a-backplane-anlt",
                          "ethernet-phy-ieee802.3-c45";
            reg = <7>; /* according to ANLTDCR1[MDEV_PORT] */
            phys = <&serdes_1 3>; /* lane D */
            max-speed = <40000>;
            pcs-handle = <&pcs2>;
            secondary-anlt-handle = <&mac2_lane2_anlt>, <&mac2_lane3_anlt>,
                                    <&mac2_lane4_anlt>;
        };

        mac2_lane2_anlt: ethernet-backplane-anlt@6 {
            compatible = "fsl,lx2160a-secondary-anlt";
            reg = <6>; /* according to ANLTCCR1[MDEV_PORT] */
            phys = <&serdes_1 2>; /* lane C */
        };

        mac2_lane3_anlt: ethernet-backplane-anlt@5 {
            compatible = "fsl,lx2160a-secondary-anlt";
            reg = <5>; /* according to ANLTBCR1[MDEV_PORT] */
            phys = <&serdes_1 1>; /* lane B */
        };

        mac2_lane4_anlt: ethernet-backplane-anlt@4 {
            compatible = "fsl,lx2160a-secondary-anlt";
            reg = <4>; /* according to ANLTACR1[MDEV_PORT] */
            phys = <&serdes_1 0>; /* lane A */
        };
    };

  # LX2160A lane E with SerDes 1 protocol 19: dpmac6 uses 25GBase-KR
  - |
    dpmac6 {
        phy-handle = <&mac6_backplane_anlt>;
        phy-connection-type = "internal";
    };

    pcs_mdio6 {
        #address-cells = <1>;
        #size-cells = <0>;
        status = "okay";

        pcs6: ethernet-phy@0 {
            reg = <0>;
        };

        mac6_backplane_anlt: ethernet-phy@4 {
            compatible = "fsl,lx2160a-backplane-anlt",
                          "ethernet-phy-ieee802.3-c45";
            reg = <4>; /* according to ANLTFCR1[MDEV_PORT] */
            phys = <&serdes_1 4>; /* lane E */
            max-speed = <25000>;
            pcs-handle = <&pcs6>;
        };
    };

  # LX2160A lane F with SerDes 1 protocol 19: dpmac5 uses 25GBase-KR
  - |
    dpmac5 {
        phy-handle = <&mac5_backplane_anlt>;
        phy-connection-type = "internal";
    };

    pcs_mdio5 {
        #address-cells = <1>;
        #size-cells = <0>;
        status = "okay";

        pcs5: ethernet-phy@0 {
            reg = <0>;
        };

        mac5_backplane_anlt: ethernet-phy@5 {
            compatible = "fsl,lx2160a-backplane-anlt",
                         "ethernet-phy-ieee802.3-c45";
            reg = <5>; /* according to ANLTFCR1[MDEV_PORT] */
            phys = <&serdes_1 5>; /* lane F */
            max-speed = <25000>;
            pcs-handle = <&pcs5>;
        };
    };

  # LX2160A lane G with SerDes 1 protocol 19: dpmac4 uses 10GBase-KR
  - |
    dpmac4 {
        phy-handle = <&mac4_backplane_anlt>;
        phy-connection-type = "internal";
    };

    pcs_mdio4 {
        #address-cells = <1>;
        #size-cells = <0>;
        status = "okay";

        mac4_backplane_anlt: ethernet-phy@0 {
            compatible = "fsl,lx2160a-backplane-anlt",
                         "ethernet-phy-ieee802.3-c45";
            reg = <0>; /* merged with PCS SXGMIIGCR1[MDEV_PORT] */
            phys = <&serdes_1 7>; /* lane G */
            max-speed = <10000>;
            /* no pcs-handle to &pcs4 */
        };
    };

  # LX2160A lane H with SerDes 1 protocol 19: dpmac3 uses 10GBase-KR
  - |
    dpmac3 {
        phy-handle = <&mac3_backplane_anlt>;
        phy-connection-type = "internal";
    };

    pcs_mdio3 {
        #address-cells = <1>;
        #size-cells = <0>;
        status = "okay";

        mac3_backplane_anlt: ethernet-phy@0 {
            compatible = "fsl,lx2160a-backplane-anlt",
                         "ethernet-phy-ieee802.3-c45";
            reg = <0>; /* merged with PCS SXGMIIHCR1[MDEV_PORT] */
            phys = <&serdes_1 7>; /* lane H */
            max-speed = <10000>;
            /* no pcs-handle to &pcs3 */
        };
    };
```

## Documentation/devicetree/bindings/phy/fsl,imx8mq-usb-phy.txt
```
* Freescale i.MX8MQ USB3 PHY binding

Required properties:
- compatible:	Should be "fsl,imx8mq-usb-phy" or "fsl,imx8mp-usb-phy"
- #phys-cells:	must be 0 (see phy-bindings.txt in this directory)
- reg:		The base address and length of the registers
- clocks:	phandles to the clocks for each clock listed in clock-names
- clock-names:	must contain "phy"

Optional properties:
- vbus-supply: A phandle to the regulator for USB VBUS.
- vbus-power-supply: A phandle to the vbus power supply provider, used to
		     to detect the possible BC charger type of it.
- fsl,phy-tx-vref-tune: Adjusts the high-speed DC level voltage.
			- 1111: + 24%
			- 1110: + 22%
			.....
			- 0101: + 4%
			- 0100: + 2%
			- 0011: 0 (default on imx8mp)
			- 0010: – 2%
			- 0001: – 4%
			- 0000: – 6%
- fsl,phy-tx-rise-tune: Adjusts the rise/fall times of the high-speed waveform.
			- 11: – 3%
			- 10: – 1%
			- 01: 0 (default on imx8mp)
			- 00: + 3%
- fsl,phy-tx-preemp-amp-tune: This property controls the amount of current
			    source to DP<#> and DM<#> after a J-to-K or K-to-J
			    transition. The HS Transmitter pre-emphasis current
			    is defined in terms of unit amounts. One unit
			    amount is approximately 600 μA and is defined as 1X
			    pre-emphasis current.
				- 11: 3x pre-emphasis current
				- 10: 2x pre-emphasis current
				- 01: 1x pre-emphasis current
				- 00: Disabled (default on imx8mp)
- fsl,phy-comp-dis-tune: Adjusts the voltage level for the threshold used to
			 detect a disconnect event at the host.
				- 111: + 15.54%
				- 110: + 11.86%
				- 101: + 7.52%
				- 100: + 4.08%
				- 011: 0 (default on imx8mp)
				- 010: – 3.04%
				- 001: – 6.5%
				- 000: – 9.01%
- fsl,pcs-tx-deemph-3p5db: This property sets the TX driver de-emphasis value
			   when pipeP_tx_deemph[1:0] is set to 2’b01 (according
			   to the PIPE3 specification), default value is 23 on
			   imx8mp.
- fsl,phy-pcs-tx-swing-full: This property sets the launch amplitude of the
			     transmitter, default value is 120 (7b'1111000)
			     on imx8mp.
Example:
	usb3_phy0: phy@381f0040 {
		compatible = "fsl,imx8mq-usb-phy";
		reg = <0x381f0040 0x40>;
		clocks = <&clk IMX8MQ_CLK_USB1_PHY_ROOT>;
		clock-names = "phy";
		#phy-cells = <0>;
	};
```

## Documentation/devicetree/bindings/pinctrl/fsl,imx7ulp-pinctrl.txt
```
* Freescale i.MX7ULP IOMUX Controller

Please refer to fsl,imx-pinctrl.txt in this directory for common binding part
and usage.

Required properties:
- compatible: "fsl,imx7ulp-iomuxc-0" or "fsl,imx7ulp-iomuxc-1"
- fsl,pins: two integers array, represents a group of pins mux and config
  setting. The format is fsl,pins = <PIN_FUNC_ID CONFIG>, PIN_FUNC_ID is a
  pin working on a specific function, CONFIG is the pad setting value like
  pull-up for this pin. Please refer to imx7ulp datasheet for the valid pad
  config settings.

NOTE: i.MX7ULP PIN_FUNC_ID consists of 4 integers as it shares one mux and
config register as follows:
<mux_conf_reg input_reg mux_mode input_val>

CONFIG bits definition:
PAD_CTL_OBE			(1 << 17)
PAD_CTL_IBE			(1 << 16)
PAD_CTL_LK			(1 << 15)
PAD_CTL_DSE_HIGH		(1 << 6)
PAD_CTL_DSE_STD			(0 << 6)
PAD_CTL_ODE_OPEN_DRAIN		(1 << 5)
PAD_CTL_ODE_PUSH_PULL		(0 << 5)
PAD_CTL_SRE_SLOW		(1 << 2)
PAD_CTL_SRE_STD			(0 << 2)
PAD_CTL_PE_PULL			(1 << 1)
PAD_CTL_PS_UP			(1 << 0)
PAD_CTL_PS_DOWN			(0 << 0)

Refer to imx7ulp-pinfunc.h in device tree source folder for all available
imx7ulp PIN_FUNC_ID.
```

## Documentation/devicetree/bindings/power/reset/nxp,imx95-resetctrl.yaml
```yaml
# SPDX-License-Identifier: (GPL-2.0 OR BSD-2-Clause)
%YAML 1.2
---
$id: http://devicetree.org/schemas/power/reset/nxp,imx95-resetctrl.yaml#
$schema: http://devicetree.org/meta-schemas/core.yaml#

title: NXP i.MX SM reset ctrl device

maintainers:
  - Ye Li <ye.li@nxp.com>

description: |
  i.MX reset control device for requring full system reset to system
  manager through PSCI.

properties:
  compatible:
    enum:
      - nxp,imx95-resetctrl
      - nxp,imx8q-resetctrl

required:
  - compatible

additionalProperties: false

examples:
  - |
    reset_ctrl {
        compatible = "nxp,imx95-resetctrl";
        status = "okay";
    };
...
```

## Documentation/devicetree/bindings/remoteproc/fsl,imx-dsp-rproc.yaml
```yaml
# SPDX-License-Identifier: (GPL-2.0-only or BSD-2-Clause)
%YAML 1.2
---
$id: http://devicetree.org/schemas/remoteproc/imx-dsp-rproc.yaml#
$schema: http://devicetree.org/meta-schemas/core.yaml#

title: i.MX DSP Remoteproc Devices

maintainers:
  - Shengjiu Wang <shengjiu.wang@nxp.com>

description:
  This binding provides support for DSP processors found on i.mX family of SoCs

properties:
  compatible:
    enum:
      - fsl,imx8qxp-hifi4
      - fsl,imx8qm-hifi4
      - fsl,imx8mp-hifi4
      - fsl,imx8ulp-hifi4

  clocks:
    description: |
      Main functional clock for the remote processor
    minItems: 1
    maxItems: 32

  clock-names:
    description:
      List of clock names for the remote processor
    minItems: 1
    maxItems: 32

  syscon:
    $ref: /schemas/types.yaml#/definitions/phandle
    description:
      Phandle to syscon block which provide access for processor enablement

  mbox-names:
    items:
      - const: tx
      - const: rx
      - const: rxdb

  mboxes:
    description:
      This property is required only if the rpmsg/virtio functionality is used.
      List of <&phandle type channel> - 1 channel for TX, 1 channel for RX, 1 channel for RXDB.
      (see mailbox/fsl,mu.yaml)
    minItems: 1
    maxItems: 3

  firmware-name:
    description: |
      Default name of the firmware to load to the remote processor.

  memory-region:
    description:
      If present, a phandle for a reserved memory area that used for vdev buffer,
      resource table, vring region and others used by remote processor.
    minItems: 1
    maxItems: 32

  reg:
    description: |
      Address space for any remoteproc memories present on the SoC.

required:
  - compatible
  - reg
  - mboxes
  - mbox-names
  - clocks
  - clock-names
  - firmware-name

additionalProperties: false

examples:
  - |
    #include <dt-bindings/clock/imx8ulp-clock.h>
    dsp_reserved: dsp@8e000000 {
      reg = <0 0x8e000000 0 0x1ef0000>;
      no-map;
    };
    dsp_vdev0vring0: vdev0vring0@8fef0000 {
      reg = <0 0x8fef0000 0 0x8000>;
      no-map;
    };
    dsp_vdev0vring1: vdev0vring1@8fef8000 {
      reg = <0 0x8fef8000 0 0x8000>;
      no-map;
    };
    dsp_vdev0buffer: vdev0buffer@8ff00000 {
      compatible = "shared-dma-pool";
      reg = <0 0x8ff00000 0 0x100000>;
      no-map;
    };

    dsp: dsp@21170000 {
      compatible = "fsl,imx8ulp-hifi4";
      reg = <0x21170000 0x20000>;
      clocks = <&cgc2 IMX8ULP_CLK_HIFI_DIVCORE>,
               <&cgc2 IMX8ULP_CLK_LPAV_BUS_DIV>,
               <&cgc2 IMX8ULP_CLK_HIFI_DIVPLAT>,
               <&pcc5 IMX8ULP_CLK_MU3_B>;
      clock-names = "core", "pbclk", "nic", "mu_b";
      firmware-name = "imx/dsp/hifi4.bin";
      mbox-names = "tx0", "rx0", "rxdb0";
      mboxes = <&mu3 0 0>,
               <&mu3 1 0>,
               <&mu3 3 0>;
      syscon = <&avd_sim>;
      memory-region = <&dsp_vdev0buffer>, <&dsp_vdev0vring0>,
                      <&dsp_vdev0vring1>, <&dsp_reserved>;
    };
```
