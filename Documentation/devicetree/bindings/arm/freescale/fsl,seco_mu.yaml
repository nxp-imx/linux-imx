## Documentation/devicetree/bindings/media/i2c/ovti,ox05b1s.yaml
```yaml
# SPDX-License-Identifier: (GPL-2.0-only OR BSD-2-Clause)
# Copyright 2024-2025 NXP
%YAML 1.2
---
$id: http://devicetree.org/schemas/media/i2c/ovti,ox05b1s.yaml#
$schema: http://devicetree.org/meta-schemas/core.yaml#

title: Omnivision OX05B1S Image Sensor

maintainers:
  - Mirela Rabulea <mirela.rabulea@nxp.com>

description:
  The Omnivision OX05B1S is a 1/2.5-Inch CMOS image sensor with an active
  array size of 2592 x 1944 and raw RGB-Ir output. It is programmable through
  I2C interface. Image data is available via MIPI CSI-2 serial data output.
  The Omnivision OS08A20 is a 1/1.8-Inch CMOS image sensor with an active
  array size of 3840 x 2160, raw RGB output and 2-exposure staggered HDR
  support.

allOf:
  - $ref: /schemas/media/video-interface-devices.yaml#

properties:
  compatible:
    enum:
      - ovti,os08a20
      - ovti,ox05b1s

  reg:
    maxItems: 1

  clocks:
    description: Input clock (6-64 MHz for OX05B1S, 6-27 MHz for OS08A20)
    maxItems: 1

  reset-gpios:
    description: Active low XSHUTDOWN pin
    maxItems: 1

  avdd-supply:
    description: Power for analog circuit (2.8V)

  dovdd-supply:
    description: Power for I/O circuit (1.8V)

  dvdd-supply:
    description: Power for digital circuit (1.2V)

  port:
    $ref: /schemas/graph.yaml#/$defs/port-base
    unevaluatedProperties: false
    description: MIPI CSI-2 transmitter port

    properties:
      endpoint:
        $ref: /schemas/media/video-interfaces.yaml#
        unevaluatedProperties: false

        properties:
          data-lanes:
            anyOf:
              - items:
                  - const: 1
                  - const: 2
              - items:
                  - const: 1
                  - const: 2
                  - const: 3
                  - const: 4
        required:
          - data-lanes

    required:
      - endpoint

required:
  - compatible
  - reg
  - clocks
  - port
  - avdd-supply
  - dovdd-supply
  - dvdd-supply

unevaluatedProperties: false

examples:
  - |
    #include <dt-bindings/gpio/gpio.h>

    i2c {
        #address-cells = <1>;
        #size-cells = <0>;

        camera@36 {
            compatible = "ovti,ox05b1s";
            reg = <0x36>;
            clocks = <&ox05b1s_clk>;

            assigned-clocks = <&ox05b1s_clk>;
            assigned-clock-parents = <&ox05b1s_clk_parent>;
            assigned-clock-rates = <24000000>;

            reset-gpios = <&gpio1 6 GPIO_ACTIVE_LOW>;

            avdd-supply = <&camera_avdd_2v8>;
            dovdd-supply = <&camera_dovdd_1v8>;
            dvdd-supply = <&camera_dvdd_1v2>;

            orientation = <2>;
            rotation = <0>;

            port {
                ox05b1s_mipi_0_ep: endpoint {
                    remote-endpoint = <&mipi_csi0_ep>;
                    data-lanes = <1 2 3 4>;
                };
            };
        };
    };
...
```

## Documentation/devicetree/bindings/mfd/nxp,pca9450.txt
```
* NXP PCA9450 Power Management Integrated Circuit (PMIC) bindings

Required properties:
 - compatible		: Should be "nxp,pca9450".
 - reg			: I2C slave address.
 - pinctrl-0      	: Pinctrl setting for pmic such as interrupt pin.
 - gpio_intr		: gpio pin used for interrupt pin.
 - regulators:          : List of child nodes that specify the regulator
                            initialization data. Including 6 buck regulators
			    and 5 ldo regulators.

Example:
	pmic: pca9450@25 {
		reg = <0x25>;
		compatible = "nxp,pca9450";
		/* PMIC PCA9450 PMIC_nINT GPIO1_IO3 */
		pinctrl-0 = <&pinctrl_pmic>;
		gpio_intr = <&gpio1 3 GPIO_ACTIVE_LOW>;

		regulators {
			#address-cells = <1>;
			#size-cells = <0>;

			pca9450,pmic-buck2-uses-i2c-dvs;
			/* Run/Standby voltage */
			pca9450,pmic-buck2-dvs-voltage = <950000>, <850000>;

			buck1_reg: regulator@0 {
				reg = <0>;
				regulator-compatible = "buck1";
				regulator-min-microvolt = <600000>;
				regulator-max-microvolt = <2187500>;
				regulator-boot-on;
				regulator-always-on;
				regulator-ramp-delay = <3125>;
			};

			buck2_reg: regulator@1 {
				reg = <1>;
				regulator-compatible = "buck2";
				regulator-min-microvolt = <600000>;
				regulator-max-microvolt = <2187500>;
				regulator-boot-on;
				regulator-always-on;
				regulator-ramp-delay = <3125>;
			};

			.....

		};
	};
```

## Documentation/devicetree/bindings/mlb/mlb150.txt
```
* Freescale Media Local Bus Host Controller (MLB) for i.MX6Q/DL

The Media Local Bus Host Controller on Freescale i.MX family
provides an interface for MOST network.

Required properties:
- compatible : Should be "fsl,<chip>-mlb150"
- reg : Should contain mlb registers location and length
- interrupts : Should contain mlb interrupt
- clocks: Should contain the mlb clock sources
- clock-names: Should be the names of mlb clock sources
- iram : phandle pointing to the SRAM device node

Examples:
mlb@0218c000 {
	compatible = "fsl,imx6q-mlb150";
	reg = <0x0218c000 0x4000>;
	interrupts = <0 53 0x04 0 117 0x04 0 126 0x04>;
	clocks = <&clks 139>, <&clks 175>;
	clock-names = "mlb", "pll8_mlb";
	iram = <&ocram>;
};
```

## Documentation/devicetree/bindings/mmc/fsl-imx-esdhc.txt
```
* Freescale Enhanced Secure Digital Host Controller (eSDHC) for i.MX

The Enhanced Secure Digital Host Controller on Freescale i.MX family
provides an interface for MMC, SD, and SDIO types of memory cards.

This file documents differences between the core properties described
by mmc.txt and the properties used by the sdhci-esdhc-imx driver.

Required properties:
- compatible : Should be "fsl,<chip>-esdhc"

Optional properties:
- fsl,cd-controller : Indicate to use controller internal card detection
- fsl,wp-controller : Indicate to use controller internal write protection
- fsl,delay-line : Specify the number of delay cells for override mode.
  This is used to set the clock delay for DLL(Delay Line) on override mode
  to select a proper data sampling window in case the clock quality is not good
  due to signal path is too long on the board. Please refer to eSDHC/uSDHC
  chapter, DLL (Delay Line) section in RM for details.
- fsl,tuning-step : The delay cell steps in tuning procedure.
  Some boards need to set the tuning-step to make sure it can pass tuning procedure.
- fsl,tuning-start-tap: Specify the start dealy cell point when send first CMD19
  in tuning procedure.
- wifi-host : assigned as a wifi host.
  This is required for some WiFi cards to do card detect

Examples:

esdhc@70004000 {
	compatible = "fsl,imx51-esdhc";
	reg = <0x70004000 0x4000>;
	interrupts = <1>;
	fsl,cd-controller;
	fsl,wp-controller;
	tuning-step = <2>;
};

esdhc@70008000 {
	compatible = "fsl,imx51-esdhc";
	reg = <0x70008000 0x4000>;
	interrupts = <2>;
	cd-gpios = <&gpio1 6 0>; /* GPIO1_6 */
	wp-gpios = <&gpio1 5 0>; /* GPIO1_5 */
};
```

## Documentation/devicetree/bindings/mtd/ti,am654-hbmc.txt
```
Bindings for HyperBus Memory Controller (HBMC) on TI's K3 family of SoCs

Required properties:
- compatible : "ti,am654-hbmc" for AM654 SoC
- reg : Two entries:
	First entry pointed to the register space of HBMC controller
	Second entry pointing to the memory map region dedicated for
	MMIO access to attached flash devices
- ranges : Address range allocated for each chipselect in the MMIO space

Optional properties:
- mux-controls : phandle to the multiplexer that controls selection of
		 HBMC vs OSPI. Mux state of 1 indicates HBMC is selected.

Example:

	hbmc: hbmc@47034000 {
		compatible = "ti,am654-hbmc";
		reg = <0x0 0x47034000 0x0 0x100>,
			<0x5 0x00000000 0x1 0x0000000>;
		power-domains = <&k3_pds 55>;
		#address-cells = <1>;
		#size-cells = <1>;
		ranges = <0x0 0x5 0x00000000 0x4000000>, /* CS0 - 64MB */
			 <0x1 0x5 0x04000000 0x4000000>; /* CS1 - 64MB

		/* Slave flash node */
		flash@0 {
			compatible = "cypress,hyperflash";
			reg = <0x0 0x4000000>;
		};
	};
```

## Documentation/devicetree/bindings/net/can/m_can.txt
```
Bosch MCAN controller Device Tree Bindings
-------------------------------------------------

Required properties:
- compatible		: Should be "bosch,m_can" for M_CAN controllers
- reg			: physical base address and size of the M_CAN
			  registers map and message ram
- interrupts		: property with a value describing the interrupt
			  number
- clocks		: clocks used by controller
- mram-cfg		: message ram configuration data, the format is
  <offset sidf_elems xidf_elems rxf1_elems rxb_elems txe_elems txb_elems>
  The 'offset' is the address offset inside the message ram. This is usually set
  if you're using the shared message ram while the other part is used by another
  m_can controller.
  The left cell are all the number of each elements inside the message ram.
  Please refer to 2.4.1 Message RAM Con.guration in Bosch M_CAN user mannual
  for each elements definition.

Example:
canfd1: canfd@020e8000 {
	compatible = "bosch,m_can";
	reg = <0x020e8000 0x4000>, <0x02298000 0x4000>;
	reg-names = "canfd", "message_ram";
	interrupts = <0 114 0x04>;
	clocks = <&clks IMX6SX_CLK_CANFD>;
	mram-cfg = <0x0 0 0 32 32 32 0 1>;
	status = "disabled";
};
```
