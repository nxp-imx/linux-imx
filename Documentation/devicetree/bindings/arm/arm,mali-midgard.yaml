## arch/arm64/configs/imx_v8_android_defconfig
```kconfig
# CONFIG_IMX8_ISI_HW is not set
CONFIG_6LOWPAN=y
CONFIG_AQUANTIA_PHY=y
CONFIG_ARCH_MXC=y
CONFIG_ARCH_NXP=y
CONFIG_ARM_IMX_CPUFREQ_DT=y
CONFIG_ARM_SCMI_POWER_CONTROL=y
CONFIG_ARM_SMMU=y
CONFIG_ARM_SMMU_V3=y
CONFIG_AT803X_PHY=y
CONFIG_BACKLIGHT_LED=y
CONFIG_BACKLIGHT_PWM=y
CONFIG_BATTERY_DUMMY=y
CONFIG_BATTERY_MAX17042=y
CONFIG_BT=y
CONFIG_BT_HCIBTSDIO=y
CONFIG_BT_HIDP=y
CONFIG_BT_RFCOMM=y
CONFIG_CAN=y
CONFIG_CAN_FLEXCAN=y
CONFIG_CAN_SLCAN=y
CONFIG_CAN_VCAN=y
CONFIG_CFG80211=y
CONFIG_CLKSRC_IMX_TPM=y
CONFIG_CLK_IMX8MM=y
CONFIG_CLK_IMX8MN=y
CONFIG_CLK_IMX8MP=y
CONFIG_CLK_IMX8MQ=y
CONFIG_CLK_IMX8QXP=y
CONFIG_CLK_IMX8ULP=y
CONFIG_CLK_IMX95_BLK_CTL=y
CONFIG_CMA=y
CONFIG_COMMON_CLK_SCMI=y
CONFIG_CPUFREQ_DT=y
CONFIG_CPUFREQ_DT_PLATDEV=y
CONFIG_DMABUF_HEAPS_CMA=y
CONFIG_DMABUF_HEAPS_DSP=y
CONFIG_DMABUF_HEAPS_SYSTEM=y
CONFIG_DMABUF_IMX=y
CONFIG_DMA_CMA=y
CONFIG_DRM_CDNS_HDCP=y
CONFIG_DRM_CDNS_HDMI_CEC=y
CONFIG_DRM_CDNS_MHDP=y
CONFIG_DRM_DISPLAY_CONNECTOR=y
CONFIG_DRM_DISPLAY_HELPER=y
CONFIG_DRM_DW_HDMI_CEC=y
CONFIG_DRM_DW_HDMI_GP_AUDIO=y
CONFIG_DRM_FSL_IMX_LVDS_BRIDGE=y
CONFIG_DRM_I2C_ADV7511=y
CONFIG_DRM_IMX8MM_LCDIF=y
CONFIG_DRM_IMX8MP_LDB=y
CONFIG_DRM_IMX8QM_LDB_NXP=y
CONFIG_DRM_IMX8QXP_LDB_NXP=y
CONFIG_DRM_IMX95_DPU=y
CONFIG_DRM_IMX95_LDB=y
CONFIG_DRM_IMX95_MIPI_DSI=y
CONFIG_DRM_IMX95_PIXEL_INTERLEAVER=y
CONFIG_DRM_IMX95_PIXEL_LINK=y
CONFIG_DRM_IMX=y
CONFIG_DRM_IMX_CDNS_MHDP=y
CONFIG_DRM_IMX_DCNANO=y
CONFIG_DRM_IMX_DCSS=y
CONFIG_DRM_IMX_HDMI=y
CONFIG_DRM_IMX_LCDIF=y
CONFIG_DRM_IMX_SEC_DSIM=y
CONFIG_DRM_ITE_IT6161=y
CONFIG_DRM_ITE_IT6263=y
CONFIG_DRM_ITE_IT6263_NXP=y
CONFIG_DRM_LONTIUM_LT8912B=y
CONFIG_DRM_LONTIUM_LT9611UXC=y
CONFIG_DRM_MAX96752_LVDS=y
CONFIG_DRM_MAX96789_DSI=y
CONFIG_DRM_MXSFB=y
CONFIG_DRM_NWL_MIPI_DSI=y
CONFIG_DRM_PANEL_LVDS=y
CONFIG_DRM_PANEL_RAYDIUM_RM67191=y
CONFIG_DRM_PANEL_RAYDIUM_RM692C9=y
CONFIG_DRM_PANEL_ROCKTECK_HIMAX8394F=y
CONFIG_DRM_PANEL_SIMPLE=y
CONFIG_DRM_TI_SN65DSI83=y
CONFIG_DWMAC_IMX8=y
CONFIG_ETHERNET=y
CONFIG_FB=y
CONFIG_FB_CORE=y
CONFIG_FB_MXC=y
CONFIG_FB_MXC_EINK_V2_PANEL=y
CONFIG_FB_NOTIFY=y
CONFIG_FEC=y
CONFIG_FPGA=y
CONFIG_FSL_EDMA=y
CONFIG_FSL_ENETC_CORE=y
CONFIG_FSL_ENETC_MDIO=y
CONFIG_FSL_ENETC_QOS=y
CONFIG_FSL_ENETC_VF=y
CONFIG_FSL_IMX8_DDR_PMU=y
CONFIG_FSL_IMX9_DDR_PMU=y
CONFIG_FXAS21002C=y
CONFIG_FXLS8962AF=y
CONFIG_FXLS8962AF_I2C=y
CONFIG_FXOS8700_I2C=y
CONFIG_GMSL_MAX9286=y
CONFIG_GPIO_ADP5585=y
CONFIG_GPIO_IMX_RPMSG=y
CONFIG_GPIO_MAX732X=y
CONFIG_GPIO_MXC=y
CONFIG_GPIO_PCA953X=y
CONFIG_GPIO_PCA953X_IRQ=y
CONFIG_GPIO_VF610=y
CONFIG_HWMON=y
CONFIG_I2C_CHARDEV=y
CONFIG_I2C_IMX=y
CONFIG_I2C_IMX_FLEXIO=y
CONFIG_I2C_IMX_LPI2C=y
CONFIG_I2C_MUX=y
CONFIG_I2C_MUX_GPIO=y
CONFIG_I2C_RPBUS=y
CONFIG_IEEE802154=y
CONFIG_IEEE802154_6LOWPAN=y
CONFIG_IIO_HRTIMER_TRIGGER=y
CONFIG_IIO_ST_ACCEL_3AXIS=y
CONFIG_IIO_ST_GYRO_3AXIS=y
CONFIG_IIO_ST_LSM6DSX=y
CONFIG_IIO_ST_LSM6DSX_I2C=y
CONFIG_IIO_ST_MAGN_3AXIS=y
CONFIG_IIO_SW_TRIGGER=y
CONFIG_IIO_SYSFS_TRIGGER=y
CONFIG_IMX2_WDT=y
CONFIG_IMX7ULP_WDT=y
CONFIG_IMX8MM_LCDIF_CORE=y
CONFIG_IMX8MM_THERMAL=y
CONFIG_IMX8M_BLK_CTRL=y
CONFIG_IMX8M_BUSFREQ=y
CONFIG_IMX8M_PM_DOMAINS=y
CONFIG_IMX8QXP_ADC=y
CONFIG_IMX8ULP_LPM_CTRL=y
CONFIG_IMX8_MEDIA_DEVICE=m
CONFIG_IMX93_ADC=y
CONFIG_IMX_DPU_CORE=y
CONFIG_IMX_DSP=y
CONFIG_IMX_DSP_REMOTEPROC=m
CONFIG_IMX_ELE_TRNG=y
CONFIG_IMX_GPCV2_PM_DOMAINS=y
CONFIG_IMX_IRQSTEER=y
CONFIG_IMX_LCDIFV3_CORE=y
CONFIG_IMX_MBOX=y
CONFIG_IMX_NEUTRON_REMOTEPROC=m
CONFIG_IMX_REMOTEPROC=y
CONFIG_IMX_SCMI_BBM_EXT=y
CONFIG_IMX_SCMI_CPU_DRV=y
CONFIG_IMX_SCMI_CPU_EXT=y
CONFIG_IMX_SCMI_LMM_DRV=y
CONFIG_IMX_SCMI_LMM_EXT=y
CONFIG_IMX_SCMI_MISC_DRV=y
CONFIG_IMX_SCMI_MISC_EXT=y
CONFIG_IMX_SCU=y
CONFIG_IMX_SCU_PD=y
CONFIG_IMX_SC_THERMAL=y
CONFIG_IMX_SC_WDT=y
CONFIG_IMX_SDMA=y
CONFIG_IMX_SEC_ENCLAVE=y
CONFIG_IR_GPIO_CIR=y
CONFIG_KEYBOARD_IMX_SC_KEY=y
CONFIG_KEYBOARD_RPMSG=y
CONFIG_KEYBOARD_SNVS_PWRKEY=y
CONFIG_L2TP=y
CONFIG_LEDS_GPIO=y
CONFIG_LEDS_PCA963X=y
CONFIG_LEDS_PCA995X=y
CONFIG_LEDS_PWM=y
CONFIG_LOGO=y
CONFIG_LOGO_LINUX_CLUT224=y
CONFIG_MAC80211=y
CONFIG_MAC802154=y
CONFIG_MALI_CSF_SUPPORT=y
CONFIG_MALI_MIDGARD=m
CONFIG_MALI_PROTECTED_MEMORY_ALLOCATOR=m
CONFIG_MAX30102=y
CONFIG_MEDIA_SUPPORT=y
CONFIG_MFD_ADP5585=y
CONFIG_MFD_FP9931=y
CONFIG_MFD_IMX_FLEXIO=y
CONFIG_MFD_MAX96752=y
CONFIG_MFD_MAX96752_I2C=y
CONFIG_MFD_MAX96789=y
CONFIG_MFD_MAX96789_I2C=y
CONFIG_MFD_ROHM_BD718XX=y
CONFIG_MICREL_PHY=y
CONFIG_MMC_SDHCI_ESDHC_IMX=y
CONFIG_MPL3115=y
CONFIG_MTD=y
CONFIG_MTD_NAND_CORE=y
CONFIG_MTD_NAND_GPMI_NAND=y
CONFIG_MTD_RAW_NAND=y
CONFIG_MTD_SPI_NOR=y
CONFIG_MUX_MMIO=y
CONFIG_MXC_CLK=y
CONFIG_MXC_GPU_VIV=y
CONFIG_MXC_HANTRO=y
CONFIG_MXC_HANTRO_845=y
CONFIG_MXC_HANTRO_845_H1=y
CONFIG_MXC_HANTRO_V4L2=y
CONFIG_MXC_HANTRO_VC8000E=y
CONFIG_MXC_MUR=y
CONFIG_MXC_PXP_CLIENT_DEVICE=y
CONFIG_MXC_PXP_V3=y
CONFIG_MXC_VIDEO_WAVE6=y
CONFIG_MXS_DMA=y
CONFIG_NET_9P=y
CONFIG_NET_ACT_GATE=y
CONFIG_NET_CLS_FLOWER=y
CONFIG_NET_SCH_CBS=y
CONFIG_NET_SCH_ETF=y
CONFIG_NET_SCH_MQPRIO=y
CONFIG_NET_SCH_TAPRIO=y
CONFIG_NET_VENDOR_FREESCALE=y
CONFIG_NEUTRON=m
CONFIG_NFC=y
CONFIG_NOP_USB_XCEIV=y
CONFIG_NVMEM_IMX_OCOTP=y
CONFIG_NVMEM_IMX_OCOTP_SCU=y
CONFIG_NXP_ENETC4=y
CONFIG_NXP_NETC_BLK_CTRL=y
CONFIG_NXP_NETC_LIB=y
CONFIG_PCI_IMX6=y
CONFIG_PCS_XPCS=y
CONFIG_PHY_CADENCE_SALVO=y
CONFIG_PHY_FSL_IMX8MP_LVDS=y
CONFIG_PHY_FSL_IMX8MQ_USB=y
CONFIG_PHY_FSL_IMX8M_PCIE=y
CONFIG_PHY_FSL_IMX8QM_HSIO=y
CONFIG_PHY_FSL_IMX9_DPHY_RX=y
CONFIG_PHY_FSL_SAMSUNG_HDMI_PHY=y
CONFIG_PHY_MIXEL_LVDS=y
CONFIG_PHY_MIXEL_LVDS_COMBO=y
CONFIG_PHY_MIXEL_MIPI_DPHY=y
CONFIG_PINCTRL_IMX8MM=y
CONFIG_PINCTRL_IMX8MN=y
CONFIG_PINCTRL_IMX8MP=y
CONFIG_PINCTRL_IMX8MQ=y
CONFIG_PINCTRL_IMX8QM=y
CONFIG_PINCTRL_IMX8QXP=y
CONFIG_PINCTRL_IMX8ULP=y
CONFIG_PINCTRL_IMX=y
CONFIG_PINCTRL_IMX_SCMI=y
CONFIG_PINCTRL_IMX_SCU=y
CONFIG_POWER_RESET_IMX=y
CONFIG_PTP_1588_CLOCK=y
CONFIG_PTP_NETC_V4_TIMER=y
CONFIG_PWM_ADP5585=y
CONFIG_PWM_IMX27=y
CONFIG_PWM_IMX_TPM=y
CONFIG_PWM_RPCHIP=y
CONFIG_PWRSEQ_SIMPLE=y
CONFIG_QORIQ_THERMAL=y
CONFIG_REALTEK_PHY=y
CONFIG_REGULATOR_BD718XX=y
CONFIG_REGULATOR_FP9931=y
CONFIG_REGULATOR_GPIO=y
CONFIG_REGULATOR_PCA9450=y
CONFIG_REGULATOR_PFUZE100=y
CONFIG_REGULATOR_ROHM=y
CONFIG_RESET_DISPMIX=y
CONFIG_RESET_GPIO=y
CONFIG_RESET_IMX7=y
CONFIG_RESET_IMX8ULP_CSR=y
CONFIG_RESET_IMX8ULP_SIM=y
CONFIG_RFKILL=y
CONFIG_RPMSG_IIO_PEDOMETER=y
CONFIG_RPMSG_LIFE_CYCLE=y
CONFIG_RPMSG_VIRTIO=y
CONFIG_RTC_DRV_IMX_BBM_SCMI=y
CONFIG_RTC_DRV_IMX_RPMSG=y
CONFIG_RTC_DRV_IMX_SC=y
CONFIG_RTC_DRV_SNVS=y
CONFIG_SECVIO_SC=y
CONFIG_SENSORS_ARM_SCMI=y
CONFIG_SENSORS_FP9931=y
CONFIG_SENSORS_ISL29018=y
CONFIG_SENSORS_PWM_FAN=y
CONFIG_SERIAL_FSL_LPUART=y
CONFIG_SERIAL_FSL_LPUART_CONSOLE=y
CONFIG_SERIAL_IMX=y
CONFIG_SERIAL_IMX_CONSOLE=y
CONFIG_SERIAL_IMX_EARLYCON=y
CONFIG_SND_AUDIO_GRAPH_CARD2=y
CONFIG_SND_IMX_SOC=y
CONFIG_SND_SIMPLE_CARD=y
CONFIG_SND_SIMPLE_CARD_UTILS=y
CONFIG_SND_SOC_AK4458=y
CONFIG_SND_SOC_AK5558=y
CONFIG_SND_SOC_BT_SCO=y
CONFIG_SND_SOC_CS42XX8=y
CONFIG_SND_SOC_CS42XX8_I2C=y
CONFIG_SND_SOC_DMIC=y
CONFIG_SND_SOC_FSL_ASOC_CARD=y
CONFIG_SND_SOC_FSL_ASRC=y
CONFIG_SND_SOC_FSL_AUD2HTX=y
CONFIG_SND_SOC_FSL_AUDMIX=y
CONFIG_SND_SOC_FSL_EASRC=y
CONFIG_SND_SOC_FSL_ESAI=y
CONFIG_SND_SOC_FSL_MICFIL=y
CONFIG_SND_SOC_FSL_MQS=y
CONFIG_SND_SOC_FSL_RPMSG=y
CONFIG_SND_SOC_FSL_SAI=y
CONFIG_SND_SOC_FSL_SPDIF=y
CONFIG_SND_SOC_IMX_AUDIO_RPMSG=y
CONFIG_SND_SOC_IMX_AUDMIX=y
CONFIG_SND_SOC_IMX_CARD=y
CONFIG_SND_SOC_IMX_HDMI=y
CONFIG_SND_SOC_IMX_PCM_DMA=y
CONFIG_SND_SOC_IMX_PCM_RPMSG=y
CONFIG_SND_SOC_IMX_RPMSG=y
CONFIG_SND_SOC_RPMSG_AK4497=y
CONFIG_SND_SOC_RPMSG_WM8960=y
CONFIG_SND_SOC_SOF_IMX8=y
CONFIG_SND_SOC_SOF_IMX_COMMON=y
CONFIG_SND_SOC_SOF_IMX_TOPLEVEL=y
CONFIG_SND_SOC_SOF_OF=y
CONFIG_SND_SOC_SOF_TOPLEVEL=y
CONFIG_SND_SOC_TPA6130A2=y
CONFIG_SND_SOC_WM8524=y
CONFIG_SND_SOC_WM8904=y
CONFIG_SND_SOC_WM8960=y
CONFIG_SND_SOC_WM8962=y
CONFIG_SOC_IMX8M=y
CONFIG_SOC_IMX9=y
CONFIG_SPI_BITBANG=y
CONFIG_SPI_FSL_LPSPI=y
CONFIG_SPI_FSL_QUADSPI=y
CONFIG_SPI_IMX=y
CONFIG_SPI_NXP_FLEXSPI=y
CONFIG_SPI_SPIDEV=y
CONFIG_STAGING_MEDIA=y
CONFIG_STMMAC_ETH=y
CONFIG_STMP_DEVICE=y
CONFIG_TIMER_IMX_SYS_CTR=y
CONFIG_TMPFS=y
CONFIG_TOUCHSCREEN_ELAN=y
CONFIG_TOUCHSCREEN_EXC3000=y
CONFIG_TOUCHSCREEN_FTS=y
CONFIG_TOUCHSCREEN_GOODIX=m
CONFIG_TOUCHSCREEN_ILITEK=y
CONFIG_TOUCHSCREEN_SYNAPTICS_DSX_I2C=m
CONFIG_TYPEC_SWITCH_GPIO=y
CONFIG_USB_CDNS3=y
CONFIG_USB_CDNS3_GADGET=y
CONFIG_USB_CDNS3_HOST=y
CONFIG_USB_CDNS3_IMX=y
CONFIG_USB_CDNS_SUPPORT=y
CONFIG_USB_CHIPIDEA=y
CONFIG_USB_CHIPIDEA_HOST=y
CONFIG_USB_CHIPIDEA_IMX=y
CONFIG_USB_CHIPIDEA_UDC=y
CONFIG_USB_DWC3_IMX8MP=y
CONFIG_USB_MXS_PHY=y
CONFIG_USER_NS=y
CONFIG_VIDEO_AMPHION_VPU=y
CONFIG_VIDEO_AP1302=y
CONFIG_VIDEO_DWC_MIPI_CSIS=y
CONFIG_VIDEO_IMX7_CSI=y
CONFIG_VIDEO_IMX8MQ_MIPI_CSI2=y
CONFIG_VIDEO_IMX8_ISI=y
CONFIG_VIDEO_IMX8_ISI_M2M=y
CONFIG_VIDEO_IMX8_JPEG=y
CONFIG_VIDEO_IMX_CAPTURE=y
CONFIG_VIDEO_IMX_CSI_FORMATTER=y
CONFIG_VIDEO_IMX_MIPI_CSIS=y
CONFIG_VIDEO_IMX_PARALLEL_CSI=y
CONFIG_VIDEO_MAX96717_LIB=y
CONFIG_VIDEO_MAX96724=y
CONFIG_VIDEO_MHDP_HDMIRX=y
CONFIG_VIDEO_MX95MBCAM=y
CONFIG_VIDEO_MXC_CAPTURE=y
CONFIG_VIDEO_NXP_NEOISP=y
CONFIG_VIDEO_OV5640=y
CONFIG_VIDEO_OX03C10_LIB=y
CONFIG_VIDEO_OX05B1S=y
CONFIG_VLAN_8021Q=y
CONFIG_WWAN=y
CONFIG_ZRAM=y
CONFIG_ZSMALLOC=y
```

## drivers/i3c/Kconfig
```kconfig
# SPDX-License-Identifier: GPL-2.0

menuconfig I3C
	tristate "I3C support"
	select I2C
	help
	  I3C is a serial protocol standardized by the MIPI alliance.

	  It's supposed to be backward compatible with I2C while providing
	  support for high speed transfers and native interrupt support
	  without the need for extra pins.

	  The I3C protocol also standardizes the slave device types and is
	  mainly designed to communicate with sensors.

	  If you want I3C support, you should say Y here and also to the
	  specific driver for your bus adapter(s) below.

	  This I3C support can also be built as a module.  If so, the module
	  will be called i3c.

if I3C
source "drivers/i3c/master/Kconfig"

config I3C_HUB
	tristate "I3C Hub Support"
	depends on I3C
	help
	  Enable support for the I3C interface in hub devices.

	  This option adds virtual I3C bus support for hubs by creating
	  virtual master controllers for downstream ports and forwarding
	  bus operations through the hub device. It also provides an
	  interface used by hub drivers to enable or disable downstream
	  ports during bus transactions.

	  Say Y here if your platform includes an I3C hub device

source "drivers/i3c/hub/Kconfig"
endif # I3C
```

## drivers/i3c/hub/Kconfig
```kconfig
# SPDX-License-Identifier: GPL-2.0
# Copyright 2025-2026 NXP
config P3H2X4X_I3C_HUB
    tristate "NXP P3H2X4X I3C HUB support"
    depends on MFD_P3H2X4X
    select I3C_HUB
    help
      This enables support for NXP P3H244x/P3H284x I3C HUB. These hubs
      connect to a host via I3C/I2C/SMBus and allow communication with
      multiple downstream peripherals. The Say Y or M here to use I3C
      HUB driver to configure I3C HUB device.
```

## drivers/media/platform/nxp/neoisp/Kconfig
```kconfig
# SPDX-License-Identifier: GPL-2.0-only

config VIDEO_NXP_NEOISP
	tristate "NXP NEO Image Signal Processor (ISP) driver"
	depends on VIDEO_DEV
	select MEDIA_CONTROLLER
	select VIDEOBUF2_DMA_CONTIG
	select V4L2_ISP
	help
	  Enable this to support the NXP NEO Image Signal Processing (ISP)
	  module present in various NXP SoCs. This module offers multiple
	  functions for processing RAW images and generating RGB or YUV images.

	  To compile this driver as a module, choose M here: the module
	  will be called neoisp.
```

## drivers/mxc/vpu/coda980/Kconfig
```kconfig
# SPDX-License-Identifier: GPL-2.0-only

comment "Coda980 vpu driver"

config MXC_VIDEO_CODA980
	tristate "Coda980 VPU (Video Processing Unit) Codec IP"
	depends on V4L_MEM2MEM_DRIVERS
	depends on ARCH_MXC || COMPILE_TEST
	depends on MEDIA_SUPPORT
	depends on VIDEO_DEV
	select MEDIA_CONTROLLER
	select V4L2_MEM2MEM_DEV
	select VIDEOBUF2_DMA_CONTIG
	help
	  Coda980 VPU Codec IP contains H.264 encoder.
	  To compile this driver as a module choose m here.
```

## drivers/mxc/vpu/hantrodec/Kconfig
```kconfig
menu "MXC HANTRO(Video Processing Unit) G1 and G2 decoder support"
	depends on ARCH_MXC

config MXC_VIDEO_HANTRO_DEC
	tristate "Support for MXC HANTRO(Video Processing Unit) encoder"
	help
	  Hantro VPU Decoder IP contains G1 and G2.
	  G1 decoder can support H264 and VP8,
	  and the full version of i.MX8MQ can support some legacy formats,
	  such as MPEG2, MPEG4, H263, VC1, AVS2, XVID, RV and jpeg.
	  G2 decoder can support HEVC and VP9.
	  To compile this driver as a module choose m here.

endmenu
```

## drivers/mxc/vpu/hantroenc/Kconfig
```kconfig
menu "MXC HANTRO(Video Processing Unit) H1 and VC8000E encoder support"
	depends on ARCH_MXC

config MXC_VIDEO_HANTRO_ENC
	tristate "Support for MXC HANTRO(Video Processing Unit) encoder"
	help
	  Hantro VPU Encoder IP contains H1 and VC8000E.
	  It support the H1 encoder and VC8000E encoder both.
	  Just replace the MXC_HANTRO_845_H1 and MXC_HANTRO_VC8000E.
	  To compile this driver as a module choose m here.

endmenu
```

## drivers/mxc/vpu/wave511/Kconfig
```kconfig
# SPDX-License-Identifier: GPL-2.0-only

comment "Wave511 vpu driver"

config MXC_VIDEO_WAVE511_CTRL
	tristate "WAVE511 VPU Ctrl"
	help
	  Wave511 VPU Ctrl is to handle the global region.
	  It help load the firmware and boot the vcpu,
	  It also help manage the vpu power domain and clock,
	  To compile this driver as a module choose m here.

config MXC_VIDEO_WAVE511
	tristate "WAVE511 VPU (Video Processing Unit) Codec IP"
	depends on V4L_MEM2MEM_DRIVERS
	depends on ARCH_MXC || COMPILE_TEST
	depends on MEDIA_SUPPORT
	depends on VIDEO_DEV
	select MEDIA_CONTROLLER
	select V4L2_MEM2MEM_DEV
	select VIDEOBUF2_DMA_CONTIG
	select MXC_VIDEO_WAVE511_CTRL
	help
	  Wave511 VPU Codec IP contains avc and hevc decoder.
	  It can support up to 4 vms, and up to 32 instances.
	  It supports H.264/HEVC 4K@60fps decoding.
	  To compile this driver as a module choose m here.
```
