## Documentation/devicetree/bindings/mailbox/fsl,mu.yaml
```yaml
# SPDX-License-Identifier: (GPL-2.0-only OR BSD-2-Clause)
%YAML 1.2
---
$id: http://devicetree.org/schemas/mailbox/fsl,mu.yaml#
$schema: http://devicetree.org/meta-schemas/core.yaml#

title: NXP i.MX Messaging Unit (MU)

maintainers:
  - Dong Aisheng <aisheng.dong@nxp.com>

description: |
  The Messaging Unit module enables two processors within the SoC to
  communicate and coordinate by passing messages (e.g. data, status
  and control) through the MU interface. The MU also provides the ability
  for one processor to signal the other processor using interrupts.

  Because the MU manages the messaging between processors, the MU uses
  different clocks (from each side of the different peripheral buses).
  Therefore, the MU must synchronize the accesses from one side to the
  other. The MU accomplishes synchronization using two sets of matching
  registers (Processor A-facing, Processor B-facing).
properties:
  compatible:
    oneOf:
      - const: fsl,imx6sx-mu
      - const: fsl,imx7ulp-mu
      - const: fsl,imx8ulp-mu
      - const: fsl,imx8-mu-scu
      - const: fsl,imx8-mu-seco
      - const: fsl,imx8ulp-mu-s4
      - const: fsl,imx93-mu-s4
      - const: fsl,imx94-mu-prime
      - const: fsl,imx94-mu-v2x
      - const: fsl,imx95-mu
      - const: fsl,imx95-mu-cm0p
      - const: fsl,imx95-mu-ele
      - const: fsl,imx95-mu-v2x
      - const: fsl,imx952-mu-prime
      - items:
          - const: fsl,imx93-mu
          - const: fsl,imx8ulp-mu
      - items:
          - enum:
              - fsl,imx7s-mu
              - fsl,imx8mq-mu
              - fsl,imx8mm-mu
              - fsl,imx8mn-mu
              - fsl,imx8mp-mu
              - fsl,imx8qm-mu
              - fsl,imx8qxp-mu
          - const: fsl,imx6sx-mu
      - description: To communicate with i.MX8 SCU with fast IPC
        items:
          - const: fsl,imx8-mu-scu
          - enum:
              - fsl,imx8qm-mu
              - fsl,imx8qxp-mu
          - const: fsl,imx6sx-mu
      - items:
          - enum:
              - fsl,imx94-mu
          - const: fsl,imx95-mu

  reg:
    minItems: 1
    maxItems: 2

  reg-names:
    minItems: 1
    maxItems: 2

  memory-region:
    $ref: /schemas/types.yaml#/definitions/phandle

  interrupts:
    minItems: 1
    maxItems: 2

  interrupt-names:
    minItems: 1
    maxItems: 2

  "#mbox-cells":
    description: |
      <&phandle type channel>
      phandle   : Label name of controller
      type      : Channel type
      channel   : Channel number

      This MU support 6 type of unidirectional channels, each type
      has 4 channels except RST channel which only has 1 channel.
      A total of 21 channels.  Following types are
      supported:
      0 - TX channel with 32bit transmit register and IRQ transmit
          acknowledgment support.
      1 - RX channel with 32bit receive register and IRQ support
      2 - TX doorbell channel. Without own register and no ACK support.
      3 - RX doorbell channel.
      4 - RST channel
      5 - Tx doorbell channel. With S/W ACK from the other side.
    const: 2

  clocks:
    maxItems: 1

  fsl,mu-side-b:
    description: boolean, if present, means it is for side B MU.
    type: boolean

  power-domains:
    maxItems: 1

  ranges: true

  '#address-cells':
    const: 1

  '#size-cells':
    const: 1

required:
  - compatible
  - reg
  - interrupts
  - "#mbox-cells"

allOf:
  - if:
      properties:
        compatible:
          enum:
            - fsl,imx93-mu-s4
    then:
      properties:
        interrupt-names:
          minItems: 2
        interrupts:
          minItems: 2
      required:
        - interrupt-names

    else:
      properties:
        interrupts:
          maxItems: 1

  - if:
      properties:
        compatible:
          contains:
            const: fsl,imx95-mu
    then:
      patternProperties:
        "^sram@[a-f0-9]+$":
          type: object
  # MU Prime requires 2 register regions (MU + ATU)
  - if:
      properties:
        compatible:
          enum:
            - fsl,imx94-mu-prime
            - fsl,imx952-mu-prime
    then:
      properties:
        reg:
          minItems: 2
          maxItems: 2

        reg-names:
          items:
            - const: prime
            - const: atu

        interrupts:
          maxItems: 1

        interrupt-names:
          items:
            - const: tx
            - const: rx

        memory-region:
          description: External DDR region for V2X messaging

      required:
        - reg-names
        - interrupt-names

patternProperties:
  "^sram@[a-f0-9]+$":
    type: object
    description: Optional SRAM region for SCMI shared memory

additionalProperties: false

examples:
  - |
    #include <dt-bindings/interrupt-controller/arm-gic.h>

    mailbox@5d1b0000 {
        compatible = "fsl,imx8qxp-mu", "fsl,imx6sx-mu";
        reg = <0x5d1b0000 0x10000>;
        interrupts = <GIC_SPI 176 IRQ_TYPE_LEVEL_HIGH>;
        #mbox-cells = <2>;
    };

  - |
    #include <dt-bindings/interrupt-controller/arm-gic.h>

    mailbox@445b0000 {
        compatible = "fsl,imx95-mu";
        reg = <0x445b0000 0x10000>;
        ranges;
        interrupts = <GIC_SPI 226 IRQ_TYPE_LEVEL_HIGH>;
        #address-cells = <1>;
        #size-cells = <1>;
        #mbox-cells = <2>;

        sram@445b1000 {
            compatible = "mmio-sram";
            reg = <0x445b1000 0x400>;
            ranges = <0x0 0x445b1000 0x400>;
            #address-cells = <1>;
            #size-cells = <1>;

            scmi-sram-section@0 {
                compatible = "arm,scmi-shmem";
                reg = <0x0 0x80>;
            };

            scmi-sram-section@80 {
                compatible = "arm,scmi-shmem";
                reg = <0x80 0x80>;
            };
        };
    };

  - |
    #include <dt-bindings/interrupt-controller/arm-gic.h>

    mailbox@47320000 {
        compatible = "fsl,imx94-mu-prime";
        reg = <0x47320000 0x10000>,
              <0x42680000 0x200>;
        reg-names = "prime", "atu";
        interrupts = <GIC_SPI 384 IRQ_TYPE_LEVEL_HIGH>;
        interrupt-names = "tx", "rx";
        #mbox-cells = <2>;
    };
```

## Documentation/devicetree/bindings/phy/fsl,imx93-mipi-dphy.yaml
```yaml
# SPDX-License-Identifier: (GPL-2.0 OR BSD-2-Clause)
%YAML 1.2
---
$id: http://devicetree.org/schemas/phy/fsl,imx93-mipi-dphy.yaml#
$schema: http://devicetree.org/meta-schemas/core.yaml#

title: Freescale i.MX93 Synopsys DesignWare MIPI DPHY

maintainers:
  - Liu Ying <victor.liu@nxp.com>

properties:
  compatible:
    items:
      - enum:
          - fsl,imx93-mipi-dphy
          - fsl,imx95-dphy-rx
          - fsl,imx95-combo-rx

  reg:
    minItems: 1

  "#phy-cells":
    const: 0

  clocks:
    minItems: 1
    maxItems: 3

  clock-names:
    minItems: 1
    maxItems: 3

  power-domains:
    maxItems: 1

  assigned-clocks:
    maxItems: 1

  assigned-clock-parents:
    maxItems: 1

  assigned-clock-rates:
    maxItems: 1

  fsl,csis:
    $ref: /schemas/types.yaml#/definitions/phandle-array
    minItems: 1
    maxItems: 2
    description:
      Must be the device tree identifier of the CSI memory map. This is required only
      for the i.MX95 CSI standalone dphy-rx driver.

  fsl,dsi:
    description:
      Must be the device tree identifier of the DSI memory map. This is required only
      for the CSI/DSI combo driver, where CSI shares the same combo phy with the DSI.
    maxItems: 1

required:
  - compatible
  - "#phy-cells"
  - clocks
  - clock-names
  - power-domains

additionalProperties: false

allOf:
  - if:
      properties:
        compatible:
          contains:
            enum:
              - fsl,imx93-mipi-dphy
    then:
      properties:
        clocks:
          items:
            - description: PHY configuration clock
            - description: PHY reference clock
        clock-names:
          items:
            - const: phy_cfg
            - const: phy_ref

  - if:
      properties:
        compatible:
          contains:
            enum:
              - fsl,imx95-dphy-rx
              - fsl,imx95-combo-rx
    then:
      properties:
        reg:
          maxItems: 1
        clocks:
          description: PHY configuration clock
        clock-names:
          const: phy_cfg
        fsl,csis:
          minItems: 1
          maxItems: 1
      required:
        - reg
        - fsl,csis

  - if:
      properties:
        compatible:
          contains:
            enum:
              - fsl,imx952-dphy-rx
    then:
      properties:
        reg:
          minItems: 1
          maxItems: 2
        clocks:
          items:
            - description: PHY configuration clock
            - description: CSI controller instance 0 pixel clock
            - description: CSI controller instance 1 pixel clock
          minItems: 2
        clock-names:
          items:
            - const: phy_cfg
            - const: csi0
            - const: csi1
          minItems: 2
        fsl,csis:
          minItems: 1
          maxItems: 2
      required:
        - reg
        - fsl,csis

examples:
  - |
    #include <dt-bindings/clock/imx93-clock.h>
    #include <dt-bindings/power/fsl,imx93-power.h>

    dphy: dphy {
        compatible = "fsl,imx93-mipi-dphy";
        clocks = <&clk IMX93_CLK_MIPI_PHY_CFG>, <&clk IMX93_CLK_24M>;
        clock-names = "phy_cfg", "phy_ref";
        assigned-clocks = <&clk IMX93_CLK_MIPI_PHY_CFG>;
        assigned-clock-parents = <&clk IMX93_CLK_24M>;
        assigned-clock-rates = <24000000>;
        #phy-cells = <0>;
        power-domains = <&media_blk_ctrl IMX93_MEDIABLK_PD_MIPI_DSI>;
    };

...
```

## Documentation/devicetree/bindings/phy/nxp,imx952-mipi-dphy.yaml
```yaml
# SPDX-License-Identifier: (GPL-2.0-only OR BSD-2-Clause)
%YAML 1.2
---
$id: http://devicetree.org/schemas/phy/nxp,imx952-mipi-dphy.yaml#
$schema: http://devicetree.org/meta-schemas/core.yaml#

title: NXP i.MX952 MIPI DPHY

maintainers:
  - Liu Ying <victor.liu@nxp.com>

properties:
  compatible:
    const: nxp,imx952-mipi-dphy

  reg:
    maxItems: 1

  "#clock-cells":
    const: 0

  clocks:
    maxItems: 3

  clock-names:
    items:
      - const: apb
      - const: cfg
      - const: ref

  nxp,blk-ctrl:
    $ref: /schemas/types.yaml#/definitions/phandle
    description:
      A phandle referencing the block control that controls MIPI DPHY and MIPI
      DPHY PLL.

  "#phy-cells":
    const: 0

  power-domains:
    maxItems: 1

additionalProperties: false

examples:
  - |
    phy@4b110000 {
        compatible = "nxp,imx952-mipi-dphy";
        reg = <0x4b110000 0x40000>;
        #clock-cells = <0>;
        clocks = <&scmi_clk 81>, <&scmi_clk 79>, <&scmi_clk 79>;
        clock-names = "apb", "cfg", "ref";
        nxp,blk-ctrl = <&display_dsi_csr>;
        #phy-cells = <0>;
        power-domains = <&scmi_devpd 11>;
    };
```
