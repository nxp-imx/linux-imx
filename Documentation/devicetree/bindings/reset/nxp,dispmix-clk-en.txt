## Documentation/devicetree/bindings/video/fsl,csi-v4l2-capture.txt
```
* Freescale CMOS Sensor Interface (CSI) V4L2 Capture

Required properties for CSI
- compatible: "fsl,<soc>-csi". Supported chip includes imx6sl
- reg: Address and length of the register set for CSI
- interrupts: Should contain CSI interrupts

Required properties for v4l2_capture
- compatible: should be "fsl,<soc>-csi-v4l2", supported socs include imx6sl

Required properties for sensor
- compatible:  "<vendor>,<sensor>"
  please check the supported sensor in the Supported Sensor fields.
- reg: sensor I2C slave address
- pinctrl-names: should be "default" for parallel sensor
- pinctrl-0: should depend on the connection between sensor and i.MX
  connection between sensor and i.MX could be only legacy parallel on i.MX6SL
- clocks: should be the clock source provided to sensor.
- clock-names: should be "csi_mclk"
- AVDD-supply: set according to the board.
- DVDD-supply: set according to the board.
- pwn-gpios: set according to the board.
- rst-gpios: set according to the board.
- csi_id: csi id for v4l2 capture device
  should be 0 for i.MX6SL
- mclk: should the value of mclk clock send out the sensor. unit is Hz.
- mclk_source: should be 0 for i.MX6SL

Supported Sensor
- ovti, ov5640

Example for CSI:
	csi: csi@020e4000 {
		compatible = "fsl,imx6sl-csi";
		reg = <0x020e4000 0x4000>;
		interrupts = <0 7 0x04>;
		status = "disabled";
	};

Examples for v4l2_capture:
	csi_v4l2_cap {
		compatible = "fsl,imx6q-v4l2-capture";
		status = "okay";
	};

Examples for sensors:
	ov564x: ov564x@3c {
		compatible = "ovti,ov564x";
		reg = <0x3c>;
		pinctrl-names = "default";
		pinctrl-0 = <&pinctrl_csi_0>;
		clocks = <&clks IMX6SL_CLK_CSI>;
		clock-names = "csi_mclk";
		AVDD-supply = <&vgen6_reg>;  /* 2.8v */
		DVDD-supply = <&vgen2_reg>;  /* 1.5v*/
		pwn-gpios = <&gpio1 25 1>;
		rst-gpios = <&gpio1 26 0>;
		csi_id = <0>;
		mclk = <24000000>;
		mclk_source = <0>;
	};
```

## Documentation/devicetree/bindings/video/fsl,ldb.txt
```
* Freescale LVDS Display Bridge(LDB)

The LVDS Display Bridge (LDB) connects a display engine,
such as IPU and LCDIF, to an external LVDS display interface.
The purpose of the LDB is to support flow of synchronous RGB
data from the display engine to external display devices
through LVDS interfaces.  This support covers all aspects of
these activities:
* Connectivity to relevant devices - Displays with LVDS receivers.
* Arranging the data as required by the external display receiver
  and by LVDS display standards.
* Synchronization and control capabilities.

Required properties:
- compatible: Should be "fsl,<soc>-ldb".
- #address-cells: Must be <1>.
- #size-cells: Must be <0>.
- gpr: gpr is the phandle to general purpose register node.
- clocks: The clocks provided by the SoC to LDB, including ldb_di0/1,
  dix_sel, ldb_di0/1_div_3_5, ldb_di0/1_div_7 and ldb_di0/1_div_sel
  clocks.
- clock-names: Must contain entries for each entry in clocks.

Optional properties:
- ext-ref: Provide this bool property if your LDB uses an external
  reference resistor for bandgap.
- split-mode: Provide this bool property if your board uses LDB split
  mode to drive a high resolution display, say 1080P@60.  In this
  mode, two LVDS channels will drive one display.
- dual-mode: Provide this bool property if your board uses LDB dual
  mode to drive two displays.  In this mode, one display engine will
  drive two displays which have the same timings and display content.

Subnode for LVDS Channel
========================

Each LVDS Channel has to contain a display-timings node that describes the
video timings for the connected LVDS display. For detailed information, also
have a look at Documentation/devicetree/bindings/video/display-timing.txt.

Required properties:
- reg: Should be <0> or <1>.
- fsl,data-mapping: Should be "spwg" or "jeida".
  This describes how the color bits are laid out in the serialized LVDS signal.
- fsl,data-width: Should be <18> or <24>.
- crtc: Should be "ipu1/2-di0/1" for i.MX6Q, "ipu1-di0/1" or "LCDIF" for i.MX6DL,
  "ipu-di0/1" for i.MX53 and "lcdif1/2" for i.MX6sx.

Optional properties:
- primary: Provide this bool property if this channel is the one found by a
  framebuffer with a smaller node id.  This property is not valid for
  dual mode and split mode.

ldb: ldb@020e0008 {
	#address-cells = <1>;
	#size-cells = <0>;
	gpr = <&gpr>;
	compatible = "fsl,imx6dl-ldb", "fsl,imx53-ldb";
	gpr = <&gpr>;
	clocks = <&clks 135>, <&clks 136>,
		 <&clks 39>, <&clks 40>,
		 <&clks 41>,
		 <&clks 184>, <&clks 185>,
		 <&clks 205>, <&clks 206>,
		 <&clks 207>, <&clks 208>;
	clock-names = "ldb_di0", "ldb_di1",
		      "di0_sel", "di1_sel",
		      "di2_sel",
		      "ldb_di0_div_3_5", "ldb_di1_div_3_5",
		      "ldb_di0_div_7", "ldb_di1_div_7",
		      "ldb_di0_div_sel", "ldb_di1_div_sel";

	lvds-channel@0 {
		reg = <0>;
		fsl,data-mapping = "spwg";
		fsl,data-width = <18>;
		crtc = "ipu1-di0";

		display-timings {
			/* ... */
		};
	};

	lvds-channel@1 {
		reg = <1>;
		fsl,data-mapping = "spwg";
		fsl,data-width = <18>;
		crtc = "ipu1-di1";
		primary;

		display-timings {
			/* ... */
		};
	};
};
```

## Documentation/devicetree/bindings/video/fsl,mipi-csi2.txt
```
* Freescale MIPI CSI2 Controller for i.MX6DQ/i.MX6SDL

Required properties for mipi csi2 controller:
- compatible: should be "fsl,imx6q-mipi-csi2"
- reg: <base addr, range> contains mipi csi2 register base address and range
- interrupts: <type num flag> where type is a interrupt type, num is the
  interrupt number and flag is a field that level/trigger information for
  the interrupt.
- clocks: the clock sources that mipi csi2 depends on.
- clock-names: the name is related to the clock source one by one.
- status: should be set to "disable".

Required properties for mipi csi2 on specified board:
- ipu_id: ipu id which mipi csi2 connected to.
  should be 0 or 1 for i.MX6DQ; should be 0 for i.MX6SDL
- csi_id: csi id which mipi csi2 connected to.
  should be 0 or 1 for i.MX6DQ/i.MX6SDL
- v_channel: virtual channel which send to MIPI CSI2 controller
  should keep consistent with the input MIPI signal.
- lanes: data lanes of input MIPI signal. The maximum data lanes is 4.
  should keep consistent with the input MIPI signal.
- status: should be set to "okay".

Examples:
for SOC imx6qdl.dtsi:
	mipi_csi@021dc000 {
		compatible = "fsl,imx6q-mipi-csi2";
		reg = <0x021dc000 0x4000>;
		interrupts = <0 100 0x04>, <0 101 0x04>;
		clocks = <&clks 138>, <&clks 53>, <&clks 204>;
		clock-names = "dphy_clk", "pixel_clk", "cfg_clk";
		status = "disabled";
	};

for board imx6qdl-sabresd.dtsi:
	mipi_csi@021dc000 {
		status = "okay";
		ipu_id = <0>;
		csi_id = <1>;
		v_channel = <0>;
		lanes = <2>;
	};
```

## Documentation/devicetree/bindings/video/fsl,v4l2-capture.txt
```
* Freescale V4L2 Capture for i.MX6DQ/i.MX6SDL

Required board properties for IPUv3 capture:
- clocks: should include the clock provided by i.MX6 to sensor
- clock-names: sensor clock's name should be "ipux_csiy"
  x should be 1 or 2 for i.MX6DQ; should be 1 for i.MX6SDL
  y is 0 or 1 for i.MX6DQ/i.MX6SDL
Note: other detailed information for IPUv3, please refer to
Documentation/devicetree/bindings/fb/fsl_ipuv3_fb.txt

Required properties for v4l2_capture
- compatible: should be "fsl,imx6q-v4l2-capture"
- ipu_id: ipu id for v4l2 capture device
  should be 0 or 1 for i.MX6DQ; should be 0 for i.MX6SDL
- csi_id: csi id for v4l2 capture device
  should be 0 or 1 for i.MX6DQ/i.MX6SDL
- mclk_source: should be 0 or 1. two mclk sources at most now
- status: should be set to "okay" to enable this device

Required properties for sensor
- compatible:  "<vendor>,<sensor>"
  please check the supported sensor in the Supported Sensor fields.
- reg: sensor I2C slave address
- pinctrl-names: should be "default" for parallel sensor
- pinctrl-0: should depend on the connection between sensor and i.MX
  connection between sensor and i.MX could be MIPI-CSI2 or legacy parallel
- clocks: should be the clock source provided to sensor.
- clock-names: should be "csi_mclk"
- DOVDD-supply: set according to the board.
- AVDD-supply: set according to the board.
- DVDD-supply: set according to the board.
- pwn-gpios: set according to the board.
- rst-gpios: set according to the board.
- csi_id: csi id for v4l2 capture device
  should be 0 or 1 for i.MX6DQ/i.MX6SDL.
- mclk: should the value of mclk clock send out the sensor. unit is Hz.
- mclk_source: should be 0 or 1 and should be the same as the setting in
  v4l2_capture.
- cvbs: 1 for CVBS input, 0 YPbPr input. This property is only needed for
  adv7180 tv decoder.

Supported Sensor
- ov5640
- ov5642
- ov5640_mipi
- adv7180


Example for IPUv3 including capture settings on imx6q-sabresd.dts:
	ipu1: ipu@02400000 { /* IPU1 */
		compatible = "fsl,imx6q-ipuv3";
		reg = <0x02400000 0x400000>;
		interrupts = <0 5 0x04>, < 0 6 0x04>;
		clocks = <&clks 130>, <&clks 131>, <&clks 132>, <&clks 39>, <&clks 40>, <&clks 169>;
		clock-names = "ipu1", "ipu1_di0", "ipu1_di1", "ipu1_di0_sel", "ipu1_di1_sel", "ipu1_csi0";
		status = "disabled";
	};

Examples for v4l2_capture:
	v4l2_cap {
		compatible = "fsl,imx6q-v4l2-capture";
		ipu_id = <0>;
		csi_id = <0>;
		mclk_source = <0>;
		status = "okay";
	};

Examples for sensors:
	ov5642: ov5642@3c {
		compatible = "ovti,ov5642";
		reg = <0x3c>;
		pinctrl-names = "default";
		pinctrl-0 = <&pinctrl_ipu1_2>;
		clocks = <&clks 201>;
		clock-names = "csi_mclk";
		DOVDD-supply = <&vgen4_reg>; /* 1.8v */
		AVDD-supply = <&vgen3_reg>;  /* 2.8v, on rev C board is VGEN3 */
		DVDD-supply = <&vgen2_reg>;  /* 1.5v*/
		pwn-gpios = <&gpio1 16 1>;   /* active low: SD1_DAT0 */
		rst-gpios = <&gpio1 17 0>;   /* active high: SD1_DAT1 */
		csi_id = <0>;
		mclk = <24000000>;
		mclk_source = <0>;
	};

	adv7180: adv7180@21 {
		compatible = "adv,adv7180";
		reg = <0x21>;
		pinctrl-names = "default";
		pinctrl-0 = <&pinctrl_ipu1_3>;
		clocks = <&clks 201>;
		clock-names = "csi_mclk";
		DOVDD-supply = <&reg_3p3v>; /* 3.3v, enabled via 2.8 VGEN6 */
		AVDD-supply = <&reg_3p3v>;  /* 1.8v */
		DVDD-supply = <&reg_3p3v>;  /* 1.8v */
		PVDD-supply = <&reg_3p3v>;  /* 1.8v */
		pwn-gpios = <&max7310_b 2 0>;
		csi_id = <0>;
		mclk = <24000000>;
		mclk_source = <0>;
		cvbs = <1>;
	};
```

## Documentation/devicetree/bindings/video/hannstar,cabc.txt
```
* Hannstar CABC device tree bindings

The Hannstar CABC function may turn a display plane's backlight
automatically according to the content shown on the plane.  The
function is controlled(enabled/disabled) by a GPIO.

Required properties:
- compatible : Should be "hannstar,cabc".

Each standalone CABC gpio is represented as a sub-node of "hannstar_cabc":
Required subnode properties:
- gpios: OF device-tree gpio specification.

Optional subnode properties:
- cabc-enable: Provide this bool property if you want to enable the CABC feature.

Example:
	hannstar_cabc {
		compatible = "hannstar,cabc";

		lvds0 {
			gpios = <&gpio6 15 GPIO_ACTIVE_HIGH>;
		};

		lvds1 {
			gpios = <&gpio6 16 GPIO_ACTIVE_HIGH>;
		};
	};
```
