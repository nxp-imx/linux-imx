## Documentation/devicetree/bindings/reset/nxp,dispmix-clk-en.txt
```
NXP Display Mix clk-en Reset Controller
=======================================

This binding describes a reset controller device that is used to enable
or disable the internal clocks for all the submodules(such as, LCDIF,
MIPI DSI, MIPI CSI, ISI and etc) included by the Display Mix subsystem
on IMX8MM and IMX8MN platforms. Like sft-rstn, only assert and deassert
functions are required for submodule internal clocks enable or disable,
that means the clk-en can be treated as a real reset controller.

Please also refer to reset.txt in this directory for common reset
controller binding usage.

Required properties:
- compatible: Should be "fsl,imx8mm-dispmix-clk-en" or
			"fsl,imx8mn-dispmix-clk-en".
- reg: should be register base and length as documented in the datasheet.
- clocks: phandle and clock specifier to disp apb clock for register access.
- clock-names: should be "disp-apb".
- power-domains: phandle to dispmix power domain.
- reset-cells: 1, see below.

example:

	dispmix_clk_en: dispmix-clk-en@32e28004 {
		compatible = "fsl,imx8mn-dispmix-clk-en";
		reg = <0x0 0x32e28004 0x0 0x4>;
		clocks = <&clk IMX8MN_CLK_DISP_APB_ROOT>;
		clock-names = "disp-apb";
		power-domains = <&dispmix_pd>;
		#reset-cells = <1>;
	};
```

## Documentation/devicetree/bindings/reset/nxp,dispmix-mipi-rst.txt
```
NXP Display Mix mipi-rst Reset Controller
=========================================

This binding describes a reset controller device that is used to reset
or de-reset the MIPI DPHY master direction(for MIPI DSI) and slave
direction(for MIPI CSI) included by the Display Mix subsystem on IMX8MM
and IMX8MN platforms. Like sft-rstn, only assert and deassert functions
are required for PHY reset or de-reset.

Please also refer to reset.txt in this directory for common reset
controller binding usage.

Required properties:
- compatible: Should be "fsl,imx8mm-dispmix-mipi-rst" or
			"fsl,imx8mn-dispmix-mipi-rst".
- reg: should be register base and length as documented in the datasheet.
- clocks: phandle and clock specifier to disp apb clock for register access.
- clock-names: should be "disp-apb".
- power-domains: phandle to dispmix power domain.
- reset-cells: 1, see below.

example:

	dispmix_mipi_rst: dispmix-mipi-rst@32e28008 {
		compatible = "fsl,imx8mn-dispmix-mipi-rst";
		reg = <0x0 0x32e28008 0x0 0x4>;
		clocks = <&clk IMX8MN_CLK_DISP_APB_ROOT>;
		clock-names = "disp-apb";
		active_low;
		power-domains = <&dispmix_pd>;
		#reset-cells = <1>;
	};
```

## Documentation/devicetree/bindings/reset/nxp,dispmix-sft-rstn.txt
```
NXP Display Mix sft-rstn Reset Controller
=========================================

This binding describes a reset controller device that is used to reset
or de-reset all the submodules(such as, LCDIF, MIPI DSI, MIPI CSI, ISI
and etc) included by the Display Mix subsystem on IMX8MM and IMX8MN
platforms. Only assert and deassert functions are required for submodule
reset or de-reset.

Please also refer to reset.txt in this directory for common reset
controller binding usage.

Required properties:
- compatible: Should be "fsl,imx8mm-dispmix-sft-rstn" or
			"fsl,imx8mn-dispmix-sft-rstn".
- reg: should be register base and length as documented in the datasheet.
- clocks: phandle and clock specifier to disp apb clock for register access.
- clock-names: should be "disp-apb".
- power-domains: phandle to dispmix power domain.
- reset-cells: 1, see below.

example:

	dispmix_sft_rstn: dispmix-sft-rstn@32e28000 {
		compatible = "fsl,imx8mm-dispmix-sft-rstn";
		reg = <0x0 0x32e28000 0x0 0x4>;
		clocks = <&clk IMX8MM_CLK_DISP_APB_ROOT>;
		clock-names = "disp-apb";
		active_low;
		power-domains = <&dispmix_pd>;
		#reset-cells = <1>;
	};
```

## Documentation/devicetree/bindings/serial/fsl,s32-linflexuart.txt
```
* Freescale LINFlexD UART

The LINFlexD controller implements several LIN protocol versions, as well as
support for full-duplex UART communication through 8-bit and 9-bit frames.

See chapter 47 ("LINFlexD") in the reference manual[1].

Required properties:
- compatible :
  - "fsl,s32v234-linflexuart" for LINFlexD configured in UART mode, which
    is compatible with the one integrated on S32V234 SoC
- reg : Address and length of the register set for the device
- interrupts : Should contain uart interrupt
- clocks : phandle + clock specifier pairs, one for each entry in clock-names
- clock-names : should contain: "lin" - the uart clock

Optional properties:
- dmas : Specifies two DMA channels - one entry for each entry in dma-names
- dma-names : DMA channel names - "tx" for transmission, "rx" for reception

Example:
uart0: serial@40053000 {
	compatible = "fsl,s32v234-linflexuart";
	reg = <0x0 0x40053000 0x0 0x1000>;
	interrupts = <0 59 4>;
	clocks = <&clks S32V234_CLK_LIN>;
	clock-names = "lin";
	dmas = <&edma 0 20>,
	       <&edma 0 19>;
	dma-names = "rx", "tx";
};

[1] https://www.nxp.com/webapp/Download?colCode=S32V234RM
```

## Documentation/devicetree/bindings/soc/fsl/gpc.txt
```
* General Power Controller (GPC)
-------------------------------------------
The General Power Controller (GPC) module controls the following functions:
  - Provide low power mode control for A7 and M4 platform
  - Provide Power domain management all ARM and SOC power domain
  - Provide domain control mechanism based on A7 and M4 CPU domain
  - Provide handshake with CCM for clock management in low power mode
  - Provide handshake with SRC for power down and power up sequence
  - Provide handshake with Analog for Deep Sleep Mode control

Required properties:
  - reg : Offset and length of the register set of the GPC block.
  - compatible : Must contain a chip-specific GPC block compatible string
	and (if applicable) may contain a chassis-version GPC compatible
	string. Chip-specific strings are of the form "fsl,<chip>-gpc",
	such as:
	* "fsl,imx7d-gpc"
	* "fsl,imx7s-gpc"
  - interrupt-controller : Specifies that this is an interrupt controller

Example:
The GPC node for imx7d:
	gpc: gpc@303a0000 {
		compatible = "fsl,imx7d-gpc";
		reg = <0x303a0000 0x1000>;
		interrupt-controller;
		interrupts = <GIC_SPI 87 IRQ_TYPE_LEVEL_HIGH>;
		#interrupt-cells = <3>;
		interrupt-parent = <&intc>;
		fsl,mf-mix-wakeup-irq = <0x54010000 0xc00 0x0 0x1040640>;
	};

* Power Gating Controller (PGC)
-------------------------------------------
The Power Gating Controller (PGC) is a power management component that controls the
power-down and power-up sequencing of individual subsystems.
The PGC block is found inside GPC, and share the same register.

Required properties:
  - compatible : Must contain a chip-specific PGC block compatible string
	and (if applicable) may contain a chassis-version PGC compatible
	string. Chip-specific strings are of the form "fsl,<chip>-pgc",
	such as:
	* "fsl,imx7d-pgc"
	* "fsl,imx7s-pgc"
  - *-supply : Specifies the regulators that can be managed by this PGC. For exampe:
	* "mipi-phy-supply = <&reg_1p0d>;"

Example:
The PGC node for imx7d:
	pgc {
		compatible = "fsl,imx7d-pgc";
		mipi-phy-supply = <&reg_1p0d>;
		pcie-phy-supply = <&reg_1p0d>;
		vcc-supply = <&reg_1p2>;
	};
```

## Documentation/devicetree/bindings/soc/fsl/imx_seco_mu.txt
```
NXP i.MX8 SECO MU

Driver for exchanging messages with SECO core on i.MX8 SOC.
Communication with SECO is performed through a Messaging Unit (MU).
Exposes a char device to user-space.

Required properties:
  - compatible        : Contains "fsl,imx8-seco-mu".
  - reg               : Offset and length of the register set for the device.
  - power-domains     : phandle pointing to power domain.
  - interrupts        : the interrupt line from the MU.
  - fsl,seco_mu_id    : Index of this MU from SECO point of view.
  - fsl,seco_max_users: Maximum number of users allowed to share this MU.

Example:
mu_seco2: mu@31560000 {
  compatible = "fsl,imx8-seco-mu";
  reg = <0x0 0x31560000 0x0 0x10000>;
  power-domains = <&pd_seco_mu_2>;
  interrupts = <GIC_SPI 448 IRQ_TYPE_LEVEL_HIGH>;
  fsl,seco_mu_id = <2>;
  fsl,seco_max_users = <2>;
  status = "okay";
};
```

## Documentation/devicetree/bindings/soc/imx/fsl,imx93-src.yaml
```yaml
# SPDX-License-Identifier: (GPL-2.0-only OR BSD-2-Clause)
%YAML 1.2
---
$id: http://devicetree.org/schemas/soc/imx/fsl,imx93-src.yaml#
$schema: http://devicetree.org/meta-schemas/core.yaml#

title: NXP i.MX9 System Reset Controller

maintainers:
  - Peng Fan <peng.fan@nxp.com>

description: |
  The System Reset Controller (SRC) is responsible for the generation of
  all the system reset signals and boot argument latching.

  Its main functions are as follows,
  - Deals with all global system reset sources from other modules,
    and generates global system reset.
  - Responsible for power gating of MIXs (Slices) and their memory
    low power control.

properties:
  compatible:
    items:
      - const: fsl,imx93-src
      - const: syscon

  reg:
    maxItems: 1

  slice:
    type: object
    description: list of power domains provided by this controller.

    patternProperties:
      "power-domain@[0-9]$":
        type: object
        properties:

          '#power-domain-cells':
            const: 0

          reg:
            description: |
              Power domain index. Valid values are defined in
              include/dt-bindings/power/imx93-power.h for fsl,imx93-src
            maxItems: 1

          clocks:
            description: |
              A number of phandles to clocks that need to be enabled
              during domain power-up sequencing to ensure reset
              propagation into devices located inside this power domain.
            minItems: 1
            maxItems: 5

        required:
          - '#power-domain-cells'
          - reg

required:
  - compatible
  - reg
  - slice

additionalProperties: false

examples:
  - |
    #include <dt-bindings/clock/imx93-clock.h>
    #include <dt-bindings/power/imx93-power.h>

    src@44460000 {
        compatible = "fsl,imx93-src", "syscon";
        reg = <0x44460000 0x10000>;

        slice {
                #address-cells = <1>;
                #size-cells = <0>;

                mediamix: power-domain@0 {
                        reg = <IMX93_POWER_DOMAIN_MEDIAMIX>;
                        #power-domain-cells = <0>;
                        clocks = <&clk IMX93_CLK_MEDIA_AXI>,
                                 <&clk IMX93_CLK_MEDIA_APB>;
                };
        };
    };
```

## Documentation/devicetree/bindings/sound/fsl,dsp.txt
```
NXP DSP

The IP is from Cadence.

Required properties:

  - compatible	: Contains one of "fsl,imx8qxp-dsp-v1", "fsl,imx8qm-dsp-v1",
		  "fsl,imx8mp-dsp-v1", "fsl,imx8ulp-dsp-v1",
  - reg		: Offset and length of the register set for the device.

Example:

dsp:  dsp@596e8000 {
	compatible = "fsl,imx8qxp-dsp";
	reg = <0x0 0x596e8000 0x0 0x88000>;
	status = "okay";
};
```

## Documentation/devicetree/bindings/sound/fsl,easrc.txt
```
Freescale Asynchronous Sample Rate Converter (ASRC) Controller

The Asynchronous Sample Rate Converter (ASRC) converts the sampling rate of a
signal associated with an input clock into a signal associated with a different
output clock. The driver currently works as a Front End of DPCM with other Back
Ends Audio controller such as ESAI, SSI and SAI. It has four context to support
four substreams within totally 32 channels.

Required properties:

  - compatible		: Contains "fsl,imx8mn-easrc".

  - reg			: Offset and length of the register set for the device.

  - interrupts		: Contains the asrc interrupt.

  - dmas		: Generic dma devicetree binding as described in
			  Documentation/devicetree/bindings/dma/dma.txt.

  - dma-names		: Contains "ctx0_rx", "ctx0_tx", "ctx1_rx", "ctx1_tx",
				   "ctx2_rx", "ctx2_tx", "ctx3_rx", "ctx3_tx".

  - clocks		: Contains an entry for each entry in clock-names.

  - clock-names		: Contains the following entries
	"mem"		  Peripheral clock to driver module.

  - fsl,easrc-ram-script-name : The coefficient table for the filters
  - fsl,asrc-rate	: Defines a mutual sample rate used by DPCM Back Ends.

  - fsl,asrc-width	: Defines a mutual sample width used by DPCM Back Ends.

Example:

easrc: easrc@300C0000 {
	compatible = "fsl,imx8mn-easrc";
	reg = <0x0 0x300C0000 0x0 0x10000>;
	interrupts = <GIC_SPI 122 IRQ_TYPE_LEVEL_HIGH>;
	clocks = <&clk IMX8MN_CLK_ASRC_ROOT>;
	clock-names = "mem";
	dmas = <&sdma2 16 23 0> , <&sdma2 17 23 0>,
	       <&sdma2 18 23 0> , <&sdma2 19 23 0>,
	       <&sdma2 20 23 0> , <&sdma2 21 23 0>,
	       <&sdma2 22 23 0> , <&sdma2 23 23 0>;
	dma-names = "ctx0_rx", "ctx0_tx",
		    "ctx1_rx", "ctx1_tx",
		    "ctx2_rx", "ctx2_tx",
		    "ctx3_rx", "ctx3_tx";
	fsl,easrc-ram-script-name = "imx/easrc/easrc-imx8mn.bin";
	fsl,asrc-rate  = <8000>;
	fsl,asrc-width = <16>;
	status = "disabled";
};
```

## Documentation/devicetree/bindings/sound/fsl-asrc-p2p.txt
```
* Freescale Asynchronous Sample Rate Converter (ASRC)

This document is for asrc p2p node. p2p is one of asrc mode. asrc p2p depend on
MXC_ASRC.

Required properties:
  - compatible: Should be "fsl,<chip>-asrc-p2p".
  - fsl,p2p-rate: the p2p rate of asrc p2p. which can be <32000> to <192000>,
  - fsl,p2p-width: the p2p width of asrc p2p. which can be <16>, <24>.
  - fsl,asrc-dma-rx-events: The rx dma event of the asrc, <a b c> corresponding
			    to 3 pair of asrc.
  - fsl,asrc-dma-tx-events: The tx dma event of the esai, <a b c> corresponding
			    to 3 pair of asrc.

Example:
asrc_p2p: asrc_p2p {
	compatible = "fsl,imx6q-asrc-p2p";
	fsl,p2p-rate  = <48000>;
	fsl,p2p-width = <16>;
	fsl,asrc-dma-rx-events = <17 18 19>;
	fsl,asrc-dma-tx-events = <20 21 22>;
	status = "okay";
};
```

## Documentation/devicetree/bindings/staging/ion/fsl-heap.txt
```
Freescale ION unmapped heap for i.MX

Unmapped heap are used for security purpose, providing secure data
path buffers for video decode and display.

Required properties
- compatible:
  -  "fsl,display-heap" for display ion heap
  -  "fsl,vpu-heap" for vpu decoder ion heap

Required properties for Ion heaps
- memory-region: one reserved mem region pointer.

Example:
  ion-display-region {
    compatible = "fsl,display-heap", "linux,ion-heap-unmapped";
    memory-region = <&display_region>;
  };
```

## Documentation/devicetree/bindings/staging/ion/imx-ion-pool.txt
```
Freescale reserved memory regions

iMX reserved memory pool, being merged into cma region

Required properties
- compatible: "imx-ion-pool"

Required properties:
 - reg: (standard definition) static memory range


Example:
  vpu_region: imx_ion@2 {
    compatible = "imx-ion-pool";
    reg = <0x0 0xe4000000 0 0x02000000>;
  };
```
